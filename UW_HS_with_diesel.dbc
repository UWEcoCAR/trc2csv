VERSION ""

NS_ :

BS_:

BU_: HSCU BCM RINE BRUSA DCDC HVAC DECM BCM_HS HCSU ACCM_HS VICM_HS

BO_ 1120 BCM_Faults: 8 BCM
 SG_ bcm_dtc_057 m29 : 23|24@0+ (1,0) [0|16777215] "DTC ID"  HSCU
 SG_ bcm_dtc_058 m29 : 47|24@0+ (1,0) [0|16777215] "DTC ID"  HSCU
 SG_ bcm_dtc_059 m30 : 23|24@0+ (1,0) [0|16777215] "DTC ID"  HSCU
 SG_ bcm_dtc_060 m30 : 47|24@0+ (1,0) [0|16777215] "DTC ID"  HSCU
 SG_ bcm_dtc_061 m31 : 23|24@0+ (1,0) [0|16777215] "DTC ID"  HSCU
 SG_ bcm_dtc_062 m31 : 47|24@0+ (1,0) [0|16777215] "DTC ID"  HSCU
 SG_ bcm_dtc_063 m32 : 23|24@0+ (1,0) [0|16777215] "DTC ID"  HSCU
 SG_ bcm_dtc_064 m32 : 47|24@0+ (1,0) [0|16777215] "DTC ID"  HSCU
 SG_ bcm_dtc_065 m33 : 23|24@0+ (1,0) [0|16777215] "DTC ID"  HSCU
 SG_ bcm_dtc_066 m33 : 47|24@0+ (1,0) [0|16777215] "DTC ID"  HSCU
 SG_ bcm_dtc_067 m34 : 23|24@0+ (1,0) [0|16777215] "DTC ID"  HSCU
 SG_ bcm_dtc_068 m34 : 47|24@0+ (1,0) [0|16777215] "DTC ID"  HSCU
 SG_ bcm_dtc_069 m35 : 23|24@0+ (1,0) [0|16777215] "DTC ID"  HSCU
 SG_ bcm_dtc_070 m35 : 47|24@0+ (1,0) [0|16777215] "DTC ID"  HSCU
 SG_ bcm_dtc_071 m36 : 23|24@0+ (1,0) [0|16777215] "DTC ID"  HSCU
 SG_ bcm_dtc_072 m36 : 47|24@0+ (1,0) [0|16777215] "DTC ID"  HSCU
 SG_ bcm_dtc_073 m37 : 23|24@0+ (1,0) [0|16777215] "DTC ID"  HSCU
 SG_ bcm_dtc_074 m37 : 47|24@0+ (1,0) [0|16777215] "DTC ID"  HSCU
 SG_ bcm_dtc_075 m38 : 23|24@0+ (1,0) [0|16777215] "DTC ID"  HSCU
 SG_ bcm_dtc_076 m38 : 47|24@0+ (1,0) [0|16777215] "DTC ID"  HSCU
 SG_ bcm_dtc_077 m39 : 23|24@0+ (1,0) [0|16777215] "DTC ID"  HSCU
 SG_ bcm_dtc_078 m39 : 47|24@0+ (1,0) [0|16777215] "DTC ID"  HSCU
 SG_ bcm_dtc_079 m40 : 23|24@0+ (1,0) [0|16777215] "DTC ID"  HSCU
 SG_ bcm_dtc_080 m40 : 47|24@0+ (1,0) [0|16777215] "DTC ID"  HSCU
 SG_ bcm_dtc_page M : 7|8@0+ (1,0) [0|255] "page number"  HSCU

BA_DEF_ SG_  "GenSigStartValue" INT 0 0;
BA_DEF_ BO_  "GenMsgCycleTime" INT 0 1000;
BA_DEF_ SG_  "SystemSignalLongSymbol" STRING ;
BA_DEF_DEF_  "GenSigStartValue" 0;
BA_DEF_DEF_  "GenMsgCycleTime" 100;
BA_DEF_DEF_  "SystemSignalLongSymbol" "";
VAL_ 1120 bcm_dtc_057 0 " - " 11276288 "DTC_VEPO" 11276289 "DTC_HSC_MISSING" 11460608 "DTC_NVM_SOC" 11460609 "DTC_NVM_KOT" 11460610 "DTC_NVM_DTC" 11460611 "DTC_NVM_SOC_CORRECTION" 11460612 "DTC_NVM_APP_SCRATCHPAD" 11517962 "DTC_LOOPTIME_TASK_A" 11517963 "DTC_LOOPTIME_TASK_B" 11517964 "DTC_LOOPTIME_TASK_C" 11517965 "DTC_LOOPTIME_TASK_D" 11517966 "DTC_LOOPTIME_TASK_E" 11517967 "DTC_LOOPTIME_TASK_F" 11323904 "DTC_INTERLOCK_A_FAILED_LOW" 11323905 "DTC_INTERLOCK_A_FAILED_HIGH" 11324160 "DTC_INTERLOCK_B_FAILED_LOW" 11324161 "DTC_INTERLOCK_B_FAILED_HIGH" 15728640 "DTC_EPO" 16498688 "DTC_BRUSA_MISSING" 16498689 "DTC_BRUSA_IDC" 16498690 "DTC_BRUSA_REQ_VS_CMD" 16433152 "DTC_AKERWADE_MISSING" 16433153 "DTC_AKERWADE_IDC" 16433154 "DTC_AKERWADE_REQ_VS_CMD" 16564224 "DTC_CHGLEAR_MISSING" 16564225 "DTC_CHGLEAR_IDC" 16564226 "DTC_CHGLEAR_REQ_VS_CMD" 16522240 "DTC_CSM_MISSING" 16522752 "DTC_CSM_VBAT" 16522753 "DTC_CSM_VPOS" 16522754 "DTC_CSM_VNEG" 16522755 "DTC_CSM_CPOS" 16522756 "DTC_CSM_CNEG" 16522757 "DTC_CSM_APOS" 16522758 "DTC_CSM_ANEG" 16522759 "DTC_CSM_FUSE_HI" 16522760 "DTC_CSM_FUSE_LO" 16521728 "DTC_CSM_ASIC" 16521729 "DTC_CSM_AILO" 16521730 "DTC_CSM_AIHI" 16520957 "DTC_LEAKAGE_DETECT_FAULT" 16522444 "DTC_REALTIMECLOCK_FAULT" 16520945 "DTC_CSM_LEAK_FAIL_CALC" 16520946 "DTC_CSM_LEAK_FAIL_HW" 16520947 "DTC_CSM_LEAK_EXT_SHORT" 16520948 "DTC_CSM_LEAK_MID_PACK_SHORT" 16520949 "DTC_CSM_LEAK_ERROR" 16520950 "DTC_CSM_LEAK_UNKNOWN" 16523008 "DTC_CSM_VER_MISMATCH" 16523009 "DTC_CSM_DTC_SET" 16523010 "DTC_CSM_CAL_FAULT" 16560128 "DTC_IBAT_MISMATCH" 16576512 "DTC_DIS_MAX_I2T" 16576513 "DTC_CHG_MAX_I2T" 16576768 "DTC_DIS_WARNING_I2T" 16576769 "DTC_CHG_WARNING_I2T" 11296784 "DTC_SAEJ1772_PROX_DECT_OOR_HI" 11296785 "DTC_SAEJ1772_PROX_DECT_OOR_LO" 11296800 "DTC_SAEJ1772_PILOT_PWM_OOR_HI" 11296801 "DTC_SAEJ1772_PILOT_PWM_OOR_LO" 11296802 "DTC_SAEJ1772_PILOT_PWM_DIG_COMM" 11296803 "DTC_SAEJ1772_PILOT_PWM_IR_ERR" 16175360 "DTC_FGD1_NO_SENSOR" 16175361 "DTC_FGD1_OOR_HI" 16175362 "DTC_FGD1_OOR_LO" 16175363 "DTC_FGD1_FAULT" 16175616 "DTC_FGD2_NO_SENSOR" 16175617 "DTC_FGD2_OOR_HI" 16175618 "DTC_FGD2_OOR_LO" 16175619 "DTC_FGD2_FAULT" 16171008 "DTC_CONT_OPEN" 16171009 "DTC_CONT_CLOSE" 16171010 "DTC_CONT_OPEN_CURRENT" 16171264 "DTC_CONT_CLOSE_ON_RESET" 16171265 "DTC_CONT_CLOSE_SIG_FAILED" 16171520 "DTC_PRECHARGE_TIMEOUT" 16171777 "DTC_CONT_MPOS_WELD_AT_SU" 16171778 "DTC_CONT_MNEG_WELD_AT_SU" 16171780 "DTC_CONT_CPOS_WELD_AT_SU" 16171781 "DTC_CONT_CNEG_WELD_AT_SU" 16171782 "DTC_CONT_ANEG_WELD_AT_SU" 16171783 "DTC_CONT_APOS_WELD_AT_SU" 16172033 "DTC_CONT_MPOS_WELD_AT_SD" 16172034 "DTC_CONT_MNEG_WELD_AT_SD" 16172036 "DTC_CONT_CPOS_WELD_AT_SD" 16172037 "DTC_CONT_CNEG_WELD_AT_SD" 16172038 "DTC_CONT_ANEG_WELD_AT_SD" 16172039 "DTC_CONT_APOS_WELD_AT_SD" 16172289 "DTC_CONT_MPOS_OPEN" 16172290 "DTC_CONT_MNEG_OPEN" 16172291 "DTC_CONT_MPRE_OPEN" 16172292 "DTC_CONT_CPOS_OPEN" 16172293 "DTC_CONT_CNEG_OPEN" 16172294 "DTC_CONT_APOS_OPEN" 16172295 "DTC_CONT_ANEG_OPEN" 16172545 "DTC_CONT_MPOS_VDIF" 16172546 "DTC_CONT_MNEG_VDIF" 16172548 "DTC_CONT_CPOS_VDIF" 16172549 "DTC_CONT_CNEG_VDIF" 16172550 "DTC_CONT_APOS_VDIF" 16172551 "DTC_CONT_ANEG_VDIF" 16174848 "DTC_HVIL" 16174849 "DTC_LVBAT_LO" 16174850 "DTC_LVBAT_HI" 16174851 "DTC_LVBAT_ERR" 16523520 "DTC_LEMLO_OOR_HI" 16523521 "DTC_LEMLO_OOR_LO" 16523522 "DTC_LEMLO_FAULT" 16523776 "DTC_LEMHI_OOR_HI" 16523777 "DTC_LEMHI_OOR_LO" 16523778 "DTC_LEMHI_FAULT" 16496320 "DTC_MBB_TOO_FEW" 16496321 "DTC_MBB_TOO_MANY" 16496352 "DTC_CELL_VMAX_ERR" 16496353 "DTC_CELL_VMIN_ERR" 16496354 "DTC_CELL_VMAX" 16496362 "DTC_CELL_VMAX_SEVERE" 16496355 "DTC_CELL_VMIN" 16496363 "DTC_CELL_VMIN_SEVERE" 16496356 "DTC_MOD_VOLTAGE_COMPARE" 16496336 "DTC_CELL_T_ERR" 16496337 "DTC_CELL_TMAX1" 16496338 "DTC_CELL_TMAX2" 16496339 "DTC_CELL_TMIN" 16497665 "DTC_MBB_01_MISSING" 16497666 "DTC_MBB_02_MISSING" 16497667 "DTC_MBB_03_MISSING" 16497668 "DTC_MBB_04_MISSING" 16497669 "DTC_MBB_05_MISSING" 16497670 "DTC_MBB_06_MISSING" 16497671 "DTC_MBB_07_MISSING" 16497672 "DTC_MBB_08_MISSING" 16497673 "DTC_MBB_09_MISSING" 16497680 "DTC_MBB_10_MISSING" 16497681 "DTC_MBB_11_MISSING" 16497682 "DTC_MBB_12_MISSING" 16497683 "DTC_MBB_13_MISSING" 16497684 "DTC_MBB_14_MISSING" 16497685 "DTC_MBB_15_MISSING" 16497686 "DTC_MBB_16_MISSING" 16497687 "DTC_MBB_17_MISSING" 16497688 "DTC_MBB_18_MISSING" 16497689 "DTC_MBB_19_MISSING" 16497696 "DTC_MBB_20_MISSING" 16497697 "DTC_MBB_21_MISSING" 16497698 "DTC_MBB_22_MISSING" 16497699 "DTC_MBB_23_MISSING" 16497700 "DTC_MBB_24_MISSING" 16498177 "DTC_MBB_01_VFAULT" 16498178 "DTC_MBB_02_VFAULT" 16498179 "DTC_MBB_03_VFAULT" 16498180 "DTC_MBB_04_VFAULT" 16498181 "DTC_MBB_05_VFAULT" 16498182 "DTC_MBB_06_VFAULT" 16498183 "DTC_MBB_07_VFAULT" 16498184 "DTC_MBB_08_VFAULT" 16498185 "DTC_MBB_09_VFAULT" 16498192 "DTC_MBB_10_VFAULT" 16498193 "DTC_MBB_11_VFAULT" 16498194 "DTC_MBB_12_VFAULT" 16498195 "DTC_MBB_13_VFAULT" 16498196 "DTC_MBB_14_VFAULT" 16498197 "DTC_MBB_15_VFAULT" 16498198 "DTC_MBB_16_VFAULT" 16498199 "DTC_MBB_17_VFAULT" 16498200 "DTC_MBB_18_VFAULT" 16498201 "DTC_MBB_19_VFAULT" 16498208 "DTC_MBB_20_VFAULT" 16498209 "DTC_MBB_21_VFAULT" 16498210 "DTC_MBB_22_VFAULT" 16498211 "DTC_MBB_23_VFAULT" 16498212 "DTC_MBB_24_VFAULT" 16497921 "DTC_MBB_01_TFAULT" 16497922 "DTC_MBB_02_TFAULT" 16497923 "DTC_MBB_03_TFAULT" 16497924 "DTC_MBB_04_TFAULT" 16497925 "DTC_MBB_05_TFAULT" 16497926 "DTC_MBB_06_TFAULT" 16497927 "DTC_MBB_07_TFAULT" 16497928 "DTC_MBB_08_TFAULT" 16497929 "DTC_MBB_09_TFAULT" 16497936 "DTC_MBB_10_TFAULT" 16497937 "DTC_MBB_11_TFAULT" 16497938 "DTC_MBB_12_TFAULT" 16497939 "DTC_MBB_13_TFAULT" 16497940 "DTC_MBB_14_TFAULT" 16497941 "DTC_MBB_15_TFAULT" 16497942 "DTC_MBB_16_TFAULT" 16497943 "DTC_MBB_17_TFAULT" 16497944 "DTC_MBB_18_TFAULT" 16497945 "DTC_MBB_19_TFAULT" 16497952 "DTC_MBB_20_TFAULT" 16497953 "DTC_MBB_21_TFAULT" 16497954 "DTC_MBB_22_TFAULT" 16497955 "DTC_MBB_23_TFAULT" 16497956 "DTC_MBB_24_TFAULT" 15785984 "DTC_PRECHARGE_ENERGY" 15785985 "DTC_PRT_FAILED" 15785986 "DTC_PRT_OVERTEMP" 15785987 "DTC_PRT_PROHIBIT" 16556032 "DTC_COOLANT_TEMP_OOR_HI" 16556033 "DTC_COOLANT_TEMP_OOR_LO" 16252928 "DTC_KEY_OFF_TIME_ERROR" 16506880 "DTC_VBAT_MISMATCH" 16506881 "DTC_VBAT_VMAX" 16506882 "DTC_VBAT_VMIN" 16506883 "DTC_PACK_FUSE" 15798544 "DTC_LLS1_OOR_HI" 15798545 "DTC_LLS1_OOR_LO" 15798546 "DTC_LLS1_FAULT" 15798816 "DTC_LLS2_OOR_HI" 15798817 "DTC_LLS2_OOR_LO" 15798818 "DTC_LLS2_FAULT" 14479360 "DTC_CFL_HEARTBEAT" 14479361 "DTC_CFL_FAULT" 14479362 "DTC_CFL_FAULT_LATCH" 13635584 "DTC_CONT_A_FAILED_HI" 13635585 "DTC_CONT_A_FAILED_LO" 13635586 "DTC_CONT_B_FAILED_HI" 13635587 "DTC_CONT_B_FAILED_LO" 13635588 "DTC_CONT_C_FAILED_HI" 13635589 "DTC_CONT_C_FAILED_LO" 13635590 "DTC_CONT_D_FAILED_HI" 13635591 "DTC_CONT_D_FAILED_LO" 13635592 "DTC_CONT_E_FAILED_HI" 13635593 "DTC_CONT_E_FAILED_LO" 13635594 "DTC_CONT_F_FAILED_HI" 13635595 "DTC_CONT_F_FAILED_LO" 13635596 "DTC_CONT_G_FAILED_HI" 13635597 "DTC_CONT_G_FAILED_LO" 13635598 "DTC_LSD_A_FAILED_HI" 13635599 "DTC_LSD_A_FAILED_LO" 13635600 "DTC_LSD_B_FAILED_HI" 13635601 "DTC_LSD_B_FAILED_LO" 13635602 "DTC_LSD_C_FAILED_HI" 13635603 "DTC_LSD_C_FAILED_LO" 13635606 "DTC_CONT_PWR_FAILED_HI" 13635607 "DTC_CONT_PWR_FAILED_LO" 13635608 "DTC_LSD_PUMP_FAILED_HI" 13635609 "DTC_LSD_PUMP_FAILED_LO" 13635610 "DTC_CHG_A_ENABLE_FAILED_HI" 13635611 "DTC_CHG_A_ENABLE_FAILED_LO" 13635612 "DTC_CHG_B_ENABLE_FAILED_HI" 13635613 "DTC_CHG_B_ENABLE_FAILED_LO" 13635614 "DTC_SW14V_PWR_FAILED_HI" 13635615 "DTC_SW14V_PWR_FAILED_LO" 13635620 "DTC_HSD_A_FAILED_HI" 13635621 "DTC_HSD_A_FAILED_LO" 13635622 "DTC_HSD_B_FAILED_HI" 13635623 "DTC_HSD_B_FAILED_LO" 13692968 "DTC_CONT_HPWR_FAILED_HI" 13692969 "DTC_CONT_HPWR_FAILED_LO" 13692970 "DTC_CONT_HPWR_OOR_HI" 13692971 "DTC_CONT_HPWR_OOR_LO" 13635616 "DTC_5V_PWR_OOR_HI" 13635617 "DTC_5V_PWR_OOR_LO" 14606336 "DTC_NVM_WRITE_TO" 14606337 "DTC_NVM_READ_TO" 14614528 "DTC_SPI_DIG_POT_FAULT" ;
VAL_ 1120 bcm_dtc_058 0 " - " 11276288 "DTC_VEPO" 11276289 "DTC_HSC_MISSING" 11460608 "DTC_NVM_SOC" 11460609 "DTC_NVM_KOT" 11460610 "DTC_NVM_DTC" 11460611 "DTC_NVM_SOC_CORRECTION" 11460612 "DTC_NVM_APP_SCRATCHPAD" 11517962 "DTC_LOOPTIME_TASK_A" 11517963 "DTC_LOOPTIME_TASK_B" 11517964 "DTC_LOOPTIME_TASK_C" 11517965 "DTC_LOOPTIME_TASK_D" 11517966 "DTC_LOOPTIME_TASK_E" 11517967 "DTC_LOOPTIME_TASK_F" 11323904 "DTC_INTERLOCK_A_FAILED_LOW" 11323905 "DTC_INTERLOCK_A_FAILED_HIGH" 11324160 "DTC_INTERLOCK_B_FAILED_LOW" 11324161 "DTC_INTERLOCK_B_FAILED_HIGH" 15728640 "DTC_EPO" 16498688 "DTC_BRUSA_MISSING" 16498689 "DTC_BRUSA_IDC" 16498690 "DTC_BRUSA_REQ_VS_CMD" 16433152 "DTC_AKERWADE_MISSING" 16433153 "DTC_AKERWADE_IDC" 16433154 "DTC_AKERWADE_REQ_VS_CMD" 16564224 "DTC_CHGLEAR_MISSING" 16564225 "DTC_CHGLEAR_IDC" 16564226 "DTC_CHGLEAR_REQ_VS_CMD" 16522240 "DTC_CSM_MISSING" 16522752 "DTC_CSM_VBAT" 16522753 "DTC_CSM_VPOS" 16522754 "DTC_CSM_VNEG" 16522755 "DTC_CSM_CPOS" 16522756 "DTC_CSM_CNEG" 16522757 "DTC_CSM_APOS" 16522758 "DTC_CSM_ANEG" 16522759 "DTC_CSM_FUSE_HI" 16522760 "DTC_CSM_FUSE_LO" 16521728 "DTC_CSM_ASIC" 16521729 "DTC_CSM_AILO" 16521730 "DTC_CSM_AIHI" 16520957 "DTC_LEAKAGE_DETECT_FAULT" 16522444 "DTC_REALTIMECLOCK_FAULT" 16520945 "DTC_CSM_LEAK_FAIL_CALC" 16520946 "DTC_CSM_LEAK_FAIL_HW" 16520947 "DTC_CSM_LEAK_EXT_SHORT" 16520948 "DTC_CSM_LEAK_MID_PACK_SHORT" 16520949 "DTC_CSM_LEAK_ERROR" 16520950 "DTC_CSM_LEAK_UNKNOWN" 16523008 "DTC_CSM_VER_MISMATCH" 16523009 "DTC_CSM_DTC_SET" 16523010 "DTC_CSM_CAL_FAULT" 16560128 "DTC_IBAT_MISMATCH" 16576512 "DTC_DIS_MAX_I2T" 16576513 "DTC_CHG_MAX_I2T" 16576768 "DTC_DIS_WARNING_I2T" 16576769 "DTC_CHG_WARNING_I2T" 11296784 "DTC_SAEJ1772_PROX_DECT_OOR_HI" 11296785 "DTC_SAEJ1772_PROX_DECT_OOR_LO" 11296800 "DTC_SAEJ1772_PILOT_PWM_OOR_HI" 11296801 "DTC_SAEJ1772_PILOT_PWM_OOR_LO" 11296802 "DTC_SAEJ1772_PILOT_PWM_DIG_COMM" 11296803 "DTC_SAEJ1772_PILOT_PWM_IR_ERR" 16175360 "DTC_FGD1_NO_SENSOR" 16175361 "DTC_FGD1_OOR_HI" 16175362 "DTC_FGD1_OOR_LO" 16175363 "DTC_FGD1_FAULT" 16175616 "DTC_FGD2_NO_SENSOR" 16175617 "DTC_FGD2_OOR_HI" 16175618 "DTC_FGD2_OOR_LO" 16175619 "DTC_FGD2_FAULT" 16171008 "DTC_CONT_OPEN" 16171009 "DTC_CONT_CLOSE" 16171010 "DTC_CONT_OPEN_CURRENT" 16171264 "DTC_CONT_CLOSE_ON_RESET" 16171265 "DTC_CONT_CLOSE_SIG_FAILED" 16171520 "DTC_PRECHARGE_TIMEOUT" 16171777 "DTC_CONT_MPOS_WELD_AT_SU" 16171778 "DTC_CONT_MNEG_WELD_AT_SU" 16171780 "DTC_CONT_CPOS_WELD_AT_SU" 16171781 "DTC_CONT_CNEG_WELD_AT_SU" 16171782 "DTC_CONT_ANEG_WELD_AT_SU" 16171783 "DTC_CONT_APOS_WELD_AT_SU" 16172033 "DTC_CONT_MPOS_WELD_AT_SD" 16172034 "DTC_CONT_MNEG_WELD_AT_SD" 16172036 "DTC_CONT_CPOS_WELD_AT_SD" 16172037 "DTC_CONT_CNEG_WELD_AT_SD" 16172038 "DTC_CONT_ANEG_WELD_AT_SD" 16172039 "DTC_CONT_APOS_WELD_AT_SD" 16172289 "DTC_CONT_MPOS_OPEN" 16172290 "DTC_CONT_MNEG_OPEN" 16172291 "DTC_CONT_MPRE_OPEN" 16172292 "DTC_CONT_CPOS_OPEN" 16172293 "DTC_CONT_CNEG_OPEN" 16172294 "DTC_CONT_APOS_OPEN" 16172295 "DTC_CONT_ANEG_OPEN" 16172545 "DTC_CONT_MPOS_VDIF" 16172546 "DTC_CONT_MNEG_VDIF" 16172548 "DTC_CONT_CPOS_VDIF" 16172549 "DTC_CONT_CNEG_VDIF" 16172550 "DTC_CONT_APOS_VDIF" 16172551 "DTC_CONT_ANEG_VDIF" 16174848 "DTC_HVIL" 16174849 "DTC_LVBAT_LO" 16174850 "DTC_LVBAT_HI" 16174851 "DTC_LVBAT_ERR" 16523520 "DTC_LEMLO_OOR_HI" 16523521 "DTC_LEMLO_OOR_LO" 16523522 "DTC_LEMLO_FAULT" 16523776 "DTC_LEMHI_OOR_HI" 16523777 "DTC_LEMHI_OOR_LO" 16523778 "DTC_LEMHI_FAULT" 16496320 "DTC_MBB_TOO_FEW" 16496321 "DTC_MBB_TOO_MANY" 16496352 "DTC_CELL_VMAX_ERR" 16496353 "DTC_CELL_VMIN_ERR" 16496354 "DTC_CELL_VMAX" 16496362 "DTC_CELL_VMAX_SEVERE" 16496355 "DTC_CELL_VMIN" 16496363 "DTC_CELL_VMIN_SEVERE" 16496356 "DTC_MOD_VOLTAGE_COMPARE" 16496336 "DTC_CELL_T_ERR" 16496337 "DTC_CELL_TMAX1" 16496338 "DTC_CELL_TMAX2" 16496339 "DTC_CELL_TMIN" 16497665 "DTC_MBB_01_MISSING" 16497666 "DTC_MBB_02_MISSING" 16497667 "DTC_MBB_03_MISSING" 16497668 "DTC_MBB_04_MISSING" 16497669 "DTC_MBB_05_MISSING" 16497670 "DTC_MBB_06_MISSING" 16497671 "DTC_MBB_07_MISSING" 16497672 "DTC_MBB_08_MISSING" 16497673 "DTC_MBB_09_MISSING" 16497680 "DTC_MBB_10_MISSING" 16497681 "DTC_MBB_11_MISSING" 16497682 "DTC_MBB_12_MISSING" 16497683 "DTC_MBB_13_MISSING" 16497684 "DTC_MBB_14_MISSING" 16497685 "DTC_MBB_15_MISSING" 16497686 "DTC_MBB_16_MISSING" 16497687 "DTC_MBB_17_MISSING" 16497688 "DTC_MBB_18_MISSING" 16497689 "DTC_MBB_19_MISSING" 16497696 "DTC_MBB_20_MISSING" 16497697 "DTC_MBB_21_MISSING" 16497698 "DTC_MBB_22_MISSING" 16497699 "DTC_MBB_23_MISSING" 16497700 "DTC_MBB_24_MISSING" 16498177 "DTC_MBB_01_VFAULT" 16498178 "DTC_MBB_02_VFAULT" 16498179 "DTC_MBB_03_VFAULT" 16498180 "DTC_MBB_04_VFAULT" 16498181 "DTC_MBB_05_VFAULT" 16498182 "DTC_MBB_06_VFAULT" 16498183 "DTC_MBB_07_VFAULT" 16498184 "DTC_MBB_08_VFAULT" 16498185 "DTC_MBB_09_VFAULT" 16498192 "DTC_MBB_10_VFAULT" 16498193 "DTC_MBB_11_VFAULT" 16498194 "DTC_MBB_12_VFAULT" 16498195 "DTC_MBB_13_VFAULT" 16498196 "DTC_MBB_14_VFAULT" 16498197 "DTC_MBB_15_VFAULT" 16498198 "DTC_MBB_16_VFAULT" 16498199 "DTC_MBB_17_VFAULT" 16498200 "DTC_MBB_18_VFAULT" 16498201 "DTC_MBB_19_VFAULT" 16498208 "DTC_MBB_20_VFAULT" 16498209 "DTC_MBB_21_VFAULT" 16498210 "DTC_MBB_22_VFAULT" 16498211 "DTC_MBB_23_VFAULT" 16498212 "DTC_MBB_24_VFAULT" 16497921 "DTC_MBB_01_TFAULT" 16497922 "DTC_MBB_02_TFAULT" 16497923 "DTC_MBB_03_TFAULT" 16497924 "DTC_MBB_04_TFAULT" 16497925 "DTC_MBB_05_TFAULT" 16497926 "DTC_MBB_06_TFAULT" 16497927 "DTC_MBB_07_TFAULT" 16497928 "DTC_MBB_08_TFAULT" 16497929 "DTC_MBB_09_TFAULT" 16497936 "DTC_MBB_10_TFAULT" 16497937 "DTC_MBB_11_TFAULT" 16497938 "DTC_MBB_12_TFAULT" 16497939 "DTC_MBB_13_TFAULT" 16497940 "DTC_MBB_14_TFAULT" 16497941 "DTC_MBB_15_TFAULT" 16497942 "DTC_MBB_16_TFAULT" 16497943 "DTC_MBB_17_TFAULT" 16497944 "DTC_MBB_18_TFAULT" 16497945 "DTC_MBB_19_TFAULT" 16497952 "DTC_MBB_20_TFAULT" 16497953 "DTC_MBB_21_TFAULT" 16497954 "DTC_MBB_22_TFAULT" 16497955 "DTC_MBB_23_TFAULT" 16497956 "DTC_MBB_24_TFAULT" 15785984 "DTC_PRECHARGE_ENERGY" 15785985 "DTC_PRT_FAILED" 15785986 "DTC_PRT_OVERTEMP" 15785987 "DTC_PRT_PROHIBIT" 16556032 "DTC_COOLANT_TEMP_OOR_HI" 16556033 "DTC_COOLANT_TEMP_OOR_LO" 16252928 "DTC_KEY_OFF_TIME_ERROR" 16506880 "DTC_VBAT_MISMATCH" 16506881 "DTC_VBAT_VMAX" 16506882 "DTC_VBAT_VMIN" 16506883 "DTC_PACK_FUSE" 15798544 "DTC_LLS1_OOR_HI" 15798545 "DTC_LLS1_OOR_LO" 15798546 "DTC_LLS1_FAULT" 15798816 "DTC_LLS2_OOR_HI" 15798817 "DTC_LLS2_OOR_LO" 15798818 "DTC_LLS2_FAULT" 14479360 "DTC_CFL_HEARTBEAT" 14479361 "DTC_CFL_FAULT" 14479362 "DTC_CFL_FAULT_LATCH" 13635584 "DTC_CONT_A_FAILED_HI" 13635585 "DTC_CONT_A_FAILED_LO" 13635586 "DTC_CONT_B_FAILED_HI" 13635587 "DTC_CONT_B_FAILED_LO" 13635588 "DTC_CONT_C_FAILED_HI" 13635589 "DTC_CONT_C_FAILED_LO" 13635590 "DTC_CONT_D_FAILED_HI" 13635591 "DTC_CONT_D_FAILED_LO" 13635592 "DTC_CONT_E_FAILED_HI" 13635593 "DTC_CONT_E_FAILED_LO" 13635594 "DTC_CONT_F_FAILED_HI" 13635595 "DTC_CONT_F_FAILED_LO" 13635596 "DTC_CONT_G_FAILED_HI" 13635597 "DTC_CONT_G_FAILED_LO" 13635598 "DTC_LSD_A_FAILED_HI" 13635599 "DTC_LSD_A_FAILED_LO" 13635600 "DTC_LSD_B_FAILED_HI" 13635601 "DTC_LSD_B_FAILED_LO" 13635602 "DTC_LSD_C_FAILED_HI" 13635603 "DTC_LSD_C_FAILED_LO" 13635606 "DTC_CONT_PWR_FAILED_HI" 13635607 "DTC_CONT_PWR_FAILED_LO" 13635608 "DTC_LSD_PUMP_FAILED_HI" 13635609 "DTC_LSD_PUMP_FAILED_LO" 13635610 "DTC_CHG_A_ENABLE_FAILED_HI" 13635611 "DTC_CHG_A_ENABLE_FAILED_LO" 13635612 "DTC_CHG_B_ENABLE_FAILED_HI" 13635613 "DTC_CHG_B_ENABLE_FAILED_LO" 13635614 "DTC_SW14V_PWR_FAILED_HI" 13635615 "DTC_SW14V_PWR_FAILED_LO" 13635620 "DTC_HSD_A_FAILED_HI" 13635621 "DTC_HSD_A_FAILED_LO" 13635622 "DTC_HSD_B_FAILED_HI" 13635623 "DTC_HSD_B_FAILED_LO" 13692968 "DTC_CONT_HPWR_FAILED_HI" 13692969 "DTC_CONT_HPWR_FAILED_LO" 13692970 "DTC_CONT_HPWR_OOR_HI" 13692971 "DTC_CONT_HPWR_OOR_LO" 13635616 "DTC_5V_PWR_OOR_HI" 13635617 "DTC_5V_PWR_OOR_LO" 14606336 "DTC_NVM_WRITE_TO" 14606337 "DTC_NVM_READ_TO" 14614528 "DTC_SPI_DIG_POT_FAULT" ;
VAL_ 1120 bcm_dtc_059 0 " - " 11276288 "DTC_VEPO" 11276289 "DTC_HSC_MISSING" 11460608 "DTC_NVM_SOC" 11460609 "DTC_NVM_KOT" 11460610 "DTC_NVM_DTC" 11460611 "DTC_NVM_SOC_CORRECTION" 11460612 "DTC_NVM_APP_SCRATCHPAD" 11517962 "DTC_LOOPTIME_TASK_A" 11517963 "DTC_LOOPTIME_TASK_B" 11517964 "DTC_LOOPTIME_TASK_C" 11517965 "DTC_LOOPTIME_TASK_D" 11517966 "DTC_LOOPTIME_TASK_E" 11517967 "DTC_LOOPTIME_TASK_F" 11323904 "DTC_INTERLOCK_A_FAILED_LOW" 11323905 "DTC_INTERLOCK_A_FAILED_HIGH" 11324160 "DTC_INTERLOCK_B_FAILED_LOW" 11324161 "DTC_INTERLOCK_B_FAILED_HIGH" 15728640 "DTC_EPO" 16498688 "DTC_BRUSA_MISSING" 16498689 "DTC_BRUSA_IDC" 16498690 "DTC_BRUSA_REQ_VS_CMD" 16433152 "DTC_AKERWADE_MISSING" 16433153 "DTC_AKERWADE_IDC" 16433154 "DTC_AKERWADE_REQ_VS_CMD" 16564224 "DTC_CHGLEAR_MISSING" 16564225 "DTC_CHGLEAR_IDC" 16564226 "DTC_CHGLEAR_REQ_VS_CMD" 16522240 "DTC_CSM_MISSING" 16522752 "DTC_CSM_VBAT" 16522753 "DTC_CSM_VPOS" 16522754 "DTC_CSM_VNEG" 16522755 "DTC_CSM_CPOS" 16522756 "DTC_CSM_CNEG" 16522757 "DTC_CSM_APOS" 16522758 "DTC_CSM_ANEG" 16522759 "DTC_CSM_FUSE_HI" 16522760 "DTC_CSM_FUSE_LO" 16521728 "DTC_CSM_ASIC" 16521729 "DTC_CSM_AILO" 16521730 "DTC_CSM_AIHI" 16520957 "DTC_LEAKAGE_DETECT_FAULT" 16522444 "DTC_REALTIMECLOCK_FAULT" 16520945 "DTC_CSM_LEAK_FAIL_CALC" 16520946 "DTC_CSM_LEAK_FAIL_HW" 16520947 "DTC_CSM_LEAK_EXT_SHORT" 16520948 "DTC_CSM_LEAK_MID_PACK_SHORT" 16520949 "DTC_CSM_LEAK_ERROR" 16520950 "DTC_CSM_LEAK_UNKNOWN" 16523008 "DTC_CSM_VER_MISMATCH" 16523009 "DTC_CSM_DTC_SET" 16523010 "DTC_CSM_CAL_FAULT" 16560128 "DTC_IBAT_MISMATCH" 16576512 "DTC_DIS_MAX_I2T" 16576513 "DTC_CHG_MAX_I2T" 16576768 "DTC_DIS_WARNING_I2T" 16576769 "DTC_CHG_WARNING_I2T" 11296784 "DTC_SAEJ1772_PROX_DECT_OOR_HI" 11296785 "DTC_SAEJ1772_PROX_DECT_OOR_LO" 11296800 "DTC_SAEJ1772_PILOT_PWM_OOR_HI" 11296801 "DTC_SAEJ1772_PILOT_PWM_OOR_LO" 11296802 "DTC_SAEJ1772_PILOT_PWM_DIG_COMM" 11296803 "DTC_SAEJ1772_PILOT_PWM_IR_ERR" 16175360 "DTC_FGD1_NO_SENSOR" 16175361 "DTC_FGD1_OOR_HI" 16175362 "DTC_FGD1_OOR_LO" 16175363 "DTC_FGD1_FAULT" 16175616 "DTC_FGD2_NO_SENSOR" 16175617 "DTC_FGD2_OOR_HI" 16175618 "DTC_FGD2_OOR_LO" 16175619 "DTC_FGD2_FAULT" 16171008 "DTC_CONT_OPEN" 16171009 "DTC_CONT_CLOSE" 16171010 "DTC_CONT_OPEN_CURRENT" 16171264 "DTC_CONT_CLOSE_ON_RESET" 16171265 "DTC_CONT_CLOSE_SIG_FAILED" 16171520 "DTC_PRECHARGE_TIMEOUT" 16171777 "DTC_CONT_MPOS_WELD_AT_SU" 16171778 "DTC_CONT_MNEG_WELD_AT_SU" 16171780 "DTC_CONT_CPOS_WELD_AT_SU" 16171781 "DTC_CONT_CNEG_WELD_AT_SU" 16171782 "DTC_CONT_ANEG_WELD_AT_SU" 16171783 "DTC_CONT_APOS_WELD_AT_SU" 16172033 "DTC_CONT_MPOS_WELD_AT_SD" 16172034 "DTC_CONT_MNEG_WELD_AT_SD" 16172036 "DTC_CONT_CPOS_WELD_AT_SD" 16172037 "DTC_CONT_CNEG_WELD_AT_SD" 16172038 "DTC_CONT_ANEG_WELD_AT_SD" 16172039 "DTC_CONT_APOS_WELD_AT_SD" 16172289 "DTC_CONT_MPOS_OPEN" 16172290 "DTC_CONT_MNEG_OPEN" 16172291 "DTC_CONT_MPRE_OPEN" 16172292 "DTC_CONT_CPOS_OPEN" 16172293 "DTC_CONT_CNEG_OPEN" 16172294 "DTC_CONT_APOS_OPEN" 16172295 "DTC_CONT_ANEG_OPEN" 16172545 "DTC_CONT_MPOS_VDIF" 16172546 "DTC_CONT_MNEG_VDIF" 16172548 "DTC_CONT_CPOS_VDIF" 16172549 "DTC_CONT_CNEG_VDIF" 16172550 "DTC_CONT_APOS_VDIF" 16172551 "DTC_CONT_ANEG_VDIF" 16174848 "DTC_HVIL" 16174849 "DTC_LVBAT_LO" 16174850 "DTC_LVBAT_HI" 16174851 "DTC_LVBAT_ERR" 16523520 "DTC_LEMLO_OOR_HI" 16523521 "DTC_LEMLO_OOR_LO" 16523522 "DTC_LEMLO_FAULT" 16523776 "DTC_LEMHI_OOR_HI" 16523777 "DTC_LEMHI_OOR_LO" 16523778 "DTC_LEMHI_FAULT" 16496320 "DTC_MBB_TOO_FEW" 16496321 "DTC_MBB_TOO_MANY" 16496352 "DTC_CELL_VMAX_ERR" 16496353 "DTC_CELL_VMIN_ERR" 16496354 "DTC_CELL_VMAX" 16496362 "DTC_CELL_VMAX_SEVERE" 16496355 "DTC_CELL_VMIN" 16496363 "DTC_CELL_VMIN_SEVERE" 16496356 "DTC_MOD_VOLTAGE_COMPARE" 16496336 "DTC_CELL_T_ERR" 16496337 "DTC_CELL_TMAX1" 16496338 "DTC_CELL_TMAX2" 16496339 "DTC_CELL_TMIN" 16497665 "DTC_MBB_01_MISSING" 16497666 "DTC_MBB_02_MISSING" 16497667 "DTC_MBB_03_MISSING" 16497668 "DTC_MBB_04_MISSING" 16497669 "DTC_MBB_05_MISSING" 16497670 "DTC_MBB_06_MISSING" 16497671 "DTC_MBB_07_MISSING" 16497672 "DTC_MBB_08_MISSING" 16497673 "DTC_MBB_09_MISSING" 16497680 "DTC_MBB_10_MISSING" 16497681 "DTC_MBB_11_MISSING" 16497682 "DTC_MBB_12_MISSING" 16497683 "DTC_MBB_13_MISSING" 16497684 "DTC_MBB_14_MISSING" 16497685 "DTC_MBB_15_MISSING" 16497686 "DTC_MBB_16_MISSING" 16497687 "DTC_MBB_17_MISSING" 16497688 "DTC_MBB_18_MISSING" 16497689 "DTC_MBB_19_MISSING" 16497696 "DTC_MBB_20_MISSING" 16497697 "DTC_MBB_21_MISSING" 16497698 "DTC_MBB_22_MISSING" 16497699 "DTC_MBB_23_MISSING" 16497700 "DTC_MBB_24_MISSING" 16498177 "DTC_MBB_01_VFAULT" 16498178 "DTC_MBB_02_VFAULT" 16498179 "DTC_MBB_03_VFAULT" 16498180 "DTC_MBB_04_VFAULT" 16498181 "DTC_MBB_05_VFAULT" 16498182 "DTC_MBB_06_VFAULT" 16498183 "DTC_MBB_07_VFAULT" 16498184 "DTC_MBB_08_VFAULT" 16498185 "DTC_MBB_09_VFAULT" 16498192 "DTC_MBB_10_VFAULT" 16498193 "DTC_MBB_11_VFAULT" 16498194 "DTC_MBB_12_VFAULT" 16498195 "DTC_MBB_13_VFAULT" 16498196 "DTC_MBB_14_VFAULT" 16498197 "DTC_MBB_15_VFAULT" 16498198 "DTC_MBB_16_VFAULT" 16498199 "DTC_MBB_17_VFAULT" 16498200 "DTC_MBB_18_VFAULT" 16498201 "DTC_MBB_19_VFAULT" 16498208 "DTC_MBB_20_VFAULT" 16498209 "DTC_MBB_21_VFAULT" 16498210 "DTC_MBB_22_VFAULT" 16498211 "DTC_MBB_23_VFAULT" 16498212 "DTC_MBB_24_VFAULT" 16497921 "DTC_MBB_01_TFAULT" 16497922 "DTC_MBB_02_TFAULT" 16497923 "DTC_MBB_03_TFAULT" 16497924 "DTC_MBB_04_TFAULT" 16497925 "DTC_MBB_05_TFAULT" 16497926 "DTC_MBB_06_TFAULT" 16497927 "DTC_MBB_07_TFAULT" 16497928 "DTC_MBB_08_TFAULT" 16497929 "DTC_MBB_09_TFAULT" 16497936 "DTC_MBB_10_TFAULT" 16497937 "DTC_MBB_11_TFAULT" 16497938 "DTC_MBB_12_TFAULT" 16497939 "DTC_MBB_13_TFAULT" 16497940 "DTC_MBB_14_TFAULT" 16497941 "DTC_MBB_15_TFAULT" 16497942 "DTC_MBB_16_TFAULT" 16497943 "DTC_MBB_17_TFAULT" 16497944 "DTC_MBB_18_TFAULT" 16497945 "DTC_MBB_19_TFAULT" 16497952 "DTC_MBB_20_TFAULT" 16497953 "DTC_MBB_21_TFAULT" 16497954 "DTC_MBB_22_TFAULT" 16497955 "DTC_MBB_23_TFAULT" 16497956 "DTC_MBB_24_TFAULT" 15785984 "DTC_PRECHARGE_ENERGY" 15785985 "DTC_PRT_FAILED" 15785986 "DTC_PRT_OVERTEMP" 15785987 "DTC_PRT_PROHIBIT" 16556032 "DTC_COOLANT_TEMP_OOR_HI" 16556033 "DTC_COOLANT_TEMP_OOR_LO" 16252928 "DTC_KEY_OFF_TIME_ERROR" 16506880 "DTC_VBAT_MISMATCH" 16506881 "DTC_VBAT_VMAX" 16506882 "DTC_VBAT_VMIN" 16506883 "DTC_PACK_FUSE" 15798544 "DTC_LLS1_OOR_HI" 15798545 "DTC_LLS1_OOR_LO" 15798546 "DTC_LLS1_FAULT" 15798816 "DTC_LLS2_OOR_HI" 15798817 "DTC_LLS2_OOR_LO" 15798818 "DTC_LLS2_FAULT" 14479360 "DTC_CFL_HEARTBEAT" 14479361 "DTC_CFL_FAULT" 14479362 "DTC_CFL_FAULT_LATCH" 13635584 "DTC_CONT_A_FAILED_HI" 13635585 "DTC_CONT_A_FAILED_LO" 13635586 "DTC_CONT_B_FAILED_HI" 13635587 "DTC_CONT_B_FAILED_LO" 13635588 "DTC_CONT_C_FAILED_HI" 13635589 "DTC_CONT_C_FAILED_LO" 13635590 "DTC_CONT_D_FAILED_HI" 13635591 "DTC_CONT_D_FAILED_LO" 13635592 "DTC_CONT_E_FAILED_HI" 13635593 "DTC_CONT_E_FAILED_LO" 13635594 "DTC_CONT_F_FAILED_HI" 13635595 "DTC_CONT_F_FAILED_LO" 13635596 "DTC_CONT_G_FAILED_HI" 13635597 "DTC_CONT_G_FAILED_LO" 13635598 "DTC_LSD_A_FAILED_HI" 13635599 "DTC_LSD_A_FAILED_LO" 13635600 "DTC_LSD_B_FAILED_HI" 13635601 "DTC_LSD_B_FAILED_LO" 13635602 "DTC_LSD_C_FAILED_HI" 13635603 "DTC_LSD_C_FAILED_LO" 13635606 "DTC_CONT_PWR_FAILED_HI" 13635607 "DTC_CONT_PWR_FAILED_LO" 13635608 "DTC_LSD_PUMP_FAILED_HI" 13635609 "DTC_LSD_PUMP_FAILED_LO" 13635610 "DTC_CHG_A_ENABLE_FAILED_HI" 13635611 "DTC_CHG_A_ENABLE_FAILED_LO" 13635612 "DTC_CHG_B_ENABLE_FAILED_HI" 13635613 "DTC_CHG_B_ENABLE_FAILED_LO" 13635614 "DTC_SW14V_PWR_FAILED_HI" 13635615 "DTC_SW14V_PWR_FAILED_LO" 13635620 "DTC_HSD_A_FAILED_HI" 13635621 "DTC_HSD_A_FAILED_LO" 13635622 "DTC_HSD_B_FAILED_HI" 13635623 "DTC_HSD_B_FAILED_LO" 13692968 "DTC_CONT_HPWR_FAILED_HI" 13692969 "DTC_CONT_HPWR_FAILED_LO" 13692970 "DTC_CONT_HPWR_OOR_HI" 13692971 "DTC_CONT_HPWR_OOR_LO" 13635616 "DTC_5V_PWR_OOR_HI" 13635617 "DTC_5V_PWR_OOR_LO" 14606336 "DTC_NVM_WRITE_TO" 14606337 "DTC_NVM_READ_TO" 14614528 "DTC_SPI_DIG_POT_FAULT" ;
VAL_ 1120 bcm_dtc_060 0 " - " 11276288 "DTC_VEPO" 11276289 "DTC_HSC_MISSING" 11460608 "DTC_NVM_SOC" 11460609 "DTC_NVM_KOT" 11460610 "DTC_NVM_DTC" 11460611 "DTC_NVM_SOC_CORRECTION" 11460612 "DTC_NVM_APP_SCRATCHPAD" 11517962 "DTC_LOOPTIME_TASK_A" 11517963 "DTC_LOOPTIME_TASK_B" 11517964 "DTC_LOOPTIME_TASK_C" 11517965 "DTC_LOOPTIME_TASK_D" 11517966 "DTC_LOOPTIME_TASK_E" 11517967 "DTC_LOOPTIME_TASK_F" 11323904 "DTC_INTERLOCK_A_FAILED_LOW" 11323905 "DTC_INTERLOCK_A_FAILED_HIGH" 11324160 "DTC_INTERLOCK_B_FAILED_LOW" 11324161 "DTC_INTERLOCK_B_FAILED_HIGH" 15728640 "DTC_EPO" 16498688 "DTC_BRUSA_MISSING" 16498689 "DTC_BRUSA_IDC" 16498690 "DTC_BRUSA_REQ_VS_CMD" 16433152 "DTC_AKERWADE_MISSING" 16433153 "DTC_AKERWADE_IDC" 16433154 "DTC_AKERWADE_REQ_VS_CMD" 16564224 "DTC_CHGLEAR_MISSING" 16564225 "DTC_CHGLEAR_IDC" 16564226 "DTC_CHGLEAR_REQ_VS_CMD" 16522240 "DTC_CSM_MISSING" 16522752 "DTC_CSM_VBAT" 16522753 "DTC_CSM_VPOS" 16522754 "DTC_CSM_VNEG" 16522755 "DTC_CSM_CPOS" 16522756 "DTC_CSM_CNEG" 16522757 "DTC_CSM_APOS" 16522758 "DTC_CSM_ANEG" 16522759 "DTC_CSM_FUSE_HI" 16522760 "DTC_CSM_FUSE_LO" 16521728 "DTC_CSM_ASIC" 16521729 "DTC_CSM_AILO" 16521730 "DTC_CSM_AIHI" 16520957 "DTC_LEAKAGE_DETECT_FAULT" 16522444 "DTC_REALTIMECLOCK_FAULT" 16520945 "DTC_CSM_LEAK_FAIL_CALC" 16520946 "DTC_CSM_LEAK_FAIL_HW" 16520947 "DTC_CSM_LEAK_EXT_SHORT" 16520948 "DTC_CSM_LEAK_MID_PACK_SHORT" 16520949 "DTC_CSM_LEAK_ERROR" 16520950 "DTC_CSM_LEAK_UNKNOWN" 16523008 "DTC_CSM_VER_MISMATCH" 16523009 "DTC_CSM_DTC_SET" 16523010 "DTC_CSM_CAL_FAULT" 16560128 "DTC_IBAT_MISMATCH" 16576512 "DTC_DIS_MAX_I2T" 16576513 "DTC_CHG_MAX_I2T" 16576768 "DTC_DIS_WARNING_I2T" 16576769 "DTC_CHG_WARNING_I2T" 11296784 "DTC_SAEJ1772_PROX_DECT_OOR_HI" 11296785 "DTC_SAEJ1772_PROX_DECT_OOR_LO" 11296800 "DTC_SAEJ1772_PILOT_PWM_OOR_HI" 11296801 "DTC_SAEJ1772_PILOT_PWM_OOR_LO" 11296802 "DTC_SAEJ1772_PILOT_PWM_DIG_COMM" 11296803 "DTC_SAEJ1772_PILOT_PWM_IR_ERR" 16175360 "DTC_FGD1_NO_SENSOR" 16175361 "DTC_FGD1_OOR_HI" 16175362 "DTC_FGD1_OOR_LO" 16175363 "DTC_FGD1_FAULT" 16175616 "DTC_FGD2_NO_SENSOR" 16175617 "DTC_FGD2_OOR_HI" 16175618 "DTC_FGD2_OOR_LO" 16175619 "DTC_FGD2_FAULT" 16171008 "DTC_CONT_OPEN" 16171009 "DTC_CONT_CLOSE" 16171010 "DTC_CONT_OPEN_CURRENT" 16171264 "DTC_CONT_CLOSE_ON_RESET" 16171265 "DTC_CONT_CLOSE_SIG_FAILED" 16171520 "DTC_PRECHARGE_TIMEOUT" 16171777 "DTC_CONT_MPOS_WELD_AT_SU" 16171778 "DTC_CONT_MNEG_WELD_AT_SU" 16171780 "DTC_CONT_CPOS_WELD_AT_SU" 16171781 "DTC_CONT_CNEG_WELD_AT_SU" 16171782 "DTC_CONT_ANEG_WELD_AT_SU" 16171783 "DTC_CONT_APOS_WELD_AT_SU" 16172033 "DTC_CONT_MPOS_WELD_AT_SD" 16172034 "DTC_CONT_MNEG_WELD_AT_SD" 16172036 "DTC_CONT_CPOS_WELD_AT_SD" 16172037 "DTC_CONT_CNEG_WELD_AT_SD" 16172038 "DTC_CONT_ANEG_WELD_AT_SD" 16172039 "DTC_CONT_APOS_WELD_AT_SD" 16172289 "DTC_CONT_MPOS_OPEN" 16172290 "DTC_CONT_MNEG_OPEN" 16172291 "DTC_CONT_MPRE_OPEN" 16172292 "DTC_CONT_CPOS_OPEN" 16172293 "DTC_CONT_CNEG_OPEN" 16172294 "DTC_CONT_APOS_OPEN" 16172295 "DTC_CONT_ANEG_OPEN" 16172545 "DTC_CONT_MPOS_VDIF" 16172546 "DTC_CONT_MNEG_VDIF" 16172548 "DTC_CONT_CPOS_VDIF" 16172549 "DTC_CONT_CNEG_VDIF" 16172550 "DTC_CONT_APOS_VDIF" 16172551 "DTC_CONT_ANEG_VDIF" 16174848 "DTC_HVIL" 16174849 "DTC_LVBAT_LO" 16174850 "DTC_LVBAT_HI" 16174851 "DTC_LVBAT_ERR" 16523520 "DTC_LEMLO_OOR_HI" 16523521 "DTC_LEMLO_OOR_LO" 16523522 "DTC_LEMLO_FAULT" 16523776 "DTC_LEMHI_OOR_HI" 16523777 "DTC_LEMHI_OOR_LO" 16523778 "DTC_LEMHI_FAULT" 16496320 "DTC_MBB_TOO_FEW" 16496321 "DTC_MBB_TOO_MANY" 16496352 "DTC_CELL_VMAX_ERR" 16496353 "DTC_CELL_VMIN_ERR" 16496354 "DTC_CELL_VMAX" 16496362 "DTC_CELL_VMAX_SEVERE" 16496355 "DTC_CELL_VMIN" 16496363 "DTC_CELL_VMIN_SEVERE" 16496356 "DTC_MOD_VOLTAGE_COMPARE" 16496336 "DTC_CELL_T_ERR" 16496337 "DTC_CELL_TMAX1" 16496338 "DTC_CELL_TMAX2" 16496339 "DTC_CELL_TMIN" 16497665 "DTC_MBB_01_MISSING" 16497666 "DTC_MBB_02_MISSING" 16497667 "DTC_MBB_03_MISSING" 16497668 "DTC_MBB_04_MISSING" 16497669 "DTC_MBB_05_MISSING" 16497670 "DTC_MBB_06_MISSING" 16497671 "DTC_MBB_07_MISSING" 16497672 "DTC_MBB_08_MISSING" 16497673 "DTC_MBB_09_MISSING" 16497680 "DTC_MBB_10_MISSING" 16497681 "DTC_MBB_11_MISSING" 16497682 "DTC_MBB_12_MISSING" 16497683 "DTC_MBB_13_MISSING" 16497684 "DTC_MBB_14_MISSING" 16497685 "DTC_MBB_15_MISSING" 16497686 "DTC_MBB_16_MISSING" 16497687 "DTC_MBB_17_MISSING" 16497688 "DTC_MBB_18_MISSING" 16497689 "DTC_MBB_19_MISSING" 16497696 "DTC_MBB_20_MISSING" 16497697 "DTC_MBB_21_MISSING" 16497698 "DTC_MBB_22_MISSING" 16497699 "DTC_MBB_23_MISSING" 16497700 "DTC_MBB_24_MISSING" 16498177 "DTC_MBB_01_VFAULT" 16498178 "DTC_MBB_02_VFAULT" 16498179 "DTC_MBB_03_VFAULT" 16498180 "DTC_MBB_04_VFAULT" 16498181 "DTC_MBB_05_VFAULT" 16498182 "DTC_MBB_06_VFAULT" 16498183 "DTC_MBB_07_VFAULT" 16498184 "DTC_MBB_08_VFAULT" 16498185 "DTC_MBB_09_VFAULT" 16498192 "DTC_MBB_10_VFAULT" 16498193 "DTC_MBB_11_VFAULT" 16498194 "DTC_MBB_12_VFAULT" 16498195 "DTC_MBB_13_VFAULT" 16498196 "DTC_MBB_14_VFAULT" 16498197 "DTC_MBB_15_VFAULT" 16498198 "DTC_MBB_16_VFAULT" 16498199 "DTC_MBB_17_VFAULT" 16498200 "DTC_MBB_18_VFAULT" 16498201 "DTC_MBB_19_VFAULT" 16498208 "DTC_MBB_20_VFAULT" 16498209 "DTC_MBB_21_VFAULT" 16498210 "DTC_MBB_22_VFAULT" 16498211 "DTC_MBB_23_VFAULT" 16498212 "DTC_MBB_24_VFAULT" 16497921 "DTC_MBB_01_TFAULT" 16497922 "DTC_MBB_02_TFAULT" 16497923 "DTC_MBB_03_TFAULT" 16497924 "DTC_MBB_04_TFAULT" 16497925 "DTC_MBB_05_TFAULT" 16497926 "DTC_MBB_06_TFAULT" 16497927 "DTC_MBB_07_TFAULT" 16497928 "DTC_MBB_08_TFAULT" 16497929 "DTC_MBB_09_TFAULT" 16497936 "DTC_MBB_10_TFAULT" 16497937 "DTC_MBB_11_TFAULT" 16497938 "DTC_MBB_12_TFAULT" 16497939 "DTC_MBB_13_TFAULT" 16497940 "DTC_MBB_14_TFAULT" 16497941 "DTC_MBB_15_TFAULT" 16497942 "DTC_MBB_16_TFAULT" 16497943 "DTC_MBB_17_TFAULT" 16497944 "DTC_MBB_18_TFAULT" 16497945 "DTC_MBB_19_TFAULT" 16497952 "DTC_MBB_20_TFAULT" 16497953 "DTC_MBB_21_TFAULT" 16497954 "DTC_MBB_22_TFAULT" 16497955 "DTC_MBB_23_TFAULT" 16497956 "DTC_MBB_24_TFAULT" 15785984 "DTC_PRECHARGE_ENERGY" 15785985 "DTC_PRT_FAILED" 15785986 "DTC_PRT_OVERTEMP" 15785987 "DTC_PRT_PROHIBIT" 16556032 "DTC_COOLANT_TEMP_OOR_HI" 16556033 "DTC_COOLANT_TEMP_OOR_LO" 16252928 "DTC_KEY_OFF_TIME_ERROR" 16506880 "DTC_VBAT_MISMATCH" 16506881 "DTC_VBAT_VMAX" 16506882 "DTC_VBAT_VMIN" 16506883 "DTC_PACK_FUSE" 15798544 "DTC_LLS1_OOR_HI" 15798545 "DTC_LLS1_OOR_LO" 15798546 "DTC_LLS1_FAULT" 15798816 "DTC_LLS2_OOR_HI" 15798817 "DTC_LLS2_OOR_LO" 15798818 "DTC_LLS2_FAULT" 14479360 "DTC_CFL_HEARTBEAT" 14479361 "DTC_CFL_FAULT" 14479362 "DTC_CFL_FAULT_LATCH" 13635584 "DTC_CONT_A_FAILED_HI" 13635585 "DTC_CONT_A_FAILED_LO" 13635586 "DTC_CONT_B_FAILED_HI" 13635587 "DTC_CONT_B_FAILED_LO" 13635588 "DTC_CONT_C_FAILED_HI" 13635589 "DTC_CONT_C_FAILED_LO" 13635590 "DTC_CONT_D_FAILED_HI" 13635591 "DTC_CONT_D_FAILED_LO" 13635592 "DTC_CONT_E_FAILED_HI" 13635593 "DTC_CONT_E_FAILED_LO" 13635594 "DTC_CONT_F_FAILED_HI" 13635595 "DTC_CONT_F_FAILED_LO" 13635596 "DTC_CONT_G_FAILED_HI" 13635597 "DTC_CONT_G_FAILED_LO" 13635598 "DTC_LSD_A_FAILED_HI" 13635599 "DTC_LSD_A_FAILED_LO" 13635600 "DTC_LSD_B_FAILED_HI" 13635601 "DTC_LSD_B_FAILED_LO" 13635602 "DTC_LSD_C_FAILED_HI" 13635603 "DTC_LSD_C_FAILED_LO" 13635606 "DTC_CONT_PWR_FAILED_HI" 13635607 "DTC_CONT_PWR_FAILED_LO" 13635608 "DTC_LSD_PUMP_FAILED_HI" 13635609 "DTC_LSD_PUMP_FAILED_LO" 13635610 "DTC_CHG_A_ENABLE_FAILED_HI" 13635611 "DTC_CHG_A_ENABLE_FAILED_LO" 13635612 "DTC_CHG_B_ENABLE_FAILED_HI" 13635613 "DTC_CHG_B_ENABLE_FAILED_LO" 13635614 "DTC_SW14V_PWR_FAILED_HI" 13635615 "DTC_SW14V_PWR_FAILED_LO" 13635620 "DTC_HSD_A_FAILED_HI" 13635621 "DTC_HSD_A_FAILED_LO" 13635622 "DTC_HSD_B_FAILED_HI" 13635623 "DTC_HSD_B_FAILED_LO" 13692968 "DTC_CONT_HPWR_FAILED_HI" 13692969 "DTC_CONT_HPWR_FAILED_LO" 13692970 "DTC_CONT_HPWR_OOR_HI" 13692971 "DTC_CONT_HPWR_OOR_LO" 13635616 "DTC_5V_PWR_OOR_HI" 13635617 "DTC_5V_PWR_OOR_LO" 14606336 "DTC_NVM_WRITE_TO" 14606337 "DTC_NVM_READ_TO" 14614528 "DTC_SPI_DIG_POT_FAULT" ;
VAL_ 1120 bcm_dtc_061 0 " - " 11276288 "DTC_VEPO" 11276289 "DTC_HSC_MISSING" 11460608 "DTC_NVM_SOC" 11460609 "DTC_NVM_KOT" 11460610 "DTC_NVM_DTC" 11460611 "DTC_NVM_SOC_CORRECTION" 11460612 "DTC_NVM_APP_SCRATCHPAD" 11517962 "DTC_LOOPTIME_TASK_A" 11517963 "DTC_LOOPTIME_TASK_B" 11517964 "DTC_LOOPTIME_TASK_C" 11517965 "DTC_LOOPTIME_TASK_D" 11517966 "DTC_LOOPTIME_TASK_E" 11517967 "DTC_LOOPTIME_TASK_F" 11323904 "DTC_INTERLOCK_A_FAILED_LOW" 11323905 "DTC_INTERLOCK_A_FAILED_HIGH" 11324160 "DTC_INTERLOCK_B_FAILED_LOW" 11324161 "DTC_INTERLOCK_B_FAILED_HIGH" 15728640 "DTC_EPO" 16498688 "DTC_BRUSA_MISSING" 16498689 "DTC_BRUSA_IDC" 16498690 "DTC_BRUSA_REQ_VS_CMD" 16433152 "DTC_AKERWADE_MISSING" 16433153 "DTC_AKERWADE_IDC" 16433154 "DTC_AKERWADE_REQ_VS_CMD" 16564224 "DTC_CHGLEAR_MISSING" 16564225 "DTC_CHGLEAR_IDC" 16564226 "DTC_CHGLEAR_REQ_VS_CMD" 16522240 "DTC_CSM_MISSING" 16522752 "DTC_CSM_VBAT" 16522753 "DTC_CSM_VPOS" 16522754 "DTC_CSM_VNEG" 16522755 "DTC_CSM_CPOS" 16522756 "DTC_CSM_CNEG" 16522757 "DTC_CSM_APOS" 16522758 "DTC_CSM_ANEG" 16522759 "DTC_CSM_FUSE_HI" 16522760 "DTC_CSM_FUSE_LO" 16521728 "DTC_CSM_ASIC" 16521729 "DTC_CSM_AILO" 16521730 "DTC_CSM_AIHI" 16520957 "DTC_LEAKAGE_DETECT_FAULT" 16522444 "DTC_REALTIMECLOCK_FAULT" 16520945 "DTC_CSM_LEAK_FAIL_CALC" 16520946 "DTC_CSM_LEAK_FAIL_HW" 16520947 "DTC_CSM_LEAK_EXT_SHORT" 16520948 "DTC_CSM_LEAK_MID_PACK_SHORT" 16520949 "DTC_CSM_LEAK_ERROR" 16520950 "DTC_CSM_LEAK_UNKNOWN" 16523008 "DTC_CSM_VER_MISMATCH" 16523009 "DTC_CSM_DTC_SET" 16523010 "DTC_CSM_CAL_FAULT" 16560128 "DTC_IBAT_MISMATCH" 16576512 "DTC_DIS_MAX_I2T" 16576513 "DTC_CHG_MAX_I2T" 16576768 "DTC_DIS_WARNING_I2T" 16576769 "DTC_CHG_WARNING_I2T" 11296784 "DTC_SAEJ1772_PROX_DECT_OOR_HI" 11296785 "DTC_SAEJ1772_PROX_DECT_OOR_LO" 11296800 "DTC_SAEJ1772_PILOT_PWM_OOR_HI" 11296801 "DTC_SAEJ1772_PILOT_PWM_OOR_LO" 11296802 "DTC_SAEJ1772_PILOT_PWM_DIG_COMM" 11296803 "DTC_SAEJ1772_PILOT_PWM_IR_ERR" 16175360 "DTC_FGD1_NO_SENSOR" 16175361 "DTC_FGD1_OOR_HI" 16175362 "DTC_FGD1_OOR_LO" 16175363 "DTC_FGD1_FAULT" 16175616 "DTC_FGD2_NO_SENSOR" 16175617 "DTC_FGD2_OOR_HI" 16175618 "DTC_FGD2_OOR_LO" 16175619 "DTC_FGD2_FAULT" 16171008 "DTC_CONT_OPEN" 16171009 "DTC_CONT_CLOSE" 16171010 "DTC_CONT_OPEN_CURRENT" 16171264 "DTC_CONT_CLOSE_ON_RESET" 16171265 "DTC_CONT_CLOSE_SIG_FAILED" 16171520 "DTC_PRECHARGE_TIMEOUT" 16171777 "DTC_CONT_MPOS_WELD_AT_SU" 16171778 "DTC_CONT_MNEG_WELD_AT_SU" 16171780 "DTC_CONT_CPOS_WELD_AT_SU" 16171781 "DTC_CONT_CNEG_WELD_AT_SU" 16171782 "DTC_CONT_ANEG_WELD_AT_SU" 16171783 "DTC_CONT_APOS_WELD_AT_SU" 16172033 "DTC_CONT_MPOS_WELD_AT_SD" 16172034 "DTC_CONT_MNEG_WELD_AT_SD" 16172036 "DTC_CONT_CPOS_WELD_AT_SD" 16172037 "DTC_CONT_CNEG_WELD_AT_SD" 16172038 "DTC_CONT_ANEG_WELD_AT_SD" 16172039 "DTC_CONT_APOS_WELD_AT_SD" 16172289 "DTC_CONT_MPOS_OPEN" 16172290 "DTC_CONT_MNEG_OPEN" 16172291 "DTC_CONT_MPRE_OPEN" 16172292 "DTC_CONT_CPOS_OPEN" 16172293 "DTC_CONT_CNEG_OPEN" 16172294 "DTC_CONT_APOS_OPEN" 16172295 "DTC_CONT_ANEG_OPEN" 16172545 "DTC_CONT_MPOS_VDIF" 16172546 "DTC_CONT_MNEG_VDIF" 16172548 "DTC_CONT_CPOS_VDIF" 16172549 "DTC_CONT_CNEG_VDIF" 16172550 "DTC_CONT_APOS_VDIF" 16172551 "DTC_CONT_ANEG_VDIF" 16174848 "DTC_HVIL" 16174849 "DTC_LVBAT_LO" 16174850 "DTC_LVBAT_HI" 16174851 "DTC_LVBAT_ERR" 16523520 "DTC_LEMLO_OOR_HI" 16523521 "DTC_LEMLO_OOR_LO" 16523522 "DTC_LEMLO_FAULT" 16523776 "DTC_LEMHI_OOR_HI" 16523777 "DTC_LEMHI_OOR_LO" 16523778 "DTC_LEMHI_FAULT" 16496320 "DTC_MBB_TOO_FEW" 16496321 "DTC_MBB_TOO_MANY" 16496352 "DTC_CELL_VMAX_ERR" 16496353 "DTC_CELL_VMIN_ERR" 16496354 "DTC_CELL_VMAX" 16496362 "DTC_CELL_VMAX_SEVERE" 16496355 "DTC_CELL_VMIN" 16496363 "DTC_CELL_VMIN_SEVERE" 16496356 "DTC_MOD_VOLTAGE_COMPARE" 16496336 "DTC_CELL_T_ERR" 16496337 "DTC_CELL_TMAX1" 16496338 "DTC_CELL_TMAX2" 16496339 "DTC_CELL_TMIN" 16497665 "DTC_MBB_01_MISSING" 16497666 "DTC_MBB_02_MISSING" 16497667 "DTC_MBB_03_MISSING" 16497668 "DTC_MBB_04_MISSING" 16497669 "DTC_MBB_05_MISSING" 16497670 "DTC_MBB_06_MISSING" 16497671 "DTC_MBB_07_MISSING" 16497672 "DTC_MBB_08_MISSING" 16497673 "DTC_MBB_09_MISSING" 16497680 "DTC_MBB_10_MISSING" 16497681 "DTC_MBB_11_MISSING" 16497682 "DTC_MBB_12_MISSING" 16497683 "DTC_MBB_13_MISSING" 16497684 "DTC_MBB_14_MISSING" 16497685 "DTC_MBB_15_MISSING" 16497686 "DTC_MBB_16_MISSING" 16497687 "DTC_MBB_17_MISSING" 16497688 "DTC_MBB_18_MISSING" 16497689 "DTC_MBB_19_MISSING" 16497696 "DTC_MBB_20_MISSING" 16497697 "DTC_MBB_21_MISSING" 16497698 "DTC_MBB_22_MISSING" 16497699 "DTC_MBB_23_MISSING" 16497700 "DTC_MBB_24_MISSING" 16498177 "DTC_MBB_01_VFAULT" 16498178 "DTC_MBB_02_VFAULT" 16498179 "DTC_MBB_03_VFAULT" 16498180 "DTC_MBB_04_VFAULT" 16498181 "DTC_MBB_05_VFAULT" 16498182 "DTC_MBB_06_VFAULT" 16498183 "DTC_MBB_07_VFAULT" 16498184 "DTC_MBB_08_VFAULT" 16498185 "DTC_MBB_09_VFAULT" 16498192 "DTC_MBB_10_VFAULT" 16498193 "DTC_MBB_11_VFAULT" 16498194 "DTC_MBB_12_VFAULT" 16498195 "DTC_MBB_13_VFAULT" 16498196 "DTC_MBB_14_VFAULT" 16498197 "DTC_MBB_15_VFAULT" 16498198 "DTC_MBB_16_VFAULT" 16498199 "DTC_MBB_17_VFAULT" 16498200 "DTC_MBB_18_VFAULT" 16498201 "DTC_MBB_19_VFAULT" 16498208 "DTC_MBB_20_VFAULT" 16498209 "DTC_MBB_21_VFAULT" 16498210 "DTC_MBB_22_VFAULT" 16498211 "DTC_MBB_23_VFAULT" 16498212 "DTC_MBB_24_VFAULT" 16497921 "DTC_MBB_01_TFAULT" 16497922 "DTC_MBB_02_TFAULT" 16497923 "DTC_MBB_03_TFAULT" 16497924 "DTC_MBB_04_TFAULT" 16497925 "DTC_MBB_05_TFAULT" 16497926 "DTC_MBB_06_TFAULT" 16497927 "DTC_MBB_07_TFAULT" 16497928 "DTC_MBB_08_TFAULT" 16497929 "DTC_MBB_09_TFAULT" 16497936 "DTC_MBB_10_TFAULT" 16497937 "DTC_MBB_11_TFAULT" 16497938 "DTC_MBB_12_TFAULT" 16497939 "DTC_MBB_13_TFAULT" 16497940 "DTC_MBB_14_TFAULT" 16497941 "DTC_MBB_15_TFAULT" 16497942 "DTC_MBB_16_TFAULT" 16497943 "DTC_MBB_17_TFAULT" 16497944 "DTC_MBB_18_TFAULT" 16497945 "DTC_MBB_19_TFAULT" 16497952 "DTC_MBB_20_TFAULT" 16497953 "DTC_MBB_21_TFAULT" 16497954 "DTC_MBB_22_TFAULT" 16497955 "DTC_MBB_23_TFAULT" 16497956 "DTC_MBB_24_TFAULT" 15785984 "DTC_PRECHARGE_ENERGY" 15785985 "DTC_PRT_FAILED" 15785986 "DTC_PRT_OVERTEMP" 15785987 "DTC_PRT_PROHIBIT" 16556032 "DTC_COOLANT_TEMP_OOR_HI" 16556033 "DTC_COOLANT_TEMP_OOR_LO" 16252928 "DTC_KEY_OFF_TIME_ERROR" 16506880 "DTC_VBAT_MISMATCH" 16506881 "DTC_VBAT_VMAX" 16506882 "DTC_VBAT_VMIN" 16506883 "DTC_PACK_FUSE" 15798544 "DTC_LLS1_OOR_HI" 15798545 "DTC_LLS1_OOR_LO" 15798546 "DTC_LLS1_FAULT" 15798816 "DTC_LLS2_OOR_HI" 15798817 "DTC_LLS2_OOR_LO" 15798818 "DTC_LLS2_FAULT" 14479360 "DTC_CFL_HEARTBEAT" 14479361 "DTC_CFL_FAULT" 14479362 "DTC_CFL_FAULT_LATCH" 13635584 "DTC_CONT_A_FAILED_HI" 13635585 "DTC_CONT_A_FAILED_LO" 13635586 "DTC_CONT_B_FAILED_HI" 13635587 "DTC_CONT_B_FAILED_LO" 13635588 "DTC_CONT_C_FAILED_HI" 13635589 "DTC_CONT_C_FAILED_LO" 13635590 "DTC_CONT_D_FAILED_HI" 13635591 "DTC_CONT_D_FAILED_LO" 13635592 "DTC_CONT_E_FAILED_HI" 13635593 "DTC_CONT_E_FAILED_LO" 13635594 "DTC_CONT_F_FAILED_HI" 13635595 "DTC_CONT_F_FAILED_LO" 13635596 "DTC_CONT_G_FAILED_HI" 13635597 "DTC_CONT_G_FAILED_LO" 13635598 "DTC_LSD_A_FAILED_HI" 13635599 "DTC_LSD_A_FAILED_LO" 13635600 "DTC_LSD_B_FAILED_HI" 13635601 "DTC_LSD_B_FAILED_LO" 13635602 "DTC_LSD_C_FAILED_HI" 13635603 "DTC_LSD_C_FAILED_LO" 13635606 "DTC_CONT_PWR_FAILED_HI" 13635607 "DTC_CONT_PWR_FAILED_LO" 13635608 "DTC_LSD_PUMP_FAILED_HI" 13635609 "DTC_LSD_PUMP_FAILED_LO" 13635610 "DTC_CHG_A_ENABLE_FAILED_HI" 13635611 "DTC_CHG_A_ENABLE_FAILED_LO" 13635612 "DTC_CHG_B_ENABLE_FAILED_HI" 13635613 "DTC_CHG_B_ENABLE_FAILED_LO" 13635614 "DTC_SW14V_PWR_FAILED_HI" 13635615 "DTC_SW14V_PWR_FAILED_LO" 13635620 "DTC_HSD_A_FAILED_HI" 13635621 "DTC_HSD_A_FAILED_LO" 13635622 "DTC_HSD_B_FAILED_HI" 13635623 "DTC_HSD_B_FAILED_LO" 13692968 "DTC_CONT_HPWR_FAILED_HI" 13692969 "DTC_CONT_HPWR_FAILED_LO" 13692970 "DTC_CONT_HPWR_OOR_HI" 13692971 "DTC_CONT_HPWR_OOR_LO" 13635616 "DTC_5V_PWR_OOR_HI" 13635617 "DTC_5V_PWR_OOR_LO" 14606336 "DTC_NVM_WRITE_TO" 14606337 "DTC_NVM_READ_TO" 14614528 "DTC_SPI_DIG_POT_FAULT" ;
VAL_ 1120 bcm_dtc_062 0 " - " 11276288 "DTC_VEPO" 11276289 "DTC_HSC_MISSING" 11460608 "DTC_NVM_SOC" 11460609 "DTC_NVM_KOT" 11460610 "DTC_NVM_DTC" 11460611 "DTC_NVM_SOC_CORRECTION" 11460612 "DTC_NVM_APP_SCRATCHPAD" 11517962 "DTC_LOOPTIME_TASK_A" 11517963 "DTC_LOOPTIME_TASK_B" 11517964 "DTC_LOOPTIME_TASK_C" 11517965 "DTC_LOOPTIME_TASK_D" 11517966 "DTC_LOOPTIME_TASK_E" 11517967 "DTC_LOOPTIME_TASK_F" 11323904 "DTC_INTERLOCK_A_FAILED_LOW" 11323905 "DTC_INTERLOCK_A_FAILED_HIGH" 11324160 "DTC_INTERLOCK_B_FAILED_LOW" 11324161 "DTC_INTERLOCK_B_FAILED_HIGH" 15728640 "DTC_EPO" 16498688 "DTC_BRUSA_MISSING" 16498689 "DTC_BRUSA_IDC" 16498690 "DTC_BRUSA_REQ_VS_CMD" 16433152 "DTC_AKERWADE_MISSING" 16433153 "DTC_AKERWADE_IDC" 16433154 "DTC_AKERWADE_REQ_VS_CMD" 16564224 "DTC_CHGLEAR_MISSING" 16564225 "DTC_CHGLEAR_IDC" 16564226 "DTC_CHGLEAR_REQ_VS_CMD" 16522240 "DTC_CSM_MISSING" 16522752 "DTC_CSM_VBAT" 16522753 "DTC_CSM_VPOS" 16522754 "DTC_CSM_VNEG" 16522755 "DTC_CSM_CPOS" 16522756 "DTC_CSM_CNEG" 16522757 "DTC_CSM_APOS" 16522758 "DTC_CSM_ANEG" 16522759 "DTC_CSM_FUSE_HI" 16522760 "DTC_CSM_FUSE_LO" 16521728 "DTC_CSM_ASIC" 16521729 "DTC_CSM_AILO" 16521730 "DTC_CSM_AIHI" 16520957 "DTC_LEAKAGE_DETECT_FAULT" 16522444 "DTC_REALTIMECLOCK_FAULT" 16520945 "DTC_CSM_LEAK_FAIL_CALC" 16520946 "DTC_CSM_LEAK_FAIL_HW" 16520947 "DTC_CSM_LEAK_EXT_SHORT" 16520948 "DTC_CSM_LEAK_MID_PACK_SHORT" 16520949 "DTC_CSM_LEAK_ERROR" 16520950 "DTC_CSM_LEAK_UNKNOWN" 16523008 "DTC_CSM_VER_MISMATCH" 16523009 "DTC_CSM_DTC_SET" 16523010 "DTC_CSM_CAL_FAULT" 16560128 "DTC_IBAT_MISMATCH" 16576512 "DTC_DIS_MAX_I2T" 16576513 "DTC_CHG_MAX_I2T" 16576768 "DTC_DIS_WARNING_I2T" 16576769 "DTC_CHG_WARNING_I2T" 11296784 "DTC_SAEJ1772_PROX_DECT_OOR_HI" 11296785 "DTC_SAEJ1772_PROX_DECT_OOR_LO" 11296800 "DTC_SAEJ1772_PILOT_PWM_OOR_HI" 11296801 "DTC_SAEJ1772_PILOT_PWM_OOR_LO" 11296802 "DTC_SAEJ1772_PILOT_PWM_DIG_COMM" 11296803 "DTC_SAEJ1772_PILOT_PWM_IR_ERR" 16175360 "DTC_FGD1_NO_SENSOR" 16175361 "DTC_FGD1_OOR_HI" 16175362 "DTC_FGD1_OOR_LO" 16175363 "DTC_FGD1_FAULT" 16175616 "DTC_FGD2_NO_SENSOR" 16175617 "DTC_FGD2_OOR_HI" 16175618 "DTC_FGD2_OOR_LO" 16175619 "DTC_FGD2_FAULT" 16171008 "DTC_CONT_OPEN" 16171009 "DTC_CONT_CLOSE" 16171010 "DTC_CONT_OPEN_CURRENT" 16171264 "DTC_CONT_CLOSE_ON_RESET" 16171265 "DTC_CONT_CLOSE_SIG_FAILED" 16171520 "DTC_PRECHARGE_TIMEOUT" 16171777 "DTC_CONT_MPOS_WELD_AT_SU" 16171778 "DTC_CONT_MNEG_WELD_AT_SU" 16171780 "DTC_CONT_CPOS_WELD_AT_SU" 16171781 "DTC_CONT_CNEG_WELD_AT_SU" 16171782 "DTC_CONT_ANEG_WELD_AT_SU" 16171783 "DTC_CONT_APOS_WELD_AT_SU" 16172033 "DTC_CONT_MPOS_WELD_AT_SD" 16172034 "DTC_CONT_MNEG_WELD_AT_SD" 16172036 "DTC_CONT_CPOS_WELD_AT_SD" 16172037 "DTC_CONT_CNEG_WELD_AT_SD" 16172038 "DTC_CONT_ANEG_WELD_AT_SD" 16172039 "DTC_CONT_APOS_WELD_AT_SD" 16172289 "DTC_CONT_MPOS_OPEN" 16172290 "DTC_CONT_MNEG_OPEN" 16172291 "DTC_CONT_MPRE_OPEN" 16172292 "DTC_CONT_CPOS_OPEN" 16172293 "DTC_CONT_CNEG_OPEN" 16172294 "DTC_CONT_APOS_OPEN" 16172295 "DTC_CONT_ANEG_OPEN" 16172545 "DTC_CONT_MPOS_VDIF" 16172546 "DTC_CONT_MNEG_VDIF" 16172548 "DTC_CONT_CPOS_VDIF" 16172549 "DTC_CONT_CNEG_VDIF" 16172550 "DTC_CONT_APOS_VDIF" 16172551 "DTC_CONT_ANEG_VDIF" 16174848 "DTC_HVIL" 16174849 "DTC_LVBAT_LO" 16174850 "DTC_LVBAT_HI" 16174851 "DTC_LVBAT_ERR" 16523520 "DTC_LEMLO_OOR_HI" 16523521 "DTC_LEMLO_OOR_LO" 16523522 "DTC_LEMLO_FAULT" 16523776 "DTC_LEMHI_OOR_HI" 16523777 "DTC_LEMHI_OOR_LO" 16523778 "DTC_LEMHI_FAULT" 16496320 "DTC_MBB_TOO_FEW" 16496321 "DTC_MBB_TOO_MANY" 16496352 "DTC_CELL_VMAX_ERR" 16496353 "DTC_CELL_VMIN_ERR" 16496354 "DTC_CELL_VMAX" 16496362 "DTC_CELL_VMAX_SEVERE" 16496355 "DTC_CELL_VMIN" 16496363 "DTC_CELL_VMIN_SEVERE" 16496356 "DTC_MOD_VOLTAGE_COMPARE" 16496336 "DTC_CELL_T_ERR" 16496337 "DTC_CELL_TMAX1" 16496338 "DTC_CELL_TMAX2" 16496339 "DTC_CELL_TMIN" 16497665 "DTC_MBB_01_MISSING" 16497666 "DTC_MBB_02_MISSING" 16497667 "DTC_MBB_03_MISSING" 16497668 "DTC_MBB_04_MISSING" 16497669 "DTC_MBB_05_MISSING" 16497670 "DTC_MBB_06_MISSING" 16497671 "DTC_MBB_07_MISSING" 16497672 "DTC_MBB_08_MISSING" 16497673 "DTC_MBB_09_MISSING" 16497680 "DTC_MBB_10_MISSING" 16497681 "DTC_MBB_11_MISSING" 16497682 "DTC_MBB_12_MISSING" 16497683 "DTC_MBB_13_MISSING" 16497684 "DTC_MBB_14_MISSING" 16497685 "DTC_MBB_15_MISSING" 16497686 "DTC_MBB_16_MISSING" 16497687 "DTC_MBB_17_MISSING" 16497688 "DTC_MBB_18_MISSING" 16497689 "DTC_MBB_19_MISSING" 16497696 "DTC_MBB_20_MISSING" 16497697 "DTC_MBB_21_MISSING" 16497698 "DTC_MBB_22_MISSING" 16497699 "DTC_MBB_23_MISSING" 16497700 "DTC_MBB_24_MISSING" 16498177 "DTC_MBB_01_VFAULT" 16498178 "DTC_MBB_02_VFAULT" 16498179 "DTC_MBB_03_VFAULT" 16498180 "DTC_MBB_04_VFAULT" 16498181 "DTC_MBB_05_VFAULT" 16498182 "DTC_MBB_06_VFAULT" 16498183 "DTC_MBB_07_VFAULT" 16498184 "DTC_MBB_08_VFAULT" 16498185 "DTC_MBB_09_VFAULT" 16498192 "DTC_MBB_10_VFAULT" 16498193 "DTC_MBB_11_VFAULT" 16498194 "DTC_MBB_12_VFAULT" 16498195 "DTC_MBB_13_VFAULT" 16498196 "DTC_MBB_14_VFAULT" 16498197 "DTC_MBB_15_VFAULT" 16498198 "DTC_MBB_16_VFAULT" 16498199 "DTC_MBB_17_VFAULT" 16498200 "DTC_MBB_18_VFAULT" 16498201 "DTC_MBB_19_VFAULT" 16498208 "DTC_MBB_20_VFAULT" 16498209 "DTC_MBB_21_VFAULT" 16498210 "DTC_MBB_22_VFAULT" 16498211 "DTC_MBB_23_VFAULT" 16498212 "DTC_MBB_24_VFAULT" 16497921 "DTC_MBB_01_TFAULT" 16497922 "DTC_MBB_02_TFAULT" 16497923 "DTC_MBB_03_TFAULT" 16497924 "DTC_MBB_04_TFAULT" 16497925 "DTC_MBB_05_TFAULT" 16497926 "DTC_MBB_06_TFAULT" 16497927 "DTC_MBB_07_TFAULT" 16497928 "DTC_MBB_08_TFAULT" 16497929 "DTC_MBB_09_TFAULT" 16497936 "DTC_MBB_10_TFAULT" 16497937 "DTC_MBB_11_TFAULT" 16497938 "DTC_MBB_12_TFAULT" 16497939 "DTC_MBB_13_TFAULT" 16497940 "DTC_MBB_14_TFAULT" 16497941 "DTC_MBB_15_TFAULT" 16497942 "DTC_MBB_16_TFAULT" 16497943 "DTC_MBB_17_TFAULT" 16497944 "DTC_MBB_18_TFAULT" 16497945 "DTC_MBB_19_TFAULT" 16497952 "DTC_MBB_20_TFAULT" 16497953 "DTC_MBB_21_TFAULT" 16497954 "DTC_MBB_22_TFAULT" 16497955 "DTC_MBB_23_TFAULT" 16497956 "DTC_MBB_24_TFAULT" 15785984 "DTC_PRECHARGE_ENERGY" 15785985 "DTC_PRT_FAILED" 15785986 "DTC_PRT_OVERTEMP" 15785987 "DTC_PRT_PROHIBIT" 16556032 "DTC_COOLANT_TEMP_OOR_HI" 16556033 "DTC_COOLANT_TEMP_OOR_LO" 16252928 "DTC_KEY_OFF_TIME_ERROR" 16506880 "DTC_VBAT_MISMATCH" 16506881 "DTC_VBAT_VMAX" 16506882 "DTC_VBAT_VMIN" 16506883 "DTC_PACK_FUSE" 15798544 "DTC_LLS1_OOR_HI" 15798545 "DTC_LLS1_OOR_LO" 15798546 "DTC_LLS1_FAULT" 15798816 "DTC_LLS2_OOR_HI" 15798817 "DTC_LLS2_OOR_LO" 15798818 "DTC_LLS2_FAULT" 14479360 "DTC_CFL_HEARTBEAT" 14479361 "DTC_CFL_FAULT" 14479362 "DTC_CFL_FAULT_LATCH" 13635584 "DTC_CONT_A_FAILED_HI" 13635585 "DTC_CONT_A_FAILED_LO" 13635586 "DTC_CONT_B_FAILED_HI" 13635587 "DTC_CONT_B_FAILED_LO" 13635588 "DTC_CONT_C_FAILED_HI" 13635589 "DTC_CONT_C_FAILED_LO" 13635590 "DTC_CONT_D_FAILED_HI" 13635591 "DTC_CONT_D_FAILED_LO" 13635592 "DTC_CONT_E_FAILED_HI" 13635593 "DTC_CONT_E_FAILED_LO" 13635594 "DTC_CONT_F_FAILED_HI" 13635595 "DTC_CONT_F_FAILED_LO" 13635596 "DTC_CONT_G_FAILED_HI" 13635597 "DTC_CONT_G_FAILED_LO" 13635598 "DTC_LSD_A_FAILED_HI" 13635599 "DTC_LSD_A_FAILED_LO" 13635600 "DTC_LSD_B_FAILED_HI" 13635601 "DTC_LSD_B_FAILED_LO" 13635602 "DTC_LSD_C_FAILED_HI" 13635603 "DTC_LSD_C_FAILED_LO" 13635606 "DTC_CONT_PWR_FAILED_HI" 13635607 "DTC_CONT_PWR_FAILED_LO" 13635608 "DTC_LSD_PUMP_FAILED_HI" 13635609 "DTC_LSD_PUMP_FAILED_LO" 13635610 "DTC_CHG_A_ENABLE_FAILED_HI" 13635611 "DTC_CHG_A_ENABLE_FAILED_LO" 13635612 "DTC_CHG_B_ENABLE_FAILED_HI" 13635613 "DTC_CHG_B_ENABLE_FAILED_LO" 13635614 "DTC_SW14V_PWR_FAILED_HI" 13635615 "DTC_SW14V_PWR_FAILED_LO" 13635620 "DTC_HSD_A_FAILED_HI" 13635621 "DTC_HSD_A_FAILED_LO" 13635622 "DTC_HSD_B_FAILED_HI" 13635623 "DTC_HSD_B_FAILED_LO" 13692968 "DTC_CONT_HPWR_FAILED_HI" 13692969 "DTC_CONT_HPWR_FAILED_LO" 13692970 "DTC_CONT_HPWR_OOR_HI" 13692971 "DTC_CONT_HPWR_OOR_LO" 13635616 "DTC_5V_PWR_OOR_HI" 13635617 "DTC_5V_PWR_OOR_LO" 14606336 "DTC_NVM_WRITE_TO" 14606337 "DTC_NVM_READ_TO" 14614528 "DTC_SPI_DIG_POT_FAULT" ;
VAL_ 1120 bcm_dtc_063 0 " - " 11276288 "DTC_VEPO" 11276289 "DTC_HSC_MISSING" 11460608 "DTC_NVM_SOC" 11460609 "DTC_NVM_KOT" 11460610 "DTC_NVM_DTC" 11460611 "DTC_NVM_SOC_CORRECTION" 11460612 "DTC_NVM_APP_SCRATCHPAD" 11517962 "DTC_LOOPTIME_TASK_A" 11517963 "DTC_LOOPTIME_TASK_B" 11517964 "DTC_LOOPTIME_TASK_C" 11517965 "DTC_LOOPTIME_TASK_D" 11517966 "DTC_LOOPTIME_TASK_E" 11517967 "DTC_LOOPTIME_TASK_F" 11323904 "DTC_INTERLOCK_A_FAILED_LOW" 11323905 "DTC_INTERLOCK_A_FAILED_HIGH" 11324160 "DTC_INTERLOCK_B_FAILED_LOW" 11324161 "DTC_INTERLOCK_B_FAILED_HIGH" 15728640 "DTC_EPO" 16498688 "DTC_BRUSA_MISSING" 16498689 "DTC_BRUSA_IDC" 16498690 "DTC_BRUSA_REQ_VS_CMD" 16433152 "DTC_AKERWADE_MISSING" 16433153 "DTC_AKERWADE_IDC" 16433154 "DTC_AKERWADE_REQ_VS_CMD" 16564224 "DTC_CHGLEAR_MISSING" 16564225 "DTC_CHGLEAR_IDC" 16564226 "DTC_CHGLEAR_REQ_VS_CMD" 16522240 "DTC_CSM_MISSING" 16522752 "DTC_CSM_VBAT" 16522753 "DTC_CSM_VPOS" 16522754 "DTC_CSM_VNEG" 16522755 "DTC_CSM_CPOS" 16522756 "DTC_CSM_CNEG" 16522757 "DTC_CSM_APOS" 16522758 "DTC_CSM_ANEG" 16522759 "DTC_CSM_FUSE_HI" 16522760 "DTC_CSM_FUSE_LO" 16521728 "DTC_CSM_ASIC" 16521729 "DTC_CSM_AILO" 16521730 "DTC_CSM_AIHI" 16520957 "DTC_LEAKAGE_DETECT_FAULT" 16522444 "DTC_REALTIMECLOCK_FAULT" 16520945 "DTC_CSM_LEAK_FAIL_CALC" 16520946 "DTC_CSM_LEAK_FAIL_HW" 16520947 "DTC_CSM_LEAK_EXT_SHORT" 16520948 "DTC_CSM_LEAK_MID_PACK_SHORT" 16520949 "DTC_CSM_LEAK_ERROR" 16520950 "DTC_CSM_LEAK_UNKNOWN" 16523008 "DTC_CSM_VER_MISMATCH" 16523009 "DTC_CSM_DTC_SET" 16523010 "DTC_CSM_CAL_FAULT" 16560128 "DTC_IBAT_MISMATCH" 16576512 "DTC_DIS_MAX_I2T" 16576513 "DTC_CHG_MAX_I2T" 16576768 "DTC_DIS_WARNING_I2T" 16576769 "DTC_CHG_WARNING_I2T" 11296784 "DTC_SAEJ1772_PROX_DECT_OOR_HI" 11296785 "DTC_SAEJ1772_PROX_DECT_OOR_LO" 11296800 "DTC_SAEJ1772_PILOT_PWM_OOR_HI" 11296801 "DTC_SAEJ1772_PILOT_PWM_OOR_LO" 11296802 "DTC_SAEJ1772_PILOT_PWM_DIG_COMM" 11296803 "DTC_SAEJ1772_PILOT_PWM_IR_ERR" 16175360 "DTC_FGD1_NO_SENSOR" 16175361 "DTC_FGD1_OOR_HI" 16175362 "DTC_FGD1_OOR_LO" 16175363 "DTC_FGD1_FAULT" 16175616 "DTC_FGD2_NO_SENSOR" 16175617 "DTC_FGD2_OOR_HI" 16175618 "DTC_FGD2_OOR_LO" 16175619 "DTC_FGD2_FAULT" 16171008 "DTC_CONT_OPEN" 16171009 "DTC_CONT_CLOSE" 16171010 "DTC_CONT_OPEN_CURRENT" 16171264 "DTC_CONT_CLOSE_ON_RESET" 16171265 "DTC_CONT_CLOSE_SIG_FAILED" 16171520 "DTC_PRECHARGE_TIMEOUT" 16171777 "DTC_CONT_MPOS_WELD_AT_SU" 16171778 "DTC_CONT_MNEG_WELD_AT_SU" 16171780 "DTC_CONT_CPOS_WELD_AT_SU" 16171781 "DTC_CONT_CNEG_WELD_AT_SU" 16171782 "DTC_CONT_ANEG_WELD_AT_SU" 16171783 "DTC_CONT_APOS_WELD_AT_SU" 16172033 "DTC_CONT_MPOS_WELD_AT_SD" 16172034 "DTC_CONT_MNEG_WELD_AT_SD" 16172036 "DTC_CONT_CPOS_WELD_AT_SD" 16172037 "DTC_CONT_CNEG_WELD_AT_SD" 16172038 "DTC_CONT_ANEG_WELD_AT_SD" 16172039 "DTC_CONT_APOS_WELD_AT_SD" 16172289 "DTC_CONT_MPOS_OPEN" 16172290 "DTC_CONT_MNEG_OPEN" 16172291 "DTC_CONT_MPRE_OPEN" 16172292 "DTC_CONT_CPOS_OPEN" 16172293 "DTC_CONT_CNEG_OPEN" 16172294 "DTC_CONT_APOS_OPEN" 16172295 "DTC_CONT_ANEG_OPEN" 16172545 "DTC_CONT_MPOS_VDIF" 16172546 "DTC_CONT_MNEG_VDIF" 16172548 "DTC_CONT_CPOS_VDIF" 16172549 "DTC_CONT_CNEG_VDIF" 16172550 "DTC_CONT_APOS_VDIF" 16172551 "DTC_CONT_ANEG_VDIF" 16174848 "DTC_HVIL" 16174849 "DTC_LVBAT_LO" 16174850 "DTC_LVBAT_HI" 16174851 "DTC_LVBAT_ERR" 16523520 "DTC_LEMLO_OOR_HI" 16523521 "DTC_LEMLO_OOR_LO" 16523522 "DTC_LEMLO_FAULT" 16523776 "DTC_LEMHI_OOR_HI" 16523777 "DTC_LEMHI_OOR_LO" 16523778 "DTC_LEMHI_FAULT" 16496320 "DTC_MBB_TOO_FEW" 16496321 "DTC_MBB_TOO_MANY" 16496352 "DTC_CELL_VMAX_ERR" 16496353 "DTC_CELL_VMIN_ERR" 16496354 "DTC_CELL_VMAX" 16496362 "DTC_CELL_VMAX_SEVERE" 16496355 "DTC_CELL_VMIN" 16496363 "DTC_CELL_VMIN_SEVERE" 16496356 "DTC_MOD_VOLTAGE_COMPARE" 16496336 "DTC_CELL_T_ERR" 16496337 "DTC_CELL_TMAX1" 16496338 "DTC_CELL_TMAX2" 16496339 "DTC_CELL_TMIN" 16497665 "DTC_MBB_01_MISSING" 16497666 "DTC_MBB_02_MISSING" 16497667 "DTC_MBB_03_MISSING" 16497668 "DTC_MBB_04_MISSING" 16497669 "DTC_MBB_05_MISSING" 16497670 "DTC_MBB_06_MISSING" 16497671 "DTC_MBB_07_MISSING" 16497672 "DTC_MBB_08_MISSING" 16497673 "DTC_MBB_09_MISSING" 16497680 "DTC_MBB_10_MISSING" 16497681 "DTC_MBB_11_MISSING" 16497682 "DTC_MBB_12_MISSING" 16497683 "DTC_MBB_13_MISSING" 16497684 "DTC_MBB_14_MISSING" 16497685 "DTC_MBB_15_MISSING" 16497686 "DTC_MBB_16_MISSING" 16497687 "DTC_MBB_17_MISSING" 16497688 "DTC_MBB_18_MISSING" 16497689 "DTC_MBB_19_MISSING" 16497696 "DTC_MBB_20_MISSING" 16497697 "DTC_MBB_21_MISSING" 16497698 "DTC_MBB_22_MISSING" 16497699 "DTC_MBB_23_MISSING" 16497700 "DTC_MBB_24_MISSING" 16498177 "DTC_MBB_01_VFAULT" 16498178 "DTC_MBB_02_VFAULT" 16498179 "DTC_MBB_03_VFAULT" 16498180 "DTC_MBB_04_VFAULT" 16498181 "DTC_MBB_05_VFAULT" 16498182 "DTC_MBB_06_VFAULT" 16498183 "DTC_MBB_07_VFAULT" 16498184 "DTC_MBB_08_VFAULT" 16498185 "DTC_MBB_09_VFAULT" 16498192 "DTC_MBB_10_VFAULT" 16498193 "DTC_MBB_11_VFAULT" 16498194 "DTC_MBB_12_VFAULT" 16498195 "DTC_MBB_13_VFAULT" 16498196 "DTC_MBB_14_VFAULT" 16498197 "DTC_MBB_15_VFAULT" 16498198 "DTC_MBB_16_VFAULT" 16498199 "DTC_MBB_17_VFAULT" 16498200 "DTC_MBB_18_VFAULT" 16498201 "DTC_MBB_19_VFAULT" 16498208 "DTC_MBB_20_VFAULT" 16498209 "DTC_MBB_21_VFAULT" 16498210 "DTC_MBB_22_VFAULT" 16498211 "DTC_MBB_23_VFAULT" 16498212 "DTC_MBB_24_VFAULT" 16497921 "DTC_MBB_01_TFAULT" 16497922 "DTC_MBB_02_TFAULT" 16497923 "DTC_MBB_03_TFAULT" 16497924 "DTC_MBB_04_TFAULT" 16497925 "DTC_MBB_05_TFAULT" 16497926 "DTC_MBB_06_TFAULT" 16497927 "DTC_MBB_07_TFAULT" 16497928 "DTC_MBB_08_TFAULT" 16497929 "DTC_MBB_09_TFAULT" 16497936 "DTC_MBB_10_TFAULT" 16497937 "DTC_MBB_11_TFAULT" 16497938 "DTC_MBB_12_TFAULT" 16497939 "DTC_MBB_13_TFAULT" 16497940 "DTC_MBB_14_TFAULT" 16497941 "DTC_MBB_15_TFAULT" 16497942 "DTC_MBB_16_TFAULT" 16497943 "DTC_MBB_17_TFAULT" 16497944 "DTC_MBB_18_TFAULT" 16497945 "DTC_MBB_19_TFAULT" 16497952 "DTC_MBB_20_TFAULT" 16497953 "DTC_MBB_21_TFAULT" 16497954 "DTC_MBB_22_TFAULT" 16497955 "DTC_MBB_23_TFAULT" 16497956 "DTC_MBB_24_TFAULT" 15785984 "DTC_PRECHARGE_ENERGY" 15785985 "DTC_PRT_FAILED" 15785986 "DTC_PRT_OVERTEMP" 15785987 "DTC_PRT_PROHIBIT" 16556032 "DTC_COOLANT_TEMP_OOR_HI" 16556033 "DTC_COOLANT_TEMP_OOR_LO" 16252928 "DTC_KEY_OFF_TIME_ERROR" 16506880 "DTC_VBAT_MISMATCH" 16506881 "DTC_VBAT_VMAX" 16506882 "DTC_VBAT_VMIN" 16506883 "DTC_PACK_FUSE" 15798544 "DTC_LLS1_OOR_HI" 15798545 "DTC_LLS1_OOR_LO" 15798546 "DTC_LLS1_FAULT" 15798816 "DTC_LLS2_OOR_HI" 15798817 "DTC_LLS2_OOR_LO" 15798818 "DTC_LLS2_FAULT" 14479360 "DTC_CFL_HEARTBEAT" 14479361 "DTC_CFL_FAULT" 14479362 "DTC_CFL_FAULT_LATCH" 13635584 "DTC_CONT_A_FAILED_HI" 13635585 "DTC_CONT_A_FAILED_LO" 13635586 "DTC_CONT_B_FAILED_HI" 13635587 "DTC_CONT_B_FAILED_LO" 13635588 "DTC_CONT_C_FAILED_HI" 13635589 "DTC_CONT_C_FAILED_LO" 13635590 "DTC_CONT_D_FAILED_HI" 13635591 "DTC_CONT_D_FAILED_LO" 13635592 "DTC_CONT_E_FAILED_HI" 13635593 "DTC_CONT_E_FAILED_LO" 13635594 "DTC_CONT_F_FAILED_HI" 13635595 "DTC_CONT_F_FAILED_LO" 13635596 "DTC_CONT_G_FAILED_HI" 13635597 "DTC_CONT_G_FAILED_LO" 13635598 "DTC_LSD_A_FAILED_HI" 13635599 "DTC_LSD_A_FAILED_LO" 13635600 "DTC_LSD_B_FAILED_HI" 13635601 "DTC_LSD_B_FAILED_LO" 13635602 "DTC_LSD_C_FAILED_HI" 13635603 "DTC_LSD_C_FAILED_LO" 13635606 "DTC_CONT_PWR_FAILED_HI" 13635607 "DTC_CONT_PWR_FAILED_LO" 13635608 "DTC_LSD_PUMP_FAILED_HI" 13635609 "DTC_LSD_PUMP_FAILED_LO" 13635610 "DTC_CHG_A_ENABLE_FAILED_HI" 13635611 "DTC_CHG_A_ENABLE_FAILED_LO" 13635612 "DTC_CHG_B_ENABLE_FAILED_HI" 13635613 "DTC_CHG_B_ENABLE_FAILED_LO" 13635614 "DTC_SW14V_PWR_FAILED_HI" 13635615 "DTC_SW14V_PWR_FAILED_LO" 13635620 "DTC_HSD_A_FAILED_HI" 13635621 "DTC_HSD_A_FAILED_LO" 13635622 "DTC_HSD_B_FAILED_HI" 13635623 "DTC_HSD_B_FAILED_LO" 13692968 "DTC_CONT_HPWR_FAILED_HI" 13692969 "DTC_CONT_HPWR_FAILED_LO" 13692970 "DTC_CONT_HPWR_OOR_HI" 13692971 "DTC_CONT_HPWR_OOR_LO" 13635616 "DTC_5V_PWR_OOR_HI" 13635617 "DTC_5V_PWR_OOR_LO" 14606336 "DTC_NVM_WRITE_TO" 14606337 "DTC_NVM_READ_TO" 14614528 "DTC_SPI_DIG_POT_FAULT" ;
VAL_ 1120 bcm_dtc_064 0 " - " 11276288 "DTC_VEPO" 11276289 "DTC_HSC_MISSING" 11460608 "DTC_NVM_SOC" 11460609 "DTC_NVM_KOT" 11460610 "DTC_NVM_DTC" 11460611 "DTC_NVM_SOC_CORRECTION" 11460612 "DTC_NVM_APP_SCRATCHPAD" 11517962 "DTC_LOOPTIME_TASK_A" 11517963 "DTC_LOOPTIME_TASK_B" 11517964 "DTC_LOOPTIME_TASK_C" 11517965 "DTC_LOOPTIME_TASK_D" 11517966 "DTC_LOOPTIME_TASK_E" 11517967 "DTC_LOOPTIME_TASK_F" 11323904 "DTC_INTERLOCK_A_FAILED_LOW" 11323905 "DTC_INTERLOCK_A_FAILED_HIGH" 11324160 "DTC_INTERLOCK_B_FAILED_LOW" 11324161 "DTC_INTERLOCK_B_FAILED_HIGH" 15728640 "DTC_EPO" 16498688 "DTC_BRUSA_MISSING" 16498689 "DTC_BRUSA_IDC" 16498690 "DTC_BRUSA_REQ_VS_CMD" 16433152 "DTC_AKERWADE_MISSING" 16433153 "DTC_AKERWADE_IDC" 16433154 "DTC_AKERWADE_REQ_VS_CMD" 16564224 "DTC_CHGLEAR_MISSING" 16564225 "DTC_CHGLEAR_IDC" 16564226 "DTC_CHGLEAR_REQ_VS_CMD" 16522240 "DTC_CSM_MISSING" 16522752 "DTC_CSM_VBAT" 16522753 "DTC_CSM_VPOS" 16522754 "DTC_CSM_VNEG" 16522755 "DTC_CSM_CPOS" 16522756 "DTC_CSM_CNEG" 16522757 "DTC_CSM_APOS" 16522758 "DTC_CSM_ANEG" 16522759 "DTC_CSM_FUSE_HI" 16522760 "DTC_CSM_FUSE_LO" 16521728 "DTC_CSM_ASIC" 16521729 "DTC_CSM_AILO" 16521730 "DTC_CSM_AIHI" 16520957 "DTC_LEAKAGE_DETECT_FAULT" 16522444 "DTC_REALTIMECLOCK_FAULT" 16520945 "DTC_CSM_LEAK_FAIL_CALC" 16520946 "DTC_CSM_LEAK_FAIL_HW" 16520947 "DTC_CSM_LEAK_EXT_SHORT" 16520948 "DTC_CSM_LEAK_MID_PACK_SHORT" 16520949 "DTC_CSM_LEAK_ERROR" 16520950 "DTC_CSM_LEAK_UNKNOWN" 16523008 "DTC_CSM_VER_MISMATCH" 16523009 "DTC_CSM_DTC_SET" 16523010 "DTC_CSM_CAL_FAULT" 16560128 "DTC_IBAT_MISMATCH" 16576512 "DTC_DIS_MAX_I2T" 16576513 "DTC_CHG_MAX_I2T" 16576768 "DTC_DIS_WARNING_I2T" 16576769 "DTC_CHG_WARNING_I2T" 11296784 "DTC_SAEJ1772_PROX_DECT_OOR_HI" 11296785 "DTC_SAEJ1772_PROX_DECT_OOR_LO" 11296800 "DTC_SAEJ1772_PILOT_PWM_OOR_HI" 11296801 "DTC_SAEJ1772_PILOT_PWM_OOR_LO" 11296802 "DTC_SAEJ1772_PILOT_PWM_DIG_COMM" 11296803 "DTC_SAEJ1772_PILOT_PWM_IR_ERR" 16175360 "DTC_FGD1_NO_SENSOR" 16175361 "DTC_FGD1_OOR_HI" 16175362 "DTC_FGD1_OOR_LO" 16175363 "DTC_FGD1_FAULT" 16175616 "DTC_FGD2_NO_SENSOR" 16175617 "DTC_FGD2_OOR_HI" 16175618 "DTC_FGD2_OOR_LO" 16175619 "DTC_FGD2_FAULT" 16171008 "DTC_CONT_OPEN" 16171009 "DTC_CONT_CLOSE" 16171010 "DTC_CONT_OPEN_CURRENT" 16171264 "DTC_CONT_CLOSE_ON_RESET" 16171265 "DTC_CONT_CLOSE_SIG_FAILED" 16171520 "DTC_PRECHARGE_TIMEOUT" 16171777 "DTC_CONT_MPOS_WELD_AT_SU" 16171778 "DTC_CONT_MNEG_WELD_AT_SU" 16171780 "DTC_CONT_CPOS_WELD_AT_SU" 16171781 "DTC_CONT_CNEG_WELD_AT_SU" 16171782 "DTC_CONT_ANEG_WELD_AT_SU" 16171783 "DTC_CONT_APOS_WELD_AT_SU" 16172033 "DTC_CONT_MPOS_WELD_AT_SD" 16172034 "DTC_CONT_MNEG_WELD_AT_SD" 16172036 "DTC_CONT_CPOS_WELD_AT_SD" 16172037 "DTC_CONT_CNEG_WELD_AT_SD" 16172038 "DTC_CONT_ANEG_WELD_AT_SD" 16172039 "DTC_CONT_APOS_WELD_AT_SD" 16172289 "DTC_CONT_MPOS_OPEN" 16172290 "DTC_CONT_MNEG_OPEN" 16172291 "DTC_CONT_MPRE_OPEN" 16172292 "DTC_CONT_CPOS_OPEN" 16172293 "DTC_CONT_CNEG_OPEN" 16172294 "DTC_CONT_APOS_OPEN" 16172295 "DTC_CONT_ANEG_OPEN" 16172545 "DTC_CONT_MPOS_VDIF" 16172546 "DTC_CONT_MNEG_VDIF" 16172548 "DTC_CONT_CPOS_VDIF" 16172549 "DTC_CONT_CNEG_VDIF" 16172550 "DTC_CONT_APOS_VDIF" 16172551 "DTC_CONT_ANEG_VDIF" 16174848 "DTC_HVIL" 16174849 "DTC_LVBAT_LO" 16174850 "DTC_LVBAT_HI" 16174851 "DTC_LVBAT_ERR" 16523520 "DTC_LEMLO_OOR_HI" 16523521 "DTC_LEMLO_OOR_LO" 16523522 "DTC_LEMLO_FAULT" 16523776 "DTC_LEMHI_OOR_HI" 16523777 "DTC_LEMHI_OOR_LO" 16523778 "DTC_LEMHI_FAULT" 16496320 "DTC_MBB_TOO_FEW" 16496321 "DTC_MBB_TOO_MANY" 16496352 "DTC_CELL_VMAX_ERR" 16496353 "DTC_CELL_VMIN_ERR" 16496354 "DTC_CELL_VMAX" 16496362 "DTC_CELL_VMAX_SEVERE" 16496355 "DTC_CELL_VMIN" 16496363 "DTC_CELL_VMIN_SEVERE" 16496356 "DTC_MOD_VOLTAGE_COMPARE" 16496336 "DTC_CELL_T_ERR" 16496337 "DTC_CELL_TMAX1" 16496338 "DTC_CELL_TMAX2" 16496339 "DTC_CELL_TMIN" 16497665 "DTC_MBB_01_MISSING" 16497666 "DTC_MBB_02_MISSING" 16497667 "DTC_MBB_03_MISSING" 16497668 "DTC_MBB_04_MISSING" 16497669 "DTC_MBB_05_MISSING" 16497670 "DTC_MBB_06_MISSING" 16497671 "DTC_MBB_07_MISSING" 16497672 "DTC_MBB_08_MISSING" 16497673 "DTC_MBB_09_MISSING" 16497680 "DTC_MBB_10_MISSING" 16497681 "DTC_MBB_11_MISSING" 16497682 "DTC_MBB_12_MISSING" 16497683 "DTC_MBB_13_MISSING" 16497684 "DTC_MBB_14_MISSING" 16497685 "DTC_MBB_15_MISSING" 16497686 "DTC_MBB_16_MISSING" 16497687 "DTC_MBB_17_MISSING" 16497688 "DTC_MBB_18_MISSING" 16497689 "DTC_MBB_19_MISSING" 16497696 "DTC_MBB_20_MISSING" 16497697 "DTC_MBB_21_MISSING" 16497698 "DTC_MBB_22_MISSING" 16497699 "DTC_MBB_23_MISSING" 16497700 "DTC_MBB_24_MISSING" 16498177 "DTC_MBB_01_VFAULT" 16498178 "DTC_MBB_02_VFAULT" 16498179 "DTC_MBB_03_VFAULT" 16498180 "DTC_MBB_04_VFAULT" 16498181 "DTC_MBB_05_VFAULT" 16498182 "DTC_MBB_06_VFAULT" 16498183 "DTC_MBB_07_VFAULT" 16498184 "DTC_MBB_08_VFAULT" 16498185 "DTC_MBB_09_VFAULT" 16498192 "DTC_MBB_10_VFAULT" 16498193 "DTC_MBB_11_VFAULT" 16498194 "DTC_MBB_12_VFAULT" 16498195 "DTC_MBB_13_VFAULT" 16498196 "DTC_MBB_14_VFAULT" 16498197 "DTC_MBB_15_VFAULT" 16498198 "DTC_MBB_16_VFAULT" 16498199 "DTC_MBB_17_VFAULT" 16498200 "DTC_MBB_18_VFAULT" 16498201 "DTC_MBB_19_VFAULT" 16498208 "DTC_MBB_20_VFAULT" 16498209 "DTC_MBB_21_VFAULT" 16498210 "DTC_MBB_22_VFAULT" 16498211 "DTC_MBB_23_VFAULT" 16498212 "DTC_MBB_24_VFAULT" 16497921 "DTC_MBB_01_TFAULT" 16497922 "DTC_MBB_02_TFAULT" 16497923 "DTC_MBB_03_TFAULT" 16497924 "DTC_MBB_04_TFAULT" 16497925 "DTC_MBB_05_TFAULT" 16497926 "DTC_MBB_06_TFAULT" 16497927 "DTC_MBB_07_TFAULT" 16497928 "DTC_MBB_08_TFAULT" 16497929 "DTC_MBB_09_TFAULT" 16497936 "DTC_MBB_10_TFAULT" 16497937 "DTC_MBB_11_TFAULT" 16497938 "DTC_MBB_12_TFAULT" 16497939 "DTC_MBB_13_TFAULT" 16497940 "DTC_MBB_14_TFAULT" 16497941 "DTC_MBB_15_TFAULT" 16497942 "DTC_MBB_16_TFAULT" 16497943 "DTC_MBB_17_TFAULT" 16497944 "DTC_MBB_18_TFAULT" 16497945 "DTC_MBB_19_TFAULT" 16497952 "DTC_MBB_20_TFAULT" 16497953 "DTC_MBB_21_TFAULT" 16497954 "DTC_MBB_22_TFAULT" 16497955 "DTC_MBB_23_TFAULT" 16497956 "DTC_MBB_24_TFAULT" 15785984 "DTC_PRECHARGE_ENERGY" 15785985 "DTC_PRT_FAILED" 15785986 "DTC_PRT_OVERTEMP" 15785987 "DTC_PRT_PROHIBIT" 16556032 "DTC_COOLANT_TEMP_OOR_HI" 16556033 "DTC_COOLANT_TEMP_OOR_LO" 16252928 "DTC_KEY_OFF_TIME_ERROR" 16506880 "DTC_VBAT_MISMATCH" 16506881 "DTC_VBAT_VMAX" 16506882 "DTC_VBAT_VMIN" 16506883 "DTC_PACK_FUSE" 15798544 "DTC_LLS1_OOR_HI" 15798545 "DTC_LLS1_OOR_LO" 15798546 "DTC_LLS1_FAULT" 15798816 "DTC_LLS2_OOR_HI" 15798817 "DTC_LLS2_OOR_LO" 15798818 "DTC_LLS2_FAULT" 14479360 "DTC_CFL_HEARTBEAT" 14479361 "DTC_CFL_FAULT" 14479362 "DTC_CFL_FAULT_LATCH" 13635584 "DTC_CONT_A_FAILED_HI" 13635585 "DTC_CONT_A_FAILED_LO" 13635586 "DTC_CONT_B_FAILED_HI" 13635587 "DTC_CONT_B_FAILED_LO" 13635588 "DTC_CONT_C_FAILED_HI" 13635589 "DTC_CONT_C_FAILED_LO" 13635590 "DTC_CONT_D_FAILED_HI" 13635591 "DTC_CONT_D_FAILED_LO" 13635592 "DTC_CONT_E_FAILED_HI" 13635593 "DTC_CONT_E_FAILED_LO" 13635594 "DTC_CONT_F_FAILED_HI" 13635595 "DTC_CONT_F_FAILED_LO" 13635596 "DTC_CONT_G_FAILED_HI" 13635597 "DTC_CONT_G_FAILED_LO" 13635598 "DTC_LSD_A_FAILED_HI" 13635599 "DTC_LSD_A_FAILED_LO" 13635600 "DTC_LSD_B_FAILED_HI" 13635601 "DTC_LSD_B_FAILED_LO" 13635602 "DTC_LSD_C_FAILED_HI" 13635603 "DTC_LSD_C_FAILED_LO" 13635606 "DTC_CONT_PWR_FAILED_HI" 13635607 "DTC_CONT_PWR_FAILED_LO" 13635608 "DTC_LSD_PUMP_FAILED_HI" 13635609 "DTC_LSD_PUMP_FAILED_LO" 13635610 "DTC_CHG_A_ENABLE_FAILED_HI" 13635611 "DTC_CHG_A_ENABLE_FAILED_LO" 13635612 "DTC_CHG_B_ENABLE_FAILED_HI" 13635613 "DTC_CHG_B_ENABLE_FAILED_LO" 13635614 "DTC_SW14V_PWR_FAILED_HI" 13635615 "DTC_SW14V_PWR_FAILED_LO" 13635620 "DTC_HSD_A_FAILED_HI" 13635621 "DTC_HSD_A_FAILED_LO" 13635622 "DTC_HSD_B_FAILED_HI" 13635623 "DTC_HSD_B_FAILED_LO" 13692968 "DTC_CONT_HPWR_FAILED_HI" 13692969 "DTC_CONT_HPWR_FAILED_LO" 13692970 "DTC_CONT_HPWR_OOR_HI" 13692971 "DTC_CONT_HPWR_OOR_LO" 13635616 "DTC_5V_PWR_OOR_HI" 13635617 "DTC_5V_PWR_OOR_LO" 14606336 "DTC_NVM_WRITE_TO" 14606337 "DTC_NVM_READ_TO" 14614528 "DTC_SPI_DIG_POT_FAULT" ;
VAL_ 1120 bcm_dtc_065 0 " - " 11276288 "DTC_VEPO" 11276289 "DTC_HSC_MISSING" 11460608 "DTC_NVM_SOC" 11460609 "DTC_NVM_KOT" 11460610 "DTC_NVM_DTC" 11460611 "DTC_NVM_SOC_CORRECTION" 11460612 "DTC_NVM_APP_SCRATCHPAD" 11517962 "DTC_LOOPTIME_TASK_A" 11517963 "DTC_LOOPTIME_TASK_B" 11517964 "DTC_LOOPTIME_TASK_C" 11517965 "DTC_LOOPTIME_TASK_D" 11517966 "DTC_LOOPTIME_TASK_E" 11517967 "DTC_LOOPTIME_TASK_F" 11323904 "DTC_INTERLOCK_A_FAILED_LOW" 11323905 "DTC_INTERLOCK_A_FAILED_HIGH" 11324160 "DTC_INTERLOCK_B_FAILED_LOW" 11324161 "DTC_INTERLOCK_B_FAILED_HIGH" 15728640 "DTC_EPO" 16498688 "DTC_BRUSA_MISSING" 16498689 "DTC_BRUSA_IDC" 16498690 "DTC_BRUSA_REQ_VS_CMD" 16433152 "DTC_AKERWADE_MISSING" 16433153 "DTC_AKERWADE_IDC" 16433154 "DTC_AKERWADE_REQ_VS_CMD" 16564224 "DTC_CHGLEAR_MISSING" 16564225 "DTC_CHGLEAR_IDC" 16564226 "DTC_CHGLEAR_REQ_VS_CMD" 16522240 "DTC_CSM_MISSING" 16522752 "DTC_CSM_VBAT" 16522753 "DTC_CSM_VPOS" 16522754 "DTC_CSM_VNEG" 16522755 "DTC_CSM_CPOS" 16522756 "DTC_CSM_CNEG" 16522757 "DTC_CSM_APOS" 16522758 "DTC_CSM_ANEG" 16522759 "DTC_CSM_FUSE_HI" 16522760 "DTC_CSM_FUSE_LO" 16521728 "DTC_CSM_ASIC" 16521729 "DTC_CSM_AILO" 16521730 "DTC_CSM_AIHI" 16520957 "DTC_LEAKAGE_DETECT_FAULT" 16522444 "DTC_REALTIMECLOCK_FAULT" 16520945 "DTC_CSM_LEAK_FAIL_CALC" 16520946 "DTC_CSM_LEAK_FAIL_HW" 16520947 "DTC_CSM_LEAK_EXT_SHORT" 16520948 "DTC_CSM_LEAK_MID_PACK_SHORT" 16520949 "DTC_CSM_LEAK_ERROR" 16520950 "DTC_CSM_LEAK_UNKNOWN" 16523008 "DTC_CSM_VER_MISMATCH" 16523009 "DTC_CSM_DTC_SET" 16523010 "DTC_CSM_CAL_FAULT" 16560128 "DTC_IBAT_MISMATCH" 16576512 "DTC_DIS_MAX_I2T" 16576513 "DTC_CHG_MAX_I2T" 16576768 "DTC_DIS_WARNING_I2T" 16576769 "DTC_CHG_WARNING_I2T" 11296784 "DTC_SAEJ1772_PROX_DECT_OOR_HI" 11296785 "DTC_SAEJ1772_PROX_DECT_OOR_LO" 11296800 "DTC_SAEJ1772_PILOT_PWM_OOR_HI" 11296801 "DTC_SAEJ1772_PILOT_PWM_OOR_LO" 11296802 "DTC_SAEJ1772_PILOT_PWM_DIG_COMM" 11296803 "DTC_SAEJ1772_PILOT_PWM_IR_ERR" 16175360 "DTC_FGD1_NO_SENSOR" 16175361 "DTC_FGD1_OOR_HI" 16175362 "DTC_FGD1_OOR_LO" 16175363 "DTC_FGD1_FAULT" 16175616 "DTC_FGD2_NO_SENSOR" 16175617 "DTC_FGD2_OOR_HI" 16175618 "DTC_FGD2_OOR_LO" 16175619 "DTC_FGD2_FAULT" 16171008 "DTC_CONT_OPEN" 16171009 "DTC_CONT_CLOSE" 16171010 "DTC_CONT_OPEN_CURRENT" 16171264 "DTC_CONT_CLOSE_ON_RESET" 16171265 "DTC_CONT_CLOSE_SIG_FAILED" 16171520 "DTC_PRECHARGE_TIMEOUT" 16171777 "DTC_CONT_MPOS_WELD_AT_SU" 16171778 "DTC_CONT_MNEG_WELD_AT_SU" 16171780 "DTC_CONT_CPOS_WELD_AT_SU" 16171781 "DTC_CONT_CNEG_WELD_AT_SU" 16171782 "DTC_CONT_ANEG_WELD_AT_SU" 16171783 "DTC_CONT_APOS_WELD_AT_SU" 16172033 "DTC_CONT_MPOS_WELD_AT_SD" 16172034 "DTC_CONT_MNEG_WELD_AT_SD" 16172036 "DTC_CONT_CPOS_WELD_AT_SD" 16172037 "DTC_CONT_CNEG_WELD_AT_SD" 16172038 "DTC_CONT_ANEG_WELD_AT_SD" 16172039 "DTC_CONT_APOS_WELD_AT_SD" 16172289 "DTC_CONT_MPOS_OPEN" 16172290 "DTC_CONT_MNEG_OPEN" 16172291 "DTC_CONT_MPRE_OPEN" 16172292 "DTC_CONT_CPOS_OPEN" 16172293 "DTC_CONT_CNEG_OPEN" 16172294 "DTC_CONT_APOS_OPEN" 16172295 "DTC_CONT_ANEG_OPEN" 16172545 "DTC_CONT_MPOS_VDIF" 16172546 "DTC_CONT_MNEG_VDIF" 16172548 "DTC_CONT_CPOS_VDIF" 16172549 "DTC_CONT_CNEG_VDIF" 16172550 "DTC_CONT_APOS_VDIF" 16172551 "DTC_CONT_ANEG_VDIF" 16174848 "DTC_HVIL" 16174849 "DTC_LVBAT_LO" 16174850 "DTC_LVBAT_HI" 16174851 "DTC_LVBAT_ERR" 16523520 "DTC_LEMLO_OOR_HI" 16523521 "DTC_LEMLO_OOR_LO" 16523522 "DTC_LEMLO_FAULT" 16523776 "DTC_LEMHI_OOR_HI" 16523777 "DTC_LEMHI_OOR_LO" 16523778 "DTC_LEMHI_FAULT" 16496320 "DTC_MBB_TOO_FEW" 16496321 "DTC_MBB_TOO_MANY" 16496352 "DTC_CELL_VMAX_ERR" 16496353 "DTC_CELL_VMIN_ERR" 16496354 "DTC_CELL_VMAX" 16496362 "DTC_CELL_VMAX_SEVERE" 16496355 "DTC_CELL_VMIN" 16496363 "DTC_CELL_VMIN_SEVERE" 16496356 "DTC_MOD_VOLTAGE_COMPARE" 16496336 "DTC_CELL_T_ERR" 16496337 "DTC_CELL_TMAX1" 16496338 "DTC_CELL_TMAX2" 16496339 "DTC_CELL_TMIN" 16497665 "DTC_MBB_01_MISSING" 16497666 "DTC_MBB_02_MISSING" 16497667 "DTC_MBB_03_MISSING" 16497668 "DTC_MBB_04_MISSING" 16497669 "DTC_MBB_05_MISSING" 16497670 "DTC_MBB_06_MISSING" 16497671 "DTC_MBB_07_MISSING" 16497672 "DTC_MBB_08_MISSING" 16497673 "DTC_MBB_09_MISSING" 16497680 "DTC_MBB_10_MISSING" 16497681 "DTC_MBB_11_MISSING" 16497682 "DTC_MBB_12_MISSING" 16497683 "DTC_MBB_13_MISSING" 16497684 "DTC_MBB_14_MISSING" 16497685 "DTC_MBB_15_MISSING" 16497686 "DTC_MBB_16_MISSING" 16497687 "DTC_MBB_17_MISSING" 16497688 "DTC_MBB_18_MISSING" 16497689 "DTC_MBB_19_MISSING" 16497696 "DTC_MBB_20_MISSING" 16497697 "DTC_MBB_21_MISSING" 16497698 "DTC_MBB_22_MISSING" 16497699 "DTC_MBB_23_MISSING" 16497700 "DTC_MBB_24_MISSING" 16498177 "DTC_MBB_01_VFAULT" 16498178 "DTC_MBB_02_VFAULT" 16498179 "DTC_MBB_03_VFAULT" 16498180 "DTC_MBB_04_VFAULT" 16498181 "DTC_MBB_05_VFAULT" 16498182 "DTC_MBB_06_VFAULT" 16498183 "DTC_MBB_07_VFAULT" 16498184 "DTC_MBB_08_VFAULT" 16498185 "DTC_MBB_09_VFAULT" 16498192 "DTC_MBB_10_VFAULT" 16498193 "DTC_MBB_11_VFAULT" 16498194 "DTC_MBB_12_VFAULT" 16498195 "DTC_MBB_13_VFAULT" 16498196 "DTC_MBB_14_VFAULT" 16498197 "DTC_MBB_15_VFAULT" 16498198 "DTC_MBB_16_VFAULT" 16498199 "DTC_MBB_17_VFAULT" 16498200 "DTC_MBB_18_VFAULT" 16498201 "DTC_MBB_19_VFAULT" 16498208 "DTC_MBB_20_VFAULT" 16498209 "DTC_MBB_21_VFAULT" 16498210 "DTC_MBB_22_VFAULT" 16498211 "DTC_MBB_23_VFAULT" 16498212 "DTC_MBB_24_VFAULT" 16497921 "DTC_MBB_01_TFAULT" 16497922 "DTC_MBB_02_TFAULT" 16497923 "DTC_MBB_03_TFAULT" 16497924 "DTC_MBB_04_TFAULT" 16497925 "DTC_MBB_05_TFAULT" 16497926 "DTC_MBB_06_TFAULT" 16497927 "DTC_MBB_07_TFAULT" 16497928 "DTC_MBB_08_TFAULT" 16497929 "DTC_MBB_09_TFAULT" 16497936 "DTC_MBB_10_TFAULT" 16497937 "DTC_MBB_11_TFAULT" 16497938 "DTC_MBB_12_TFAULT" 16497939 "DTC_MBB_13_TFAULT" 16497940 "DTC_MBB_14_TFAULT" 16497941 "DTC_MBB_15_TFAULT" 16497942 "DTC_MBB_16_TFAULT" 16497943 "DTC_MBB_17_TFAULT" 16497944 "DTC_MBB_18_TFAULT" 16497945 "DTC_MBB_19_TFAULT" 16497952 "DTC_MBB_20_TFAULT" 16497953 "DTC_MBB_21_TFAULT" 16497954 "DTC_MBB_22_TFAULT" 16497955 "DTC_MBB_23_TFAULT" 16497956 "DTC_MBB_24_TFAULT" 15785984 "DTC_PRECHARGE_ENERGY" 15785985 "DTC_PRT_FAILED" 15785986 "DTC_PRT_OVERTEMP" 15785987 "DTC_PRT_PROHIBIT" 16556032 "DTC_COOLANT_TEMP_OOR_HI" 16556033 "DTC_COOLANT_TEMP_OOR_LO" 16252928 "DTC_KEY_OFF_TIME_ERROR" 16506880 "DTC_VBAT_MISMATCH" 16506881 "DTC_VBAT_VMAX" 16506882 "DTC_VBAT_VMIN" 16506883 "DTC_PACK_FUSE" 15798544 "DTC_LLS1_OOR_HI" 15798545 "DTC_LLS1_OOR_LO" 15798546 "DTC_LLS1_FAULT" 15798816 "DTC_LLS2_OOR_HI" 15798817 "DTC_LLS2_OOR_LO" 15798818 "DTC_LLS2_FAULT" 14479360 "DTC_CFL_HEARTBEAT" 14479361 "DTC_CFL_FAULT" 14479362 "DTC_CFL_FAULT_LATCH" 13635584 "DTC_CONT_A_FAILED_HI" 13635585 "DTC_CONT_A_FAILED_LO" 13635586 "DTC_CONT_B_FAILED_HI" 13635587 "DTC_CONT_B_FAILED_LO" 13635588 "DTC_CONT_C_FAILED_HI" 13635589 "DTC_CONT_C_FAILED_LO" 13635590 "DTC_CONT_D_FAILED_HI" 13635591 "DTC_CONT_D_FAILED_LO" 13635592 "DTC_CONT_E_FAILED_HI" 13635593 "DTC_CONT_E_FAILED_LO" 13635594 "DTC_CONT_F_FAILED_HI" 13635595 "DTC_CONT_F_FAILED_LO" 13635596 "DTC_CONT_G_FAILED_HI" 13635597 "DTC_CONT_G_FAILED_LO" 13635598 "DTC_LSD_A_FAILED_HI" 13635599 "DTC_LSD_A_FAILED_LO" 13635600 "DTC_LSD_B_FAILED_HI" 13635601 "DTC_LSD_B_FAILED_LO" 13635602 "DTC_LSD_C_FAILED_HI" 13635603 "DTC_LSD_C_FAILED_LO" 13635606 "DTC_CONT_PWR_FAILED_HI" 13635607 "DTC_CONT_PWR_FAILED_LO" 13635608 "DTC_LSD_PUMP_FAILED_HI" 13635609 "DTC_LSD_PUMP_FAILED_LO" 13635610 "DTC_CHG_A_ENABLE_FAILED_HI" 13635611 "DTC_CHG_A_ENABLE_FAILED_LO" 13635612 "DTC_CHG_B_ENABLE_FAILED_HI" 13635613 "DTC_CHG_B_ENABLE_FAILED_LO" 13635614 "DTC_SW14V_PWR_FAILED_HI" 13635615 "DTC_SW14V_PWR_FAILED_LO" 13635620 "DTC_HSD_A_FAILED_HI" 13635621 "DTC_HSD_A_FAILED_LO" 13635622 "DTC_HSD_B_FAILED_HI" 13635623 "DTC_HSD_B_FAILED_LO" 13692968 "DTC_CONT_HPWR_FAILED_HI" 13692969 "DTC_CONT_HPWR_FAILED_LO" 13692970 "DTC_CONT_HPWR_OOR_HI" 13692971 "DTC_CONT_HPWR_OOR_LO" 13635616 "DTC_5V_PWR_OOR_HI" 13635617 "DTC_5V_PWR_OOR_LO" 14606336 "DTC_NVM_WRITE_TO" 14606337 "DTC_NVM_READ_TO" 14614528 "DTC_SPI_DIG_POT_FAULT" ;
VAL_ 1120 bcm_dtc_066 0 " - " 11276288 "DTC_VEPO" 11276289 "DTC_HSC_MISSING" 11460608 "DTC_NVM_SOC" 11460609 "DTC_NVM_KOT" 11460610 "DTC_NVM_DTC" 11460611 "DTC_NVM_SOC_CORRECTION" 11460612 "DTC_NVM_APP_SCRATCHPAD" 11517962 "DTC_LOOPTIME_TASK_A" 11517963 "DTC_LOOPTIME_TASK_B" 11517964 "DTC_LOOPTIME_TASK_C" 11517965 "DTC_LOOPTIME_TASK_D" 11517966 "DTC_LOOPTIME_TASK_E" 11517967 "DTC_LOOPTIME_TASK_F" 11323904 "DTC_INTERLOCK_A_FAILED_LOW" 11323905 "DTC_INTERLOCK_A_FAILED_HIGH" 11324160 "DTC_INTERLOCK_B_FAILED_LOW" 11324161 "DTC_INTERLOCK_B_FAILED_HIGH" 15728640 "DTC_EPO" 16498688 "DTC_BRUSA_MISSING" 16498689 "DTC_BRUSA_IDC" 16498690 "DTC_BRUSA_REQ_VS_CMD" 16433152 "DTC_AKERWADE_MISSING" 16433153 "DTC_AKERWADE_IDC" 16433154 "DTC_AKERWADE_REQ_VS_CMD" 16564224 "DTC_CHGLEAR_MISSING" 16564225 "DTC_CHGLEAR_IDC" 16564226 "DTC_CHGLEAR_REQ_VS_CMD" 16522240 "DTC_CSM_MISSING" 16522752 "DTC_CSM_VBAT" 16522753 "DTC_CSM_VPOS" 16522754 "DTC_CSM_VNEG" 16522755 "DTC_CSM_CPOS" 16522756 "DTC_CSM_CNEG" 16522757 "DTC_CSM_APOS" 16522758 "DTC_CSM_ANEG" 16522759 "DTC_CSM_FUSE_HI" 16522760 "DTC_CSM_FUSE_LO" 16521728 "DTC_CSM_ASIC" 16521729 "DTC_CSM_AILO" 16521730 "DTC_CSM_AIHI" 16520957 "DTC_LEAKAGE_DETECT_FAULT" 16522444 "DTC_REALTIMECLOCK_FAULT" 16520945 "DTC_CSM_LEAK_FAIL_CALC" 16520946 "DTC_CSM_LEAK_FAIL_HW" 16520947 "DTC_CSM_LEAK_EXT_SHORT" 16520948 "DTC_CSM_LEAK_MID_PACK_SHORT" 16520949 "DTC_CSM_LEAK_ERROR" 16520950 "DTC_CSM_LEAK_UNKNOWN" 16523008 "DTC_CSM_VER_MISMATCH" 16523009 "DTC_CSM_DTC_SET" 16523010 "DTC_CSM_CAL_FAULT" 16560128 "DTC_IBAT_MISMATCH" 16576512 "DTC_DIS_MAX_I2T" 16576513 "DTC_CHG_MAX_I2T" 16576768 "DTC_DIS_WARNING_I2T" 16576769 "DTC_CHG_WARNING_I2T" 11296784 "DTC_SAEJ1772_PROX_DECT_OOR_HI" 11296785 "DTC_SAEJ1772_PROX_DECT_OOR_LO" 11296800 "DTC_SAEJ1772_PILOT_PWM_OOR_HI" 11296801 "DTC_SAEJ1772_PILOT_PWM_OOR_LO" 11296802 "DTC_SAEJ1772_PILOT_PWM_DIG_COMM" 11296803 "DTC_SAEJ1772_PILOT_PWM_IR_ERR" 16175360 "DTC_FGD1_NO_SENSOR" 16175361 "DTC_FGD1_OOR_HI" 16175362 "DTC_FGD1_OOR_LO" 16175363 "DTC_FGD1_FAULT" 16175616 "DTC_FGD2_NO_SENSOR" 16175617 "DTC_FGD2_OOR_HI" 16175618 "DTC_FGD2_OOR_LO" 16175619 "DTC_FGD2_FAULT" 16171008 "DTC_CONT_OPEN" 16171009 "DTC_CONT_CLOSE" 16171010 "DTC_CONT_OPEN_CURRENT" 16171264 "DTC_CONT_CLOSE_ON_RESET" 16171265 "DTC_CONT_CLOSE_SIG_FAILED" 16171520 "DTC_PRECHARGE_TIMEOUT" 16171777 "DTC_CONT_MPOS_WELD_AT_SU" 16171778 "DTC_CONT_MNEG_WELD_AT_SU" 16171780 "DTC_CONT_CPOS_WELD_AT_SU" 16171781 "DTC_CONT_CNEG_WELD_AT_SU" 16171782 "DTC_CONT_ANEG_WELD_AT_SU" 16171783 "DTC_CONT_APOS_WELD_AT_SU" 16172033 "DTC_CONT_MPOS_WELD_AT_SD" 16172034 "DTC_CONT_MNEG_WELD_AT_SD" 16172036 "DTC_CONT_CPOS_WELD_AT_SD" 16172037 "DTC_CONT_CNEG_WELD_AT_SD" 16172038 "DTC_CONT_ANEG_WELD_AT_SD" 16172039 "DTC_CONT_APOS_WELD_AT_SD" 16172289 "DTC_CONT_MPOS_OPEN" 16172290 "DTC_CONT_MNEG_OPEN" 16172291 "DTC_CONT_MPRE_OPEN" 16172292 "DTC_CONT_CPOS_OPEN" 16172293 "DTC_CONT_CNEG_OPEN" 16172294 "DTC_CONT_APOS_OPEN" 16172295 "DTC_CONT_ANEG_OPEN" 16172545 "DTC_CONT_MPOS_VDIF" 16172546 "DTC_CONT_MNEG_VDIF" 16172548 "DTC_CONT_CPOS_VDIF" 16172549 "DTC_CONT_CNEG_VDIF" 16172550 "DTC_CONT_APOS_VDIF" 16172551 "DTC_CONT_ANEG_VDIF" 16174848 "DTC_HVIL" 16174849 "DTC_LVBAT_LO" 16174850 "DTC_LVBAT_HI" 16174851 "DTC_LVBAT_ERR" 16523520 "DTC_LEMLO_OOR_HI" 16523521 "DTC_LEMLO_OOR_LO" 16523522 "DTC_LEMLO_FAULT" 16523776 "DTC_LEMHI_OOR_HI" 16523777 "DTC_LEMHI_OOR_LO" 16523778 "DTC_LEMHI_FAULT" 16496320 "DTC_MBB_TOO_FEW" 16496321 "DTC_MBB_TOO_MANY" 16496352 "DTC_CELL_VMAX_ERR" 16496353 "DTC_CELL_VMIN_ERR" 16496354 "DTC_CELL_VMAX" 16496362 "DTC_CELL_VMAX_SEVERE" 16496355 "DTC_CELL_VMIN" 16496363 "DTC_CELL_VMIN_SEVERE" 16496356 "DTC_MOD_VOLTAGE_COMPARE" 16496336 "DTC_CELL_T_ERR" 16496337 "DTC_CELL_TMAX1" 16496338 "DTC_CELL_TMAX2" 16496339 "DTC_CELL_TMIN" 16497665 "DTC_MBB_01_MISSING" 16497666 "DTC_MBB_02_MISSING" 16497667 "DTC_MBB_03_MISSING" 16497668 "DTC_MBB_04_MISSING" 16497669 "DTC_MBB_05_MISSING" 16497670 "DTC_MBB_06_MISSING" 16497671 "DTC_MBB_07_MISSING" 16497672 "DTC_MBB_08_MISSING" 16497673 "DTC_MBB_09_MISSING" 16497680 "DTC_MBB_10_MISSING" 16497681 "DTC_MBB_11_MISSING" 16497682 "DTC_MBB_12_MISSING" 16497683 "DTC_MBB_13_MISSING" 16497684 "DTC_MBB_14_MISSING" 16497685 "DTC_MBB_15_MISSING" 16497686 "DTC_MBB_16_MISSING" 16497687 "DTC_MBB_17_MISSING" 16497688 "DTC_MBB_18_MISSING" 16497689 "DTC_MBB_19_MISSING" 16497696 "DTC_MBB_20_MISSING" 16497697 "DTC_MBB_21_MISSING" 16497698 "DTC_MBB_22_MISSING" 16497699 "DTC_MBB_23_MISSING" 16497700 "DTC_MBB_24_MISSING" 16498177 "DTC_MBB_01_VFAULT" 16498178 "DTC_MBB_02_VFAULT" 16498179 "DTC_MBB_03_VFAULT" 16498180 "DTC_MBB_04_VFAULT" 16498181 "DTC_MBB_05_VFAULT" 16498182 "DTC_MBB_06_VFAULT" 16498183 "DTC_MBB_07_VFAULT" 16498184 "DTC_MBB_08_VFAULT" 16498185 "DTC_MBB_09_VFAULT" 16498192 "DTC_MBB_10_VFAULT" 16498193 "DTC_MBB_11_VFAULT" 16498194 "DTC_MBB_12_VFAULT" 16498195 "DTC_MBB_13_VFAULT" 16498196 "DTC_MBB_14_VFAULT" 16498197 "DTC_MBB_15_VFAULT" 16498198 "DTC_MBB_16_VFAULT" 16498199 "DTC_MBB_17_VFAULT" 16498200 "DTC_MBB_18_VFAULT" 16498201 "DTC_MBB_19_VFAULT" 16498208 "DTC_MBB_20_VFAULT" 16498209 "DTC_MBB_21_VFAULT" 16498210 "DTC_MBB_22_VFAULT" 16498211 "DTC_MBB_23_VFAULT" 16498212 "DTC_MBB_24_VFAULT" 16497921 "DTC_MBB_01_TFAULT" 16497922 "DTC_MBB_02_TFAULT" 16497923 "DTC_MBB_03_TFAULT" 16497924 "DTC_MBB_04_TFAULT" 16497925 "DTC_MBB_05_TFAULT" 16497926 "DTC_MBB_06_TFAULT" 16497927 "DTC_MBB_07_TFAULT" 16497928 "DTC_MBB_08_TFAULT" 16497929 "DTC_MBB_09_TFAULT" 16497936 "DTC_MBB_10_TFAULT" 16497937 "DTC_MBB_11_TFAULT" 16497938 "DTC_MBB_12_TFAULT" 16497939 "DTC_MBB_13_TFAULT" 16497940 "DTC_MBB_14_TFAULT" 16497941 "DTC_MBB_15_TFAULT" 16497942 "DTC_MBB_16_TFAULT" 16497943 "DTC_MBB_17_TFAULT" 16497944 "DTC_MBB_18_TFAULT" 16497945 "DTC_MBB_19_TFAULT" 16497952 "DTC_MBB_20_TFAULT" 16497953 "DTC_MBB_21_TFAULT" 16497954 "DTC_MBB_22_TFAULT" 16497955 "DTC_MBB_23_TFAULT" 16497956 "DTC_MBB_24_TFAULT" 15785984 "DTC_PRECHARGE_ENERGY" 15785985 "DTC_PRT_FAILED" 15785986 "DTC_PRT_OVERTEMP" 15785987 "DTC_PRT_PROHIBIT" 16556032 "DTC_COOLANT_TEMP_OOR_HI" 16556033 "DTC_COOLANT_TEMP_OOR_LO" 16252928 "DTC_KEY_OFF_TIME_ERROR" 16506880 "DTC_VBAT_MISMATCH" 16506881 "DTC_VBAT_VMAX" 16506882 "DTC_VBAT_VMIN" 16506883 "DTC_PACK_FUSE" 15798544 "DTC_LLS1_OOR_HI" 15798545 "DTC_LLS1_OOR_LO" 15798546 "DTC_LLS1_FAULT" 15798816 "DTC_LLS2_OOR_HI" 15798817 "DTC_LLS2_OOR_LO" 15798818 "DTC_LLS2_FAULT" 14479360 "DTC_CFL_HEARTBEAT" 14479361 "DTC_CFL_FAULT" 14479362 "DTC_CFL_FAULT_LATCH" 13635584 "DTC_CONT_A_FAILED_HI" 13635585 "DTC_CONT_A_FAILED_LO" 13635586 "DTC_CONT_B_FAILED_HI" 13635587 "DTC_CONT_B_FAILED_LO" 13635588 "DTC_CONT_C_FAILED_HI" 13635589 "DTC_CONT_C_FAILED_LO" 13635590 "DTC_CONT_D_FAILED_HI" 13635591 "DTC_CONT_D_FAILED_LO" 13635592 "DTC_CONT_E_FAILED_HI" 13635593 "DTC_CONT_E_FAILED_LO" 13635594 "DTC_CONT_F_FAILED_HI" 13635595 "DTC_CONT_F_FAILED_LO" 13635596 "DTC_CONT_G_FAILED_HI" 13635597 "DTC_CONT_G_FAILED_LO" 13635598 "DTC_LSD_A_FAILED_HI" 13635599 "DTC_LSD_A_FAILED_LO" 13635600 "DTC_LSD_B_FAILED_HI" 13635601 "DTC_LSD_B_FAILED_LO" 13635602 "DTC_LSD_C_FAILED_HI" 13635603 "DTC_LSD_C_FAILED_LO" 13635606 "DTC_CONT_PWR_FAILED_HI" 13635607 "DTC_CONT_PWR_FAILED_LO" 13635608 "DTC_LSD_PUMP_FAILED_HI" 13635609 "DTC_LSD_PUMP_FAILED_LO" 13635610 "DTC_CHG_A_ENABLE_FAILED_HI" 13635611 "DTC_CHG_A_ENABLE_FAILED_LO" 13635612 "DTC_CHG_B_ENABLE_FAILED_HI" 13635613 "DTC_CHG_B_ENABLE_FAILED_LO" 13635614 "DTC_SW14V_PWR_FAILED_HI" 13635615 "DTC_SW14V_PWR_FAILED_LO" 13635620 "DTC_HSD_A_FAILED_HI" 13635621 "DTC_HSD_A_FAILED_LO" 13635622 "DTC_HSD_B_FAILED_HI" 13635623 "DTC_HSD_B_FAILED_LO" 13692968 "DTC_CONT_HPWR_FAILED_HI" 13692969 "DTC_CONT_HPWR_FAILED_LO" 13692970 "DTC_CONT_HPWR_OOR_HI" 13692971 "DTC_CONT_HPWR_OOR_LO" 13635616 "DTC_5V_PWR_OOR_HI" 13635617 "DTC_5V_PWR_OOR_LO" 14606336 "DTC_NVM_WRITE_TO" 14606337 "DTC_NVM_READ_TO" 14614528 "DTC_SPI_DIG_POT_FAULT" ;
VAL_ 1120 bcm_dtc_067 0 " - " 11276288 "DTC_VEPO" 11276289 "DTC_HSC_MISSING" 11460608 "DTC_NVM_SOC" 11460609 "DTC_NVM_KOT" 11460610 "DTC_NVM_DTC" 11460611 "DTC_NVM_SOC_CORRECTION" 11460612 "DTC_NVM_APP_SCRATCHPAD" 11517962 "DTC_LOOPTIME_TASK_A" 11517963 "DTC_LOOPTIME_TASK_B" 11517964 "DTC_LOOPTIME_TASK_C" 11517965 "DTC_LOOPTIME_TASK_D" 11517966 "DTC_LOOPTIME_TASK_E" 11517967 "DTC_LOOPTIME_TASK_F" 11323904 "DTC_INTERLOCK_A_FAILED_LOW" 11323905 "DTC_INTERLOCK_A_FAILED_HIGH" 11324160 "DTC_INTERLOCK_B_FAILED_LOW" 11324161 "DTC_INTERLOCK_B_FAILED_HIGH" 15728640 "DTC_EPO" 16498688 "DTC_BRUSA_MISSING" 16498689 "DTC_BRUSA_IDC" 16498690 "DTC_BRUSA_REQ_VS_CMD" 16433152 "DTC_AKERWADE_MISSING" 16433153 "DTC_AKERWADE_IDC" 16433154 "DTC_AKERWADE_REQ_VS_CMD" 16564224 "DTC_CHGLEAR_MISSING" 16564225 "DTC_CHGLEAR_IDC" 16564226 "DTC_CHGLEAR_REQ_VS_CMD" 16522240 "DTC_CSM_MISSING" 16522752 "DTC_CSM_VBAT" 16522753 "DTC_CSM_VPOS" 16522754 "DTC_CSM_VNEG" 16522755 "DTC_CSM_CPOS" 16522756 "DTC_CSM_CNEG" 16522757 "DTC_CSM_APOS" 16522758 "DTC_CSM_ANEG" 16522759 "DTC_CSM_FUSE_HI" 16522760 "DTC_CSM_FUSE_LO" 16521728 "DTC_CSM_ASIC" 16521729 "DTC_CSM_AILO" 16521730 "DTC_CSM_AIHI" 16520957 "DTC_LEAKAGE_DETECT_FAULT" 16522444 "DTC_REALTIMECLOCK_FAULT" 16520945 "DTC_CSM_LEAK_FAIL_CALC" 16520946 "DTC_CSM_LEAK_FAIL_HW" 16520947 "DTC_CSM_LEAK_EXT_SHORT" 16520948 "DTC_CSM_LEAK_MID_PACK_SHORT" 16520949 "DTC_CSM_LEAK_ERROR" 16520950 "DTC_CSM_LEAK_UNKNOWN" 16523008 "DTC_CSM_VER_MISMATCH" 16523009 "DTC_CSM_DTC_SET" 16523010 "DTC_CSM_CAL_FAULT" 16560128 "DTC_IBAT_MISMATCH" 16576512 "DTC_DIS_MAX_I2T" 16576513 "DTC_CHG_MAX_I2T" 16576768 "DTC_DIS_WARNING_I2T" 16576769 "DTC_CHG_WARNING_I2T" 11296784 "DTC_SAEJ1772_PROX_DECT_OOR_HI" 11296785 "DTC_SAEJ1772_PROX_DECT_OOR_LO" 11296800 "DTC_SAEJ1772_PILOT_PWM_OOR_HI" 11296801 "DTC_SAEJ1772_PILOT_PWM_OOR_LO" 11296802 "DTC_SAEJ1772_PILOT_PWM_DIG_COMM" 11296803 "DTC_SAEJ1772_PILOT_PWM_IR_ERR" 16175360 "DTC_FGD1_NO_SENSOR" 16175361 "DTC_FGD1_OOR_HI" 16175362 "DTC_FGD1_OOR_LO" 16175363 "DTC_FGD1_FAULT" 16175616 "DTC_FGD2_NO_SENSOR" 16175617 "DTC_FGD2_OOR_HI" 16175618 "DTC_FGD2_OOR_LO" 16175619 "DTC_FGD2_FAULT" 16171008 "DTC_CONT_OPEN" 16171009 "DTC_CONT_CLOSE" 16171010 "DTC_CONT_OPEN_CURRENT" 16171264 "DTC_CONT_CLOSE_ON_RESET" 16171265 "DTC_CONT_CLOSE_SIG_FAILED" 16171520 "DTC_PRECHARGE_TIMEOUT" 16171777 "DTC_CONT_MPOS_WELD_AT_SU" 16171778 "DTC_CONT_MNEG_WELD_AT_SU" 16171780 "DTC_CONT_CPOS_WELD_AT_SU" 16171781 "DTC_CONT_CNEG_WELD_AT_SU" 16171782 "DTC_CONT_ANEG_WELD_AT_SU" 16171783 "DTC_CONT_APOS_WELD_AT_SU" 16172033 "DTC_CONT_MPOS_WELD_AT_SD" 16172034 "DTC_CONT_MNEG_WELD_AT_SD" 16172036 "DTC_CONT_CPOS_WELD_AT_SD" 16172037 "DTC_CONT_CNEG_WELD_AT_SD" 16172038 "DTC_CONT_ANEG_WELD_AT_SD" 16172039 "DTC_CONT_APOS_WELD_AT_SD" 16172289 "DTC_CONT_MPOS_OPEN" 16172290 "DTC_CONT_MNEG_OPEN" 16172291 "DTC_CONT_MPRE_OPEN" 16172292 "DTC_CONT_CPOS_OPEN" 16172293 "DTC_CONT_CNEG_OPEN" 16172294 "DTC_CONT_APOS_OPEN" 16172295 "DTC_CONT_ANEG_OPEN" 16172545 "DTC_CONT_MPOS_VDIF" 16172546 "DTC_CONT_MNEG_VDIF" 16172548 "DTC_CONT_CPOS_VDIF" 16172549 "DTC_CONT_CNEG_VDIF" 16172550 "DTC_CONT_APOS_VDIF" 16172551 "DTC_CONT_ANEG_VDIF" 16174848 "DTC_HVIL" 16174849 "DTC_LVBAT_LO" 16174850 "DTC_LVBAT_HI" 16174851 "DTC_LVBAT_ERR" 16523520 "DTC_LEMLO_OOR_HI" 16523521 "DTC_LEMLO_OOR_LO" 16523522 "DTC_LEMLO_FAULT" 16523776 "DTC_LEMHI_OOR_HI" 16523777 "DTC_LEMHI_OOR_LO" 16523778 "DTC_LEMHI_FAULT" 16496320 "DTC_MBB_TOO_FEW" 16496321 "DTC_MBB_TOO_MANY" 16496352 "DTC_CELL_VMAX_ERR" 16496353 "DTC_CELL_VMIN_ERR" 16496354 "DTC_CELL_VMAX" 16496362 "DTC_CELL_VMAX_SEVERE" 16496355 "DTC_CELL_VMIN" 16496363 "DTC_CELL_VMIN_SEVERE" 16496356 "DTC_MOD_VOLTAGE_COMPARE" 16496336 "DTC_CELL_T_ERR" 16496337 "DTC_CELL_TMAX1" 16496338 "DTC_CELL_TMAX2" 16496339 "DTC_CELL_TMIN" 16497665 "DTC_MBB_01_MISSING" 16497666 "DTC_MBB_02_MISSING" 16497667 "DTC_MBB_03_MISSING" 16497668 "DTC_MBB_04_MISSING" 16497669 "DTC_MBB_05_MISSING" 16497670 "DTC_MBB_06_MISSING" 16497671 "DTC_MBB_07_MISSING" 16497672 "DTC_MBB_08_MISSING" 16497673 "DTC_MBB_09_MISSING" 16497680 "DTC_MBB_10_MISSING" 16497681 "DTC_MBB_11_MISSING" 16497682 "DTC_MBB_12_MISSING" 16497683 "DTC_MBB_13_MISSING" 16497684 "DTC_MBB_14_MISSING" 16497685 "DTC_MBB_15_MISSING" 16497686 "DTC_MBB_16_MISSING" 16497687 "DTC_MBB_17_MISSING" 16497688 "DTC_MBB_18_MISSING" 16497689 "DTC_MBB_19_MISSING" 16497696 "DTC_MBB_20_MISSING" 16497697 "DTC_MBB_21_MISSING" 16497698 "DTC_MBB_22_MISSING" 16497699 "DTC_MBB_23_MISSING" 16497700 "DTC_MBB_24_MISSING" 16498177 "DTC_MBB_01_VFAULT" 16498178 "DTC_MBB_02_VFAULT" 16498179 "DTC_MBB_03_VFAULT" 16498180 "DTC_MBB_04_VFAULT" 16498181 "DTC_MBB_05_VFAULT" 16498182 "DTC_MBB_06_VFAULT" 16498183 "DTC_MBB_07_VFAULT" 16498184 "DTC_MBB_08_VFAULT" 16498185 "DTC_MBB_09_VFAULT" 16498192 "DTC_MBB_10_VFAULT" 16498193 "DTC_MBB_11_VFAULT" 16498194 "DTC_MBB_12_VFAULT" 16498195 "DTC_MBB_13_VFAULT" 16498196 "DTC_MBB_14_VFAULT" 16498197 "DTC_MBB_15_VFAULT" 16498198 "DTC_MBB_16_VFAULT" 16498199 "DTC_MBB_17_VFAULT" 16498200 "DTC_MBB_18_VFAULT" 16498201 "DTC_MBB_19_VFAULT" 16498208 "DTC_MBB_20_VFAULT" 16498209 "DTC_MBB_21_VFAULT" 16498210 "DTC_MBB_22_VFAULT" 16498211 "DTC_MBB_23_VFAULT" 16498212 "DTC_MBB_24_VFAULT" 16497921 "DTC_MBB_01_TFAULT" 16497922 "DTC_MBB_02_TFAULT" 16497923 "DTC_MBB_03_TFAULT" 16497924 "DTC_MBB_04_TFAULT" 16497925 "DTC_MBB_05_TFAULT" 16497926 "DTC_MBB_06_TFAULT" 16497927 "DTC_MBB_07_TFAULT" 16497928 "DTC_MBB_08_TFAULT" 16497929 "DTC_MBB_09_TFAULT" 16497936 "DTC_MBB_10_TFAULT" 16497937 "DTC_MBB_11_TFAULT" 16497938 "DTC_MBB_12_TFAULT" 16497939 "DTC_MBB_13_TFAULT" 16497940 "DTC_MBB_14_TFAULT" 16497941 "DTC_MBB_15_TFAULT" 16497942 "DTC_MBB_16_TFAULT" 16497943 "DTC_MBB_17_TFAULT" 16497944 "DTC_MBB_18_TFAULT" 16497945 "DTC_MBB_19_TFAULT" 16497952 "DTC_MBB_20_TFAULT" 16497953 "DTC_MBB_21_TFAULT" 16497954 "DTC_MBB_22_TFAULT" 16497955 "DTC_MBB_23_TFAULT" 16497956 "DTC_MBB_24_TFAULT" 15785984 "DTC_PRECHARGE_ENERGY" 15785985 "DTC_PRT_FAILED" 15785986 "DTC_PRT_OVERTEMP" 15785987 "DTC_PRT_PROHIBIT" 16556032 "DTC_COOLANT_TEMP_OOR_HI" 16556033 "DTC_COOLANT_TEMP_OOR_LO" 16252928 "DTC_KEY_OFF_TIME_ERROR" 16506880 "DTC_VBAT_MISMATCH" 16506881 "DTC_VBAT_VMAX" 16506882 "DTC_VBAT_VMIN" 16506883 "DTC_PACK_FUSE" 15798544 "DTC_LLS1_OOR_HI" 15798545 "DTC_LLS1_OOR_LO" 15798546 "DTC_LLS1_FAULT" 15798816 "DTC_LLS2_OOR_HI" 15798817 "DTC_LLS2_OOR_LO" 15798818 "DTC_LLS2_FAULT" 14479360 "DTC_CFL_HEARTBEAT" 14479361 "DTC_CFL_FAULT" 14479362 "DTC_CFL_FAULT_LATCH" 13635584 "DTC_CONT_A_FAILED_HI" 13635585 "DTC_CONT_A_FAILED_LO" 13635586 "DTC_CONT_B_FAILED_HI" 13635587 "DTC_CONT_B_FAILED_LO" 13635588 "DTC_CONT_C_FAILED_HI" 13635589 "DTC_CONT_C_FAILED_LO" 13635590 "DTC_CONT_D_FAILED_HI" 13635591 "DTC_CONT_D_FAILED_LO" 13635592 "DTC_CONT_E_FAILED_HI" 13635593 "DTC_CONT_E_FAILED_LO" 13635594 "DTC_CONT_F_FAILED_HI" 13635595 "DTC_CONT_F_FAILED_LO" 13635596 "DTC_CONT_G_FAILED_HI" 13635597 "DTC_CONT_G_FAILED_LO" 13635598 "DTC_LSD_A_FAILED_HI" 13635599 "DTC_LSD_A_FAILED_LO" 13635600 "DTC_LSD_B_FAILED_HI" 13635601 "DTC_LSD_B_FAILED_LO" 13635602 "DTC_LSD_C_FAILED_HI" 13635603 "DTC_LSD_C_FAILED_LO" 13635606 "DTC_CONT_PWR_FAILED_HI" 13635607 "DTC_CONT_PWR_FAILED_LO" 13635608 "DTC_LSD_PUMP_FAILED_HI" 13635609 "DTC_LSD_PUMP_FAILED_LO" 13635610 "DTC_CHG_A_ENABLE_FAILED_HI" 13635611 "DTC_CHG_A_ENABLE_FAILED_LO" 13635612 "DTC_CHG_B_ENABLE_FAILED_HI" 13635613 "DTC_CHG_B_ENABLE_FAILED_LO" 13635614 "DTC_SW14V_PWR_FAILED_HI" 13635615 "DTC_SW14V_PWR_FAILED_LO" 13635620 "DTC_HSD_A_FAILED_HI" 13635621 "DTC_HSD_A_FAILED_LO" 13635622 "DTC_HSD_B_FAILED_HI" 13635623 "DTC_HSD_B_FAILED_LO" 13692968 "DTC_CONT_HPWR_FAILED_HI" 13692969 "DTC_CONT_HPWR_FAILED_LO" 13692970 "DTC_CONT_HPWR_OOR_HI" 13692971 "DTC_CONT_HPWR_OOR_LO" 13635616 "DTC_5V_PWR_OOR_HI" 13635617 "DTC_5V_PWR_OOR_LO" 14606336 "DTC_NVM_WRITE_TO" 14606337 "DTC_NVM_READ_TO" 14614528 "DTC_SPI_DIG_POT_FAULT" ;
VAL_ 1120 bcm_dtc_068 0 " - " 11276288 "DTC_VEPO" 11276289 "DTC_HSC_MISSING" 11460608 "DTC_NVM_SOC" 11460609 "DTC_NVM_KOT" 11460610 "DTC_NVM_DTC" 11460611 "DTC_NVM_SOC_CORRECTION" 11460612 "DTC_NVM_APP_SCRATCHPAD" 11517962 "DTC_LOOPTIME_TASK_A" 11517963 "DTC_LOOPTIME_TASK_B" 11517964 "DTC_LOOPTIME_TASK_C" 11517965 "DTC_LOOPTIME_TASK_D" 11517966 "DTC_LOOPTIME_TASK_E" 11517967 "DTC_LOOPTIME_TASK_F" 11323904 "DTC_INTERLOCK_A_FAILED_LOW" 11323905 "DTC_INTERLOCK_A_FAILED_HIGH" 11324160 "DTC_INTERLOCK_B_FAILED_LOW" 11324161 "DTC_INTERLOCK_B_FAILED_HIGH" 15728640 "DTC_EPO" 16498688 "DTC_BRUSA_MISSING" 16498689 "DTC_BRUSA_IDC" 16498690 "DTC_BRUSA_REQ_VS_CMD" 16433152 "DTC_AKERWADE_MISSING" 16433153 "DTC_AKERWADE_IDC" 16433154 "DTC_AKERWADE_REQ_VS_CMD" 16564224 "DTC_CHGLEAR_MISSING" 16564225 "DTC_CHGLEAR_IDC" 16564226 "DTC_CHGLEAR_REQ_VS_CMD" 16522240 "DTC_CSM_MISSING" 16522752 "DTC_CSM_VBAT" 16522753 "DTC_CSM_VPOS" 16522754 "DTC_CSM_VNEG" 16522755 "DTC_CSM_CPOS" 16522756 "DTC_CSM_CNEG" 16522757 "DTC_CSM_APOS" 16522758 "DTC_CSM_ANEG" 16522759 "DTC_CSM_FUSE_HI" 16522760 "DTC_CSM_FUSE_LO" 16521728 "DTC_CSM_ASIC" 16521729 "DTC_CSM_AILO" 16521730 "DTC_CSM_AIHI" 16520957 "DTC_LEAKAGE_DETECT_FAULT" 16522444 "DTC_REALTIMECLOCK_FAULT" 16520945 "DTC_CSM_LEAK_FAIL_CALC" 16520946 "DTC_CSM_LEAK_FAIL_HW" 16520947 "DTC_CSM_LEAK_EXT_SHORT" 16520948 "DTC_CSM_LEAK_MID_PACK_SHORT" 16520949 "DTC_CSM_LEAK_ERROR" 16520950 "DTC_CSM_LEAK_UNKNOWN" 16523008 "DTC_CSM_VER_MISMATCH" 16523009 "DTC_CSM_DTC_SET" 16523010 "DTC_CSM_CAL_FAULT" 16560128 "DTC_IBAT_MISMATCH" 16576512 "DTC_DIS_MAX_I2T" 16576513 "DTC_CHG_MAX_I2T" 16576768 "DTC_DIS_WARNING_I2T" 16576769 "DTC_CHG_WARNING_I2T" 11296784 "DTC_SAEJ1772_PROX_DECT_OOR_HI" 11296785 "DTC_SAEJ1772_PROX_DECT_OOR_LO" 11296800 "DTC_SAEJ1772_PILOT_PWM_OOR_HI" 11296801 "DTC_SAEJ1772_PILOT_PWM_OOR_LO" 11296802 "DTC_SAEJ1772_PILOT_PWM_DIG_COMM" 11296803 "DTC_SAEJ1772_PILOT_PWM_IR_ERR" 16175360 "DTC_FGD1_NO_SENSOR" 16175361 "DTC_FGD1_OOR_HI" 16175362 "DTC_FGD1_OOR_LO" 16175363 "DTC_FGD1_FAULT" 16175616 "DTC_FGD2_NO_SENSOR" 16175617 "DTC_FGD2_OOR_HI" 16175618 "DTC_FGD2_OOR_LO" 16175619 "DTC_FGD2_FAULT" 16171008 "DTC_CONT_OPEN" 16171009 "DTC_CONT_CLOSE" 16171010 "DTC_CONT_OPEN_CURRENT" 16171264 "DTC_CONT_CLOSE_ON_RESET" 16171265 "DTC_CONT_CLOSE_SIG_FAILED" 16171520 "DTC_PRECHARGE_TIMEOUT" 16171777 "DTC_CONT_MPOS_WELD_AT_SU" 16171778 "DTC_CONT_MNEG_WELD_AT_SU" 16171780 "DTC_CONT_CPOS_WELD_AT_SU" 16171781 "DTC_CONT_CNEG_WELD_AT_SU" 16171782 "DTC_CONT_ANEG_WELD_AT_SU" 16171783 "DTC_CONT_APOS_WELD_AT_SU" 16172033 "DTC_CONT_MPOS_WELD_AT_SD" 16172034 "DTC_CONT_MNEG_WELD_AT_SD" 16172036 "DTC_CONT_CPOS_WELD_AT_SD" 16172037 "DTC_CONT_CNEG_WELD_AT_SD" 16172038 "DTC_CONT_ANEG_WELD_AT_SD" 16172039 "DTC_CONT_APOS_WELD_AT_SD" 16172289 "DTC_CONT_MPOS_OPEN" 16172290 "DTC_CONT_MNEG_OPEN" 16172291 "DTC_CONT_MPRE_OPEN" 16172292 "DTC_CONT_CPOS_OPEN" 16172293 "DTC_CONT_CNEG_OPEN" 16172294 "DTC_CONT_APOS_OPEN" 16172295 "DTC_CONT_ANEG_OPEN" 16172545 "DTC_CONT_MPOS_VDIF" 16172546 "DTC_CONT_MNEG_VDIF" 16172548 "DTC_CONT_CPOS_VDIF" 16172549 "DTC_CONT_CNEG_VDIF" 16172550 "DTC_CONT_APOS_VDIF" 16172551 "DTC_CONT_ANEG_VDIF" 16174848 "DTC_HVIL" 16174849 "DTC_LVBAT_LO" 16174850 "DTC_LVBAT_HI" 16174851 "DTC_LVBAT_ERR" 16523520 "DTC_LEMLO_OOR_HI" 16523521 "DTC_LEMLO_OOR_LO" 16523522 "DTC_LEMLO_FAULT" 16523776 "DTC_LEMHI_OOR_HI" 16523777 "DTC_LEMHI_OOR_LO" 16523778 "DTC_LEMHI_FAULT" 16496320 "DTC_MBB_TOO_FEW" 16496321 "DTC_MBB_TOO_MANY" 16496352 "DTC_CELL_VMAX_ERR" 16496353 "DTC_CELL_VMIN_ERR" 16496354 "DTC_CELL_VMAX" 16496362 "DTC_CELL_VMAX_SEVERE" 16496355 "DTC_CELL_VMIN" 16496363 "DTC_CELL_VMIN_SEVERE" 16496356 "DTC_MOD_VOLTAGE_COMPARE" 16496336 "DTC_CELL_T_ERR" 16496337 "DTC_CELL_TMAX1" 16496338 "DTC_CELL_TMAX2" 16496339 "DTC_CELL_TMIN" 16497665 "DTC_MBB_01_MISSING" 16497666 "DTC_MBB_02_MISSING" 16497667 "DTC_MBB_03_MISSING" 16497668 "DTC_MBB_04_MISSING" 16497669 "DTC_MBB_05_MISSING" 16497670 "DTC_MBB_06_MISSING" 16497671 "DTC_MBB_07_MISSING" 16497672 "DTC_MBB_08_MISSING" 16497673 "DTC_MBB_09_MISSING" 16497680 "DTC_MBB_10_MISSING" 16497681 "DTC_MBB_11_MISSING" 16497682 "DTC_MBB_12_MISSING" 16497683 "DTC_MBB_13_MISSING" 16497684 "DTC_MBB_14_MISSING" 16497685 "DTC_MBB_15_MISSING" 16497686 "DTC_MBB_16_MISSING" 16497687 "DTC_MBB_17_MISSING" 16497688 "DTC_MBB_18_MISSING" 16497689 "DTC_MBB_19_MISSING" 16497696 "DTC_MBB_20_MISSING" 16497697 "DTC_MBB_21_MISSING" 16497698 "DTC_MBB_22_MISSING" 16497699 "DTC_MBB_23_MISSING" 16497700 "DTC_MBB_24_MISSING" 16498177 "DTC_MBB_01_VFAULT" 16498178 "DTC_MBB_02_VFAULT" 16498179 "DTC_MBB_03_VFAULT" 16498180 "DTC_MBB_04_VFAULT" 16498181 "DTC_MBB_05_VFAULT" 16498182 "DTC_MBB_06_VFAULT" 16498183 "DTC_MBB_07_VFAULT" 16498184 "DTC_MBB_08_VFAULT" 16498185 "DTC_MBB_09_VFAULT" 16498192 "DTC_MBB_10_VFAULT" 16498193 "DTC_MBB_11_VFAULT" 16498194 "DTC_MBB_12_VFAULT" 16498195 "DTC_MBB_13_VFAULT" 16498196 "DTC_MBB_14_VFAULT" 16498197 "DTC_MBB_15_VFAULT" 16498198 "DTC_MBB_16_VFAULT" 16498199 "DTC_MBB_17_VFAULT" 16498200 "DTC_MBB_18_VFAULT" 16498201 "DTC_MBB_19_VFAULT" 16498208 "DTC_MBB_20_VFAULT" 16498209 "DTC_MBB_21_VFAULT" 16498210 "DTC_MBB_22_VFAULT" 16498211 "DTC_MBB_23_VFAULT" 16498212 "DTC_MBB_24_VFAULT" 16497921 "DTC_MBB_01_TFAULT" 16497922 "DTC_MBB_02_TFAULT" 16497923 "DTC_MBB_03_TFAULT" 16497924 "DTC_MBB_04_TFAULT" 16497925 "DTC_MBB_05_TFAULT" 16497926 "DTC_MBB_06_TFAULT" 16497927 "DTC_MBB_07_TFAULT" 16497928 "DTC_MBB_08_TFAULT" 16497929 "DTC_MBB_09_TFAULT" 16497936 "DTC_MBB_10_TFAULT" 16497937 "DTC_MBB_11_TFAULT" 16497938 "DTC_MBB_12_TFAULT" 16497939 "DTC_MBB_13_TFAULT" 16497940 "DTC_MBB_14_TFAULT" 16497941 "DTC_MBB_15_TFAULT" 16497942 "DTC_MBB_16_TFAULT" 16497943 "DTC_MBB_17_TFAULT" 16497944 "DTC_MBB_18_TFAULT" 16497945 "DTC_MBB_19_TFAULT" 16497952 "DTC_MBB_20_TFAULT" 16497953 "DTC_MBB_21_TFAULT" 16497954 "DTC_MBB_22_TFAULT" 16497955 "DTC_MBB_23_TFAULT" 16497956 "DTC_MBB_24_TFAULT" 15785984 "DTC_PRECHARGE_ENERGY" 15785985 "DTC_PRT_FAILED" 15785986 "DTC_PRT_OVERTEMP" 15785987 "DTC_PRT_PROHIBIT" 16556032 "DTC_COOLANT_TEMP_OOR_HI" 16556033 "DTC_COOLANT_TEMP_OOR_LO" 16252928 "DTC_KEY_OFF_TIME_ERROR" 16506880 "DTC_VBAT_MISMATCH" 16506881 "DTC_VBAT_VMAX" 16506882 "DTC_VBAT_VMIN" 16506883 "DTC_PACK_FUSE" 15798544 "DTC_LLS1_OOR_HI" 15798545 "DTC_LLS1_OOR_LO" 15798546 "DTC_LLS1_FAULT" 15798816 "DTC_LLS2_OOR_HI" 15798817 "DTC_LLS2_OOR_LO" 15798818 "DTC_LLS2_FAULT" 14479360 "DTC_CFL_HEARTBEAT" 14479361 "DTC_CFL_FAULT" 14479362 "DTC_CFL_FAULT_LATCH" 13635584 "DTC_CONT_A_FAILED_HI" 13635585 "DTC_CONT_A_FAILED_LO" 13635586 "DTC_CONT_B_FAILED_HI" 13635587 "DTC_CONT_B_FAILED_LO" 13635588 "DTC_CONT_C_FAILED_HI" 13635589 "DTC_CONT_C_FAILED_LO" 13635590 "DTC_CONT_D_FAILED_HI" 13635591 "DTC_CONT_D_FAILED_LO" 13635592 "DTC_CONT_E_FAILED_HI" 13635593 "DTC_CONT_E_FAILED_LO" 13635594 "DTC_CONT_F_FAILED_HI" 13635595 "DTC_CONT_F_FAILED_LO" 13635596 "DTC_CONT_G_FAILED_HI" 13635597 "DTC_CONT_G_FAILED_LO" 13635598 "DTC_LSD_A_FAILED_HI" 13635599 "DTC_LSD_A_FAILED_LO" 13635600 "DTC_LSD_B_FAILED_HI" 13635601 "DTC_LSD_B_FAILED_LO" 13635602 "DTC_LSD_C_FAILED_HI" 13635603 "DTC_LSD_C_FAILED_LO" 13635606 "DTC_CONT_PWR_FAILED_HI" 13635607 "DTC_CONT_PWR_FAILED_LO" 13635608 "DTC_LSD_PUMP_FAILED_HI" 13635609 "DTC_LSD_PUMP_FAILED_LO" 13635610 "DTC_CHG_A_ENABLE_FAILED_HI" 13635611 "DTC_CHG_A_ENABLE_FAILED_LO" 13635612 "DTC_CHG_B_ENABLE_FAILED_HI" 13635613 "DTC_CHG_B_ENABLE_FAILED_LO" 13635614 "DTC_SW14V_PWR_FAILED_HI" 13635615 "DTC_SW14V_PWR_FAILED_LO" 13635620 "DTC_HSD_A_FAILED_HI" 13635621 "DTC_HSD_A_FAILED_LO" 13635622 "DTC_HSD_B_FAILED_HI" 13635623 "DTC_HSD_B_FAILED_LO" 13692968 "DTC_CONT_HPWR_FAILED_HI" 13692969 "DTC_CONT_HPWR_FAILED_LO" 13692970 "DTC_CONT_HPWR_OOR_HI" 13692971 "DTC_CONT_HPWR_OOR_LO" 13635616 "DTC_5V_PWR_OOR_HI" 13635617 "DTC_5V_PWR_OOR_LO" 14606336 "DTC_NVM_WRITE_TO" 14606337 "DTC_NVM_READ_TO" 14614528 "DTC_SPI_DIG_POT_FAULT" ;
VAL_ 1120 bcm_dtc_069 0 " - " 11276288 "DTC_VEPO" 11276289 "DTC_HSC_MISSING" 11460608 "DTC_NVM_SOC" 11460609 "DTC_NVM_KOT" 11460610 "DTC_NVM_DTC" 11460611 "DTC_NVM_SOC_CORRECTION" 11460612 "DTC_NVM_APP_SCRATCHPAD" 11517962 "DTC_LOOPTIME_TASK_A" 11517963 "DTC_LOOPTIME_TASK_B" 11517964 "DTC_LOOPTIME_TASK_C" 11517965 "DTC_LOOPTIME_TASK_D" 11517966 "DTC_LOOPTIME_TASK_E" 11517967 "DTC_LOOPTIME_TASK_F" 11323904 "DTC_INTERLOCK_A_FAILED_LOW" 11323905 "DTC_INTERLOCK_A_FAILED_HIGH" 11324160 "DTC_INTERLOCK_B_FAILED_LOW" 11324161 "DTC_INTERLOCK_B_FAILED_HIGH" 15728640 "DTC_EPO" 16498688 "DTC_BRUSA_MISSING" 16498689 "DTC_BRUSA_IDC" 16498690 "DTC_BRUSA_REQ_VS_CMD" 16433152 "DTC_AKERWADE_MISSING" 16433153 "DTC_AKERWADE_IDC" 16433154 "DTC_AKERWADE_REQ_VS_CMD" 16564224 "DTC_CHGLEAR_MISSING" 16564225 "DTC_CHGLEAR_IDC" 16564226 "DTC_CHGLEAR_REQ_VS_CMD" 16522240 "DTC_CSM_MISSING" 16522752 "DTC_CSM_VBAT" 16522753 "DTC_CSM_VPOS" 16522754 "DTC_CSM_VNEG" 16522755 "DTC_CSM_CPOS" 16522756 "DTC_CSM_CNEG" 16522757 "DTC_CSM_APOS" 16522758 "DTC_CSM_ANEG" 16522759 "DTC_CSM_FUSE_HI" 16522760 "DTC_CSM_FUSE_LO" 16521728 "DTC_CSM_ASIC" 16521729 "DTC_CSM_AILO" 16521730 "DTC_CSM_AIHI" 16520957 "DTC_LEAKAGE_DETECT_FAULT" 16522444 "DTC_REALTIMECLOCK_FAULT" 16520945 "DTC_CSM_LEAK_FAIL_CALC" 16520946 "DTC_CSM_LEAK_FAIL_HW" 16520947 "DTC_CSM_LEAK_EXT_SHORT" 16520948 "DTC_CSM_LEAK_MID_PACK_SHORT" 16520949 "DTC_CSM_LEAK_ERROR" 16520950 "DTC_CSM_LEAK_UNKNOWN" 16523008 "DTC_CSM_VER_MISMATCH" 16523009 "DTC_CSM_DTC_SET" 16523010 "DTC_CSM_CAL_FAULT" 16560128 "DTC_IBAT_MISMATCH" 16576512 "DTC_DIS_MAX_I2T" 16576513 "DTC_CHG_MAX_I2T" 16576768 "DTC_DIS_WARNING_I2T" 16576769 "DTC_CHG_WARNING_I2T" 11296784 "DTC_SAEJ1772_PROX_DECT_OOR_HI" 11296785 "DTC_SAEJ1772_PROX_DECT_OOR_LO" 11296800 "DTC_SAEJ1772_PILOT_PWM_OOR_HI" 11296801 "DTC_SAEJ1772_PILOT_PWM_OOR_LO" 11296802 "DTC_SAEJ1772_PILOT_PWM_DIG_COMM" 11296803 "DTC_SAEJ1772_PILOT_PWM_IR_ERR" 16175360 "DTC_FGD1_NO_SENSOR" 16175361 "DTC_FGD1_OOR_HI" 16175362 "DTC_FGD1_OOR_LO" 16175363 "DTC_FGD1_FAULT" 16175616 "DTC_FGD2_NO_SENSOR" 16175617 "DTC_FGD2_OOR_HI" 16175618 "DTC_FGD2_OOR_LO" 16175619 "DTC_FGD2_FAULT" 16171008 "DTC_CONT_OPEN" 16171009 "DTC_CONT_CLOSE" 16171010 "DTC_CONT_OPEN_CURRENT" 16171264 "DTC_CONT_CLOSE_ON_RESET" 16171265 "DTC_CONT_CLOSE_SIG_FAILED" 16171520 "DTC_PRECHARGE_TIMEOUT" 16171777 "DTC_CONT_MPOS_WELD_AT_SU" 16171778 "DTC_CONT_MNEG_WELD_AT_SU" 16171780 "DTC_CONT_CPOS_WELD_AT_SU" 16171781 "DTC_CONT_CNEG_WELD_AT_SU" 16171782 "DTC_CONT_ANEG_WELD_AT_SU" 16171783 "DTC_CONT_APOS_WELD_AT_SU" 16172033 "DTC_CONT_MPOS_WELD_AT_SD" 16172034 "DTC_CONT_MNEG_WELD_AT_SD" 16172036 "DTC_CONT_CPOS_WELD_AT_SD" 16172037 "DTC_CONT_CNEG_WELD_AT_SD" 16172038 "DTC_CONT_ANEG_WELD_AT_SD" 16172039 "DTC_CONT_APOS_WELD_AT_SD" 16172289 "DTC_CONT_MPOS_OPEN" 16172290 "DTC_CONT_MNEG_OPEN" 16172291 "DTC_CONT_MPRE_OPEN" 16172292 "DTC_CONT_CPOS_OPEN" 16172293 "DTC_CONT_CNEG_OPEN" 16172294 "DTC_CONT_APOS_OPEN" 16172295 "DTC_CONT_ANEG_OPEN" 16172545 "DTC_CONT_MPOS_VDIF" 16172546 "DTC_CONT_MNEG_VDIF" 16172548 "DTC_CONT_CPOS_VDIF" 16172549 "DTC_CONT_CNEG_VDIF" 16172550 "DTC_CONT_APOS_VDIF" 16172551 "DTC_CONT_ANEG_VDIF" 16174848 "DTC_HVIL" 16174849 "DTC_LVBAT_LO" 16174850 "DTC_LVBAT_HI" 16174851 "DTC_LVBAT_ERR" 16523520 "DTC_LEMLO_OOR_HI" 16523521 "DTC_LEMLO_OOR_LO" 16523522 "DTC_LEMLO_FAULT" 16523776 "DTC_LEMHI_OOR_HI" 16523777 "DTC_LEMHI_OOR_LO" 16523778 "DTC_LEMHI_FAULT" 16496320 "DTC_MBB_TOO_FEW" 16496321 "DTC_MBB_TOO_MANY" 16496352 "DTC_CELL_VMAX_ERR" 16496353 "DTC_CELL_VMIN_ERR" 16496354 "DTC_CELL_VMAX" 16496362 "DTC_CELL_VMAX_SEVERE" 16496355 "DTC_CELL_VMIN" 16496363 "DTC_CELL_VMIN_SEVERE" 16496356 "DTC_MOD_VOLTAGE_COMPARE" 16496336 "DTC_CELL_T_ERR" 16496337 "DTC_CELL_TMAX1" 16496338 "DTC_CELL_TMAX2" 16496339 "DTC_CELL_TMIN" 16497665 "DTC_MBB_01_MISSING" 16497666 "DTC_MBB_02_MISSING" 16497667 "DTC_MBB_03_MISSING" 16497668 "DTC_MBB_04_MISSING" 16497669 "DTC_MBB_05_MISSING" 16497670 "DTC_MBB_06_MISSING" 16497671 "DTC_MBB_07_MISSING" 16497672 "DTC_MBB_08_MISSING" 16497673 "DTC_MBB_09_MISSING" 16497680 "DTC_MBB_10_MISSING" 16497681 "DTC_MBB_11_MISSING" 16497682 "DTC_MBB_12_MISSING" 16497683 "DTC_MBB_13_MISSING" 16497684 "DTC_MBB_14_MISSING" 16497685 "DTC_MBB_15_MISSING" 16497686 "DTC_MBB_16_MISSING" 16497687 "DTC_MBB_17_MISSING" 16497688 "DTC_MBB_18_MISSING" 16497689 "DTC_MBB_19_MISSING" 16497696 "DTC_MBB_20_MISSING" 16497697 "DTC_MBB_21_MISSING" 16497698 "DTC_MBB_22_MISSING" 16497699 "DTC_MBB_23_MISSING" 16497700 "DTC_MBB_24_MISSING" 16498177 "DTC_MBB_01_VFAULT" 16498178 "DTC_MBB_02_VFAULT" 16498179 "DTC_MBB_03_VFAULT" 16498180 "DTC_MBB_04_VFAULT" 16498181 "DTC_MBB_05_VFAULT" 16498182 "DTC_MBB_06_VFAULT" 16498183 "DTC_MBB_07_VFAULT" 16498184 "DTC_MBB_08_VFAULT" 16498185 "DTC_MBB_09_VFAULT" 16498192 "DTC_MBB_10_VFAULT" 16498193 "DTC_MBB_11_VFAULT" 16498194 "DTC_MBB_12_VFAULT" 16498195 "DTC_MBB_13_VFAULT" 16498196 "DTC_MBB_14_VFAULT" 16498197 "DTC_MBB_15_VFAULT" 16498198 "DTC_MBB_16_VFAULT" 16498199 "DTC_MBB_17_VFAULT" 16498200 "DTC_MBB_18_VFAULT" 16498201 "DTC_MBB_19_VFAULT" 16498208 "DTC_MBB_20_VFAULT" 16498209 "DTC_MBB_21_VFAULT" 16498210 "DTC_MBB_22_VFAULT" 16498211 "DTC_MBB_23_VFAULT" 16498212 "DTC_MBB_24_VFAULT" 16497921 "DTC_MBB_01_TFAULT" 16497922 "DTC_MBB_02_TFAULT" 16497923 "DTC_MBB_03_TFAULT" 16497924 "DTC_MBB_04_TFAULT" 16497925 "DTC_MBB_05_TFAULT" 16497926 "DTC_MBB_06_TFAULT" 16497927 "DTC_MBB_07_TFAULT" 16497928 "DTC_MBB_08_TFAULT" 16497929 "DTC_MBB_09_TFAULT" 16497936 "DTC_MBB_10_TFAULT" 16497937 "DTC_MBB_11_TFAULT" 16497938 "DTC_MBB_12_TFAULT" 16497939 "DTC_MBB_13_TFAULT" 16497940 "DTC_MBB_14_TFAULT" 16497941 "DTC_MBB_15_TFAULT" 16497942 "DTC_MBB_16_TFAULT" 16497943 "DTC_MBB_17_TFAULT" 16497944 "DTC_MBB_18_TFAULT" 16497945 "DTC_MBB_19_TFAULT" 16497952 "DTC_MBB_20_TFAULT" 16497953 "DTC_MBB_21_TFAULT" 16497954 "DTC_MBB_22_TFAULT" 16497955 "DTC_MBB_23_TFAULT" 16497956 "DTC_MBB_24_TFAULT" 15785984 "DTC_PRECHARGE_ENERGY" 15785985 "DTC_PRT_FAILED" 15785986 "DTC_PRT_OVERTEMP" 15785987 "DTC_PRT_PROHIBIT" 16556032 "DTC_COOLANT_TEMP_OOR_HI" 16556033 "DTC_COOLANT_TEMP_OOR_LO" 16252928 "DTC_KEY_OFF_TIME_ERROR" 16506880 "DTC_VBAT_MISMATCH" 16506881 "DTC_VBAT_VMAX" 16506882 "DTC_VBAT_VMIN" 16506883 "DTC_PACK_FUSE" 15798544 "DTC_LLS1_OOR_HI" 15798545 "DTC_LLS1_OOR_LO" 15798546 "DTC_LLS1_FAULT" 15798816 "DTC_LLS2_OOR_HI" 15798817 "DTC_LLS2_OOR_LO" 15798818 "DTC_LLS2_FAULT" 14479360 "DTC_CFL_HEARTBEAT" 14479361 "DTC_CFL_FAULT" 14479362 "DTC_CFL_FAULT_LATCH" 13635584 "DTC_CONT_A_FAILED_HI" 13635585 "DTC_CONT_A_FAILED_LO" 13635586 "DTC_CONT_B_FAILED_HI" 13635587 "DTC_CONT_B_FAILED_LO" 13635588 "DTC_CONT_C_FAILED_HI" 13635589 "DTC_CONT_C_FAILED_LO" 13635590 "DTC_CONT_D_FAILED_HI" 13635591 "DTC_CONT_D_FAILED_LO" 13635592 "DTC_CONT_E_FAILED_HI" 13635593 "DTC_CONT_E_FAILED_LO" 13635594 "DTC_CONT_F_FAILED_HI" 13635595 "DTC_CONT_F_FAILED_LO" 13635596 "DTC_CONT_G_FAILED_HI" 13635597 "DTC_CONT_G_FAILED_LO" 13635598 "DTC_LSD_A_FAILED_HI" 13635599 "DTC_LSD_A_FAILED_LO" 13635600 "DTC_LSD_B_FAILED_HI" 13635601 "DTC_LSD_B_FAILED_LO" 13635602 "DTC_LSD_C_FAILED_HI" 13635603 "DTC_LSD_C_FAILED_LO" 13635606 "DTC_CONT_PWR_FAILED_HI" 13635607 "DTC_CONT_PWR_FAILED_LO" 13635608 "DTC_LSD_PUMP_FAILED_HI" 13635609 "DTC_LSD_PUMP_FAILED_LO" 13635610 "DTC_CHG_A_ENABLE_FAILED_HI" 13635611 "DTC_CHG_A_ENABLE_FAILED_LO" 13635612 "DTC_CHG_B_ENABLE_FAILED_HI" 13635613 "DTC_CHG_B_ENABLE_FAILED_LO" 13635614 "DTC_SW14V_PWR_FAILED_HI" 13635615 "DTC_SW14V_PWR_FAILED_LO" 13635620 "DTC_HSD_A_FAILED_HI" 13635621 "DTC_HSD_A_FAILED_LO" 13635622 "DTC_HSD_B_FAILED_HI" 13635623 "DTC_HSD_B_FAILED_LO" 13692968 "DTC_CONT_HPWR_FAILED_HI" 13692969 "DTC_CONT_HPWR_FAILED_LO" 13692970 "DTC_CONT_HPWR_OOR_HI" 13692971 "DTC_CONT_HPWR_OOR_LO" 13635616 "DTC_5V_PWR_OOR_HI" 13635617 "DTC_5V_PWR_OOR_LO" 14606336 "DTC_NVM_WRITE_TO" 14606337 "DTC_NVM_READ_TO" 14614528 "DTC_SPI_DIG_POT_FAULT" ;
VAL_ 1120 bcm_dtc_070 0 " - " 11276288 "DTC_VEPO" 11276289 "DTC_HSC_MISSING" 11460608 "DTC_NVM_SOC" 11460609 "DTC_NVM_KOT" 11460610 "DTC_NVM_DTC" 11460611 "DTC_NVM_SOC_CORRECTION" 11460612 "DTC_NVM_APP_SCRATCHPAD" 11517962 "DTC_LOOPTIME_TASK_A" 11517963 "DTC_LOOPTIME_TASK_B" 11517964 "DTC_LOOPTIME_TASK_C" 11517965 "DTC_LOOPTIME_TASK_D" 11517966 "DTC_LOOPTIME_TASK_E" 11517967 "DTC_LOOPTIME_TASK_F" 11323904 "DTC_INTERLOCK_A_FAILED_LOW" 11323905 "DTC_INTERLOCK_A_FAILED_HIGH" 11324160 "DTC_INTERLOCK_B_FAILED_LOW" 11324161 "DTC_INTERLOCK_B_FAILED_HIGH" 15728640 "DTC_EPO" 16498688 "DTC_BRUSA_MISSING" 16498689 "DTC_BRUSA_IDC" 16498690 "DTC_BRUSA_REQ_VS_CMD" 16433152 "DTC_AKERWADE_MISSING" 16433153 "DTC_AKERWADE_IDC" 16433154 "DTC_AKERWADE_REQ_VS_CMD" 16564224 "DTC_CHGLEAR_MISSING" 16564225 "DTC_CHGLEAR_IDC" 16564226 "DTC_CHGLEAR_REQ_VS_CMD" 16522240 "DTC_CSM_MISSING" 16522752 "DTC_CSM_VBAT" 16522753 "DTC_CSM_VPOS" 16522754 "DTC_CSM_VNEG" 16522755 "DTC_CSM_CPOS" 16522756 "DTC_CSM_CNEG" 16522757 "DTC_CSM_APOS" 16522758 "DTC_CSM_ANEG" 16522759 "DTC_CSM_FUSE_HI" 16522760 "DTC_CSM_FUSE_LO" 16521728 "DTC_CSM_ASIC" 16521729 "DTC_CSM_AILO" 16521730 "DTC_CSM_AIHI" 16520957 "DTC_LEAKAGE_DETECT_FAULT" 16522444 "DTC_REALTIMECLOCK_FAULT" 16520945 "DTC_CSM_LEAK_FAIL_CALC" 16520946 "DTC_CSM_LEAK_FAIL_HW" 16520947 "DTC_CSM_LEAK_EXT_SHORT" 16520948 "DTC_CSM_LEAK_MID_PACK_SHORT" 16520949 "DTC_CSM_LEAK_ERROR" 16520950 "DTC_CSM_LEAK_UNKNOWN" 16523008 "DTC_CSM_VER_MISMATCH" 16523009 "DTC_CSM_DTC_SET" 16523010 "DTC_CSM_CAL_FAULT" 16560128 "DTC_IBAT_MISMATCH" 16576512 "DTC_DIS_MAX_I2T" 16576513 "DTC_CHG_MAX_I2T" 16576768 "DTC_DIS_WARNING_I2T" 16576769 "DTC_CHG_WARNING_I2T" 11296784 "DTC_SAEJ1772_PROX_DECT_OOR_HI" 11296785 "DTC_SAEJ1772_PROX_DECT_OOR_LO" 11296800 "DTC_SAEJ1772_PILOT_PWM_OOR_HI" 11296801 "DTC_SAEJ1772_PILOT_PWM_OOR_LO" 11296802 "DTC_SAEJ1772_PILOT_PWM_DIG_COMM" 11296803 "DTC_SAEJ1772_PILOT_PWM_IR_ERR" 16175360 "DTC_FGD1_NO_SENSOR" 16175361 "DTC_FGD1_OOR_HI" 16175362 "DTC_FGD1_OOR_LO" 16175363 "DTC_FGD1_FAULT" 16175616 "DTC_FGD2_NO_SENSOR" 16175617 "DTC_FGD2_OOR_HI" 16175618 "DTC_FGD2_OOR_LO" 16175619 "DTC_FGD2_FAULT" 16171008 "DTC_CONT_OPEN" 16171009 "DTC_CONT_CLOSE" 16171010 "DTC_CONT_OPEN_CURRENT" 16171264 "DTC_CONT_CLOSE_ON_RESET" 16171265 "DTC_CONT_CLOSE_SIG_FAILED" 16171520 "DTC_PRECHARGE_TIMEOUT" 16171777 "DTC_CONT_MPOS_WELD_AT_SU" 16171778 "DTC_CONT_MNEG_WELD_AT_SU" 16171780 "DTC_CONT_CPOS_WELD_AT_SU" 16171781 "DTC_CONT_CNEG_WELD_AT_SU" 16171782 "DTC_CONT_ANEG_WELD_AT_SU" 16171783 "DTC_CONT_APOS_WELD_AT_SU" 16172033 "DTC_CONT_MPOS_WELD_AT_SD" 16172034 "DTC_CONT_MNEG_WELD_AT_SD" 16172036 "DTC_CONT_CPOS_WELD_AT_SD" 16172037 "DTC_CONT_CNEG_WELD_AT_SD" 16172038 "DTC_CONT_ANEG_WELD_AT_SD" 16172039 "DTC_CONT_APOS_WELD_AT_SD" 16172289 "DTC_CONT_MPOS_OPEN" 16172290 "DTC_CONT_MNEG_OPEN" 16172291 "DTC_CONT_MPRE_OPEN" 16172292 "DTC_CONT_CPOS_OPEN" 16172293 "DTC_CONT_CNEG_OPEN" 16172294 "DTC_CONT_APOS_OPEN" 16172295 "DTC_CONT_ANEG_OPEN" 16172545 "DTC_CONT_MPOS_VDIF" 16172546 "DTC_CONT_MNEG_VDIF" 16172548 "DTC_CONT_CPOS_VDIF" 16172549 "DTC_CONT_CNEG_VDIF" 16172550 "DTC_CONT_APOS_VDIF" 16172551 "DTC_CONT_ANEG_VDIF" 16174848 "DTC_HVIL" 16174849 "DTC_LVBAT_LO" 16174850 "DTC_LVBAT_HI" 16174851 "DTC_LVBAT_ERR" 16523520 "DTC_LEMLO_OOR_HI" 16523521 "DTC_LEMLO_OOR_LO" 16523522 "DTC_LEMLO_FAULT" 16523776 "DTC_LEMHI_OOR_HI" 16523777 "DTC_LEMHI_OOR_LO" 16523778 "DTC_LEMHI_FAULT" 16496320 "DTC_MBB_TOO_FEW" 16496321 "DTC_MBB_TOO_MANY" 16496352 "DTC_CELL_VMAX_ERR" 16496353 "DTC_CELL_VMIN_ERR" 16496354 "DTC_CELL_VMAX" 16496362 "DTC_CELL_VMAX_SEVERE" 16496355 "DTC_CELL_VMIN" 16496363 "DTC_CELL_VMIN_SEVERE" 16496356 "DTC_MOD_VOLTAGE_COMPARE" 16496336 "DTC_CELL_T_ERR" 16496337 "DTC_CELL_TMAX1" 16496338 "DTC_CELL_TMAX2" 16496339 "DTC_CELL_TMIN" 16497665 "DTC_MBB_01_MISSING" 16497666 "DTC_MBB_02_MISSING" 16497667 "DTC_MBB_03_MISSING" 16497668 "DTC_MBB_04_MISSING" 16497669 "DTC_MBB_05_MISSING" 16497670 "DTC_MBB_06_MISSING" 16497671 "DTC_MBB_07_MISSING" 16497672 "DTC_MBB_08_MISSING" 16497673 "DTC_MBB_09_MISSING" 16497680 "DTC_MBB_10_MISSING" 16497681 "DTC_MBB_11_MISSING" 16497682 "DTC_MBB_12_MISSING" 16497683 "DTC_MBB_13_MISSING" 16497684 "DTC_MBB_14_MISSING" 16497685 "DTC_MBB_15_MISSING" 16497686 "DTC_MBB_16_MISSING" 16497687 "DTC_MBB_17_MISSING" 16497688 "DTC_MBB_18_MISSING" 16497689 "DTC_MBB_19_MISSING" 16497696 "DTC_MBB_20_MISSING" 16497697 "DTC_MBB_21_MISSING" 16497698 "DTC_MBB_22_MISSING" 16497699 "DTC_MBB_23_MISSING" 16497700 "DTC_MBB_24_MISSING" 16498177 "DTC_MBB_01_VFAULT" 16498178 "DTC_MBB_02_VFAULT" 16498179 "DTC_MBB_03_VFAULT" 16498180 "DTC_MBB_04_VFAULT" 16498181 "DTC_MBB_05_VFAULT" 16498182 "DTC_MBB_06_VFAULT" 16498183 "DTC_MBB_07_VFAULT" 16498184 "DTC_MBB_08_VFAULT" 16498185 "DTC_MBB_09_VFAULT" 16498192 "DTC_MBB_10_VFAULT" 16498193 "DTC_MBB_11_VFAULT" 16498194 "DTC_MBB_12_VFAULT" 16498195 "DTC_MBB_13_VFAULT" 16498196 "DTC_MBB_14_VFAULT" 16498197 "DTC_MBB_15_VFAULT" 16498198 "DTC_MBB_16_VFAULT" 16498199 "DTC_MBB_17_VFAULT" 16498200 "DTC_MBB_18_VFAULT" 16498201 "DTC_MBB_19_VFAULT" 16498208 "DTC_MBB_20_VFAULT" 16498209 "DTC_MBB_21_VFAULT" 16498210 "DTC_MBB_22_VFAULT" 16498211 "DTC_MBB_23_VFAULT" 16498212 "DTC_MBB_24_VFAULT" 16497921 "DTC_MBB_01_TFAULT" 16497922 "DTC_MBB_02_TFAULT" 16497923 "DTC_MBB_03_TFAULT" 16497924 "DTC_MBB_04_TFAULT" 16497925 "DTC_MBB_05_TFAULT" 16497926 "DTC_MBB_06_TFAULT" 16497927 "DTC_MBB_07_TFAULT" 16497928 "DTC_MBB_08_TFAULT" 16497929 "DTC_MBB_09_TFAULT" 16497936 "DTC_MBB_10_TFAULT" 16497937 "DTC_MBB_11_TFAULT" 16497938 "DTC_MBB_12_TFAULT" 16497939 "DTC_MBB_13_TFAULT" 16497940 "DTC_MBB_14_TFAULT" 16497941 "DTC_MBB_15_TFAULT" 16497942 "DTC_MBB_16_TFAULT" 16497943 "DTC_MBB_17_TFAULT" 16497944 "DTC_MBB_18_TFAULT" 16497945 "DTC_MBB_19_TFAULT" 16497952 "DTC_MBB_20_TFAULT" 16497953 "DTC_MBB_21_TFAULT" 16497954 "DTC_MBB_22_TFAULT" 16497955 "DTC_MBB_23_TFAULT" 16497956 "DTC_MBB_24_TFAULT" 15785984 "DTC_PRECHARGE_ENERGY" 15785985 "DTC_PRT_FAILED" 15785986 "DTC_PRT_OVERTEMP" 15785987 "DTC_PRT_PROHIBIT" 16556032 "DTC_COOLANT_TEMP_OOR_HI" 16556033 "DTC_COOLANT_TEMP_OOR_LO" 16252928 "DTC_KEY_OFF_TIME_ERROR" 16506880 "DTC_VBAT_MISMATCH" 16506881 "DTC_VBAT_VMAX" 16506882 "DTC_VBAT_VMIN" 16506883 "DTC_PACK_FUSE" 15798544 "DTC_LLS1_OOR_HI" 15798545 "DTC_LLS1_OOR_LO" 15798546 "DTC_LLS1_FAULT" 15798816 "DTC_LLS2_OOR_HI" 15798817 "DTC_LLS2_OOR_LO" 15798818 "DTC_LLS2_FAULT" 14479360 "DTC_CFL_HEARTBEAT" 14479361 "DTC_CFL_FAULT" 14479362 "DTC_CFL_FAULT_LATCH" 13635584 "DTC_CONT_A_FAILED_HI" 13635585 "DTC_CONT_A_FAILED_LO" 13635586 "DTC_CONT_B_FAILED_HI" 13635587 "DTC_CONT_B_FAILED_LO" 13635588 "DTC_CONT_C_FAILED_HI" 13635589 "DTC_CONT_C_FAILED_LO" 13635590 "DTC_CONT_D_FAILED_HI" 13635591 "DTC_CONT_D_FAILED_LO" 13635592 "DTC_CONT_E_FAILED_HI" 13635593 "DTC_CONT_E_FAILED_LO" 13635594 "DTC_CONT_F_FAILED_HI" 13635595 "DTC_CONT_F_FAILED_LO" 13635596 "DTC_CONT_G_FAILED_HI" 13635597 "DTC_CONT_G_FAILED_LO" 13635598 "DTC_LSD_A_FAILED_HI" 13635599 "DTC_LSD_A_FAILED_LO" 13635600 "DTC_LSD_B_FAILED_HI" 13635601 "DTC_LSD_B_FAILED_LO" 13635602 "DTC_LSD_C_FAILED_HI" 13635603 "DTC_LSD_C_FAILED_LO" 13635606 "DTC_CONT_PWR_FAILED_HI" 13635607 "DTC_CONT_PWR_FAILED_LO" 13635608 "DTC_LSD_PUMP_FAILED_HI" 13635609 "DTC_LSD_PUMP_FAILED_LO" 13635610 "DTC_CHG_A_ENABLE_FAILED_HI" 13635611 "DTC_CHG_A_ENABLE_FAILED_LO" 13635612 "DTC_CHG_B_ENABLE_FAILED_HI" 13635613 "DTC_CHG_B_ENABLE_FAILED_LO" 13635614 "DTC_SW14V_PWR_FAILED_HI" 13635615 "DTC_SW14V_PWR_FAILED_LO" 13635620 "DTC_HSD_A_FAILED_HI" 13635621 "DTC_HSD_A_FAILED_LO" 13635622 "DTC_HSD_B_FAILED_HI" 13635623 "DTC_HSD_B_FAILED_LO" 13692968 "DTC_CONT_HPWR_FAILED_HI" 13692969 "DTC_CONT_HPWR_FAILED_LO" 13692970 "DTC_CONT_HPWR_OOR_HI" 13692971 "DTC_CONT_HPWR_OOR_LO" 13635616 "DTC_5V_PWR_OOR_HI" 13635617 "DTC_5V_PWR_OOR_LO" 14606336 "DTC_NVM_WRITE_TO" 14606337 "DTC_NVM_READ_TO" 14614528 "DTC_SPI_DIG_POT_FAULT" ;
VAL_ 1120 bcm_dtc_071 0 " - " 11276288 "DTC_VEPO" 11276289 "DTC_HSC_MISSING" 11460608 "DTC_NVM_SOC" 11460609 "DTC_NVM_KOT" 11460610 "DTC_NVM_DTC" 11460611 "DTC_NVM_SOC_CORRECTION" 11460612 "DTC_NVM_APP_SCRATCHPAD" 11517962 "DTC_LOOPTIME_TASK_A" 11517963 "DTC_LOOPTIME_TASK_B" 11517964 "DTC_LOOPTIME_TASK_C" 11517965 "DTC_LOOPTIME_TASK_D" 11517966 "DTC_LOOPTIME_TASK_E" 11517967 "DTC_LOOPTIME_TASK_F" 11323904 "DTC_INTERLOCK_A_FAILED_LOW" 11323905 "DTC_INTERLOCK_A_FAILED_HIGH" 11324160 "DTC_INTERLOCK_B_FAILED_LOW" 11324161 "DTC_INTERLOCK_B_FAILED_HIGH" 15728640 "DTC_EPO" 16498688 "DTC_BRUSA_MISSING" 16498689 "DTC_BRUSA_IDC" 16498690 "DTC_BRUSA_REQ_VS_CMD" 16433152 "DTC_AKERWADE_MISSING" 16433153 "DTC_AKERWADE_IDC" 16433154 "DTC_AKERWADE_REQ_VS_CMD" 16564224 "DTC_CHGLEAR_MISSING" 16564225 "DTC_CHGLEAR_IDC" 16564226 "DTC_CHGLEAR_REQ_VS_CMD" 16522240 "DTC_CSM_MISSING" 16522752 "DTC_CSM_VBAT" 16522753 "DTC_CSM_VPOS" 16522754 "DTC_CSM_VNEG" 16522755 "DTC_CSM_CPOS" 16522756 "DTC_CSM_CNEG" 16522757 "DTC_CSM_APOS" 16522758 "DTC_CSM_ANEG" 16522759 "DTC_CSM_FUSE_HI" 16522760 "DTC_CSM_FUSE_LO" 16521728 "DTC_CSM_ASIC" 16521729 "DTC_CSM_AILO" 16521730 "DTC_CSM_AIHI" 16520957 "DTC_LEAKAGE_DETECT_FAULT" 16522444 "DTC_REALTIMECLOCK_FAULT" 16520945 "DTC_CSM_LEAK_FAIL_CALC" 16520946 "DTC_CSM_LEAK_FAIL_HW" 16520947 "DTC_CSM_LEAK_EXT_SHORT" 16520948 "DTC_CSM_LEAK_MID_PACK_SHORT" 16520949 "DTC_CSM_LEAK_ERROR" 16520950 "DTC_CSM_LEAK_UNKNOWN" 16523008 "DTC_CSM_VER_MISMATCH" 16523009 "DTC_CSM_DTC_SET" 16523010 "DTC_CSM_CAL_FAULT" 16560128 "DTC_IBAT_MISMATCH" 16576512 "DTC_DIS_MAX_I2T" 16576513 "DTC_CHG_MAX_I2T" 16576768 "DTC_DIS_WARNING_I2T" 16576769 "DTC_CHG_WARNING_I2T" 11296784 "DTC_SAEJ1772_PROX_DECT_OOR_HI" 11296785 "DTC_SAEJ1772_PROX_DECT_OOR_LO" 11296800 "DTC_SAEJ1772_PILOT_PWM_OOR_HI" 11296801 "DTC_SAEJ1772_PILOT_PWM_OOR_LO" 11296802 "DTC_SAEJ1772_PILOT_PWM_DIG_COMM" 11296803 "DTC_SAEJ1772_PILOT_PWM_IR_ERR" 16175360 "DTC_FGD1_NO_SENSOR" 16175361 "DTC_FGD1_OOR_HI" 16175362 "DTC_FGD1_OOR_LO" 16175363 "DTC_FGD1_FAULT" 16175616 "DTC_FGD2_NO_SENSOR" 16175617 "DTC_FGD2_OOR_HI" 16175618 "DTC_FGD2_OOR_LO" 16175619 "DTC_FGD2_FAULT" 16171008 "DTC_CONT_OPEN" 16171009 "DTC_CONT_CLOSE" 16171010 "DTC_CONT_OPEN_CURRENT" 16171264 "DTC_CONT_CLOSE_ON_RESET" 16171265 "DTC_CONT_CLOSE_SIG_FAILED" 16171520 "DTC_PRECHARGE_TIMEOUT" 16171777 "DTC_CONT_MPOS_WELD_AT_SU" 16171778 "DTC_CONT_MNEG_WELD_AT_SU" 16171780 "DTC_CONT_CPOS_WELD_AT_SU" 16171781 "DTC_CONT_CNEG_WELD_AT_SU" 16171782 "DTC_CONT_ANEG_WELD_AT_SU" 16171783 "DTC_CONT_APOS_WELD_AT_SU" 16172033 "DTC_CONT_MPOS_WELD_AT_SD" 16172034 "DTC_CONT_MNEG_WELD_AT_SD" 16172036 "DTC_CONT_CPOS_WELD_AT_SD" 16172037 "DTC_CONT_CNEG_WELD_AT_SD" 16172038 "DTC_CONT_ANEG_WELD_AT_SD" 16172039 "DTC_CONT_APOS_WELD_AT_SD" 16172289 "DTC_CONT_MPOS_OPEN" 16172290 "DTC_CONT_MNEG_OPEN" 16172291 "DTC_CONT_MPRE_OPEN" 16172292 "DTC_CONT_CPOS_OPEN" 16172293 "DTC_CONT_CNEG_OPEN" 16172294 "DTC_CONT_APOS_OPEN" 16172295 "DTC_CONT_ANEG_OPEN" 16172545 "DTC_CONT_MPOS_VDIF" 16172546 "DTC_CONT_MNEG_VDIF" 16172548 "DTC_CONT_CPOS_VDIF" 16172549 "DTC_CONT_CNEG_VDIF" 16172550 "DTC_CONT_APOS_VDIF" 16172551 "DTC_CONT_ANEG_VDIF" 16174848 "DTC_HVIL" 16174849 "DTC_LVBAT_LO" 16174850 "DTC_LVBAT_HI" 16174851 "DTC_LVBAT_ERR" 16523520 "DTC_LEMLO_OOR_HI" 16523521 "DTC_LEMLO_OOR_LO" 16523522 "DTC_LEMLO_FAULT" 16523776 "DTC_LEMHI_OOR_HI" 16523777 "DTC_LEMHI_OOR_LO" 16523778 "DTC_LEMHI_FAULT" 16496320 "DTC_MBB_TOO_FEW" 16496321 "DTC_MBB_TOO_MANY" 16496352 "DTC_CELL_VMAX_ERR" 16496353 "DTC_CELL_VMIN_ERR" 16496354 "DTC_CELL_VMAX" 16496362 "DTC_CELL_VMAX_SEVERE" 16496355 "DTC_CELL_VMIN" 16496363 "DTC_CELL_VMIN_SEVERE" 16496356 "DTC_MOD_VOLTAGE_COMPARE" 16496336 "DTC_CELL_T_ERR" 16496337 "DTC_CELL_TMAX1" 16496338 "DTC_CELL_TMAX2" 16496339 "DTC_CELL_TMIN" 16497665 "DTC_MBB_01_MISSING" 16497666 "DTC_MBB_02_MISSING" 16497667 "DTC_MBB_03_MISSING" 16497668 "DTC_MBB_04_MISSING" 16497669 "DTC_MBB_05_MISSING" 16497670 "DTC_MBB_06_MISSING" 16497671 "DTC_MBB_07_MISSING" 16497672 "DTC_MBB_08_MISSING" 16497673 "DTC_MBB_09_MISSING" 16497680 "DTC_MBB_10_MISSING" 16497681 "DTC_MBB_11_MISSING" 16497682 "DTC_MBB_12_MISSING" 16497683 "DTC_MBB_13_MISSING" 16497684 "DTC_MBB_14_MISSING" 16497685 "DTC_MBB_15_MISSING" 16497686 "DTC_MBB_16_MISSING" 16497687 "DTC_MBB_17_MISSING" 16497688 "DTC_MBB_18_MISSING" 16497689 "DTC_MBB_19_MISSING" 16497696 "DTC_MBB_20_MISSING" 16497697 "DTC_MBB_21_MISSING" 16497698 "DTC_MBB_22_MISSING" 16497699 "DTC_MBB_23_MISSING" 16497700 "DTC_MBB_24_MISSING" 16498177 "DTC_MBB_01_VFAULT" 16498178 "DTC_MBB_02_VFAULT" 16498179 "DTC_MBB_03_VFAULT" 16498180 "DTC_MBB_04_VFAULT" 16498181 "DTC_MBB_05_VFAULT" 16498182 "DTC_MBB_06_VFAULT" 16498183 "DTC_MBB_07_VFAULT" 16498184 "DTC_MBB_08_VFAULT" 16498185 "DTC_MBB_09_VFAULT" 16498192 "DTC_MBB_10_VFAULT" 16498193 "DTC_MBB_11_VFAULT" 16498194 "DTC_MBB_12_VFAULT" 16498195 "DTC_MBB_13_VFAULT" 16498196 "DTC_MBB_14_VFAULT" 16498197 "DTC_MBB_15_VFAULT" 16498198 "DTC_MBB_16_VFAULT" 16498199 "DTC_MBB_17_VFAULT" 16498200 "DTC_MBB_18_VFAULT" 16498201 "DTC_MBB_19_VFAULT" 16498208 "DTC_MBB_20_VFAULT" 16498209 "DTC_MBB_21_VFAULT" 16498210 "DTC_MBB_22_VFAULT" 16498211 "DTC_MBB_23_VFAULT" 16498212 "DTC_MBB_24_VFAULT" 16497921 "DTC_MBB_01_TFAULT" 16497922 "DTC_MBB_02_TFAULT" 16497923 "DTC_MBB_03_TFAULT" 16497924 "DTC_MBB_04_TFAULT" 16497925 "DTC_MBB_05_TFAULT" 16497926 "DTC_MBB_06_TFAULT" 16497927 "DTC_MBB_07_TFAULT" 16497928 "DTC_MBB_08_TFAULT" 16497929 "DTC_MBB_09_TFAULT" 16497936 "DTC_MBB_10_TFAULT" 16497937 "DTC_MBB_11_TFAULT" 16497938 "DTC_MBB_12_TFAULT" 16497939 "DTC_MBB_13_TFAULT" 16497940 "DTC_MBB_14_TFAULT" 16497941 "DTC_MBB_15_TFAULT" 16497942 "DTC_MBB_16_TFAULT" 16497943 "DTC_MBB_17_TFAULT" 16497944 "DTC_MBB_18_TFAULT" 16497945 "DTC_MBB_19_TFAULT" 16497952 "DTC_MBB_20_TFAULT" 16497953 "DTC_MBB_21_TFAULT" 16497954 "DTC_MBB_22_TFAULT" 16497955 "DTC_MBB_23_TFAULT" 16497956 "DTC_MBB_24_TFAULT" 15785984 "DTC_PRECHARGE_ENERGY" 15785985 "DTC_PRT_FAILED" 15785986 "DTC_PRT_OVERTEMP" 15785987 "DTC_PRT_PROHIBIT" 16556032 "DTC_COOLANT_TEMP_OOR_HI" 16556033 "DTC_COOLANT_TEMP_OOR_LO" 16252928 "DTC_KEY_OFF_TIME_ERROR" 16506880 "DTC_VBAT_MISMATCH" 16506881 "DTC_VBAT_VMAX" 16506882 "DTC_VBAT_VMIN" 16506883 "DTC_PACK_FUSE" 15798544 "DTC_LLS1_OOR_HI" 15798545 "DTC_LLS1_OOR_LO" 15798546 "DTC_LLS1_FAULT" 15798816 "DTC_LLS2_OOR_HI" 15798817 "DTC_LLS2_OOR_LO" 15798818 "DTC_LLS2_FAULT" 14479360 "DTC_CFL_HEARTBEAT" 14479361 "DTC_CFL_FAULT" 14479362 "DTC_CFL_FAULT_LATCH" 13635584 "DTC_CONT_A_FAILED_HI" 13635585 "DTC_CONT_A_FAILED_LO" 13635586 "DTC_CONT_B_FAILED_HI" 13635587 "DTC_CONT_B_FAILED_LO" 13635588 "DTC_CONT_C_FAILED_HI" 13635589 "DTC_CONT_C_FAILED_LO" 13635590 "DTC_CONT_D_FAILED_HI" 13635591 "DTC_CONT_D_FAILED_LO" 13635592 "DTC_CONT_E_FAILED_HI" 13635593 "DTC_CONT_E_FAILED_LO" 13635594 "DTC_CONT_F_FAILED_HI" 13635595 "DTC_CONT_F_FAILED_LO" 13635596 "DTC_CONT_G_FAILED_HI" 13635597 "DTC_CONT_G_FAILED_LO" 13635598 "DTC_LSD_A_FAILED_HI" 13635599 "DTC_LSD_A_FAILED_LO" 13635600 "DTC_LSD_B_FAILED_HI" 13635601 "DTC_LSD_B_FAILED_LO" 13635602 "DTC_LSD_C_FAILED_HI" 13635603 "DTC_LSD_C_FAILED_LO" 13635606 "DTC_CONT_PWR_FAILED_HI" 13635607 "DTC_CONT_PWR_FAILED_LO" 13635608 "DTC_LSD_PUMP_FAILED_HI" 13635609 "DTC_LSD_PUMP_FAILED_LO" 13635610 "DTC_CHG_A_ENABLE_FAILED_HI" 13635611 "DTC_CHG_A_ENABLE_FAILED_LO" 13635612 "DTC_CHG_B_ENABLE_FAILED_HI" 13635613 "DTC_CHG_B_ENABLE_FAILED_LO" 13635614 "DTC_SW14V_PWR_FAILED_HI" 13635615 "DTC_SW14V_PWR_FAILED_LO" 13635620 "DTC_HSD_A_FAILED_HI" 13635621 "DTC_HSD_A_FAILED_LO" 13635622 "DTC_HSD_B_FAILED_HI" 13635623 "DTC_HSD_B_FAILED_LO" 13692968 "DTC_CONT_HPWR_FAILED_HI" 13692969 "DTC_CONT_HPWR_FAILED_LO" 13692970 "DTC_CONT_HPWR_OOR_HI" 13692971 "DTC_CONT_HPWR_OOR_LO" 13635616 "DTC_5V_PWR_OOR_HI" 13635617 "DTC_5V_PWR_OOR_LO" 14606336 "DTC_NVM_WRITE_TO" 14606337 "DTC_NVM_READ_TO" 14614528 "DTC_SPI_DIG_POT_FAULT" ;
VAL_ 1120 bcm_dtc_072 0 " - " 11276288 "DTC_VEPO" 11276289 "DTC_HSC_MISSING" 11460608 "DTC_NVM_SOC" 11460609 "DTC_NVM_KOT" 11460610 "DTC_NVM_DTC" 11460611 "DTC_NVM_SOC_CORRECTION" 11460612 "DTC_NVM_APP_SCRATCHPAD" 11517962 "DTC_LOOPTIME_TASK_A" 11517963 "DTC_LOOPTIME_TASK_B" 11517964 "DTC_LOOPTIME_TASK_C" 11517965 "DTC_LOOPTIME_TASK_D" 11517966 "DTC_LOOPTIME_TASK_E" 11517967 "DTC_LOOPTIME_TASK_F" 11323904 "DTC_INTERLOCK_A_FAILED_LOW" 11323905 "DTC_INTERLOCK_A_FAILED_HIGH" 11324160 "DTC_INTERLOCK_B_FAILED_LOW" 11324161 "DTC_INTERLOCK_B_FAILED_HIGH" 15728640 "DTC_EPO" 16498688 "DTC_BRUSA_MISSING" 16498689 "DTC_BRUSA_IDC" 16498690 "DTC_BRUSA_REQ_VS_CMD" 16433152 "DTC_AKERWADE_MISSING" 16433153 "DTC_AKERWADE_IDC" 16433154 "DTC_AKERWADE_REQ_VS_CMD" 16564224 "DTC_CHGLEAR_MISSING" 16564225 "DTC_CHGLEAR_IDC" 16564226 "DTC_CHGLEAR_REQ_VS_CMD" 16522240 "DTC_CSM_MISSING" 16522752 "DTC_CSM_VBAT" 16522753 "DTC_CSM_VPOS" 16522754 "DTC_CSM_VNEG" 16522755 "DTC_CSM_CPOS" 16522756 "DTC_CSM_CNEG" 16522757 "DTC_CSM_APOS" 16522758 "DTC_CSM_ANEG" 16522759 "DTC_CSM_FUSE_HI" 16522760 "DTC_CSM_FUSE_LO" 16521728 "DTC_CSM_ASIC" 16521729 "DTC_CSM_AILO" 16521730 "DTC_CSM_AIHI" 16520957 "DTC_LEAKAGE_DETECT_FAULT" 16522444 "DTC_REALTIMECLOCK_FAULT" 16520945 "DTC_CSM_LEAK_FAIL_CALC" 16520946 "DTC_CSM_LEAK_FAIL_HW" 16520947 "DTC_CSM_LEAK_EXT_SHORT" 16520948 "DTC_CSM_LEAK_MID_PACK_SHORT" 16520949 "DTC_CSM_LEAK_ERROR" 16520950 "DTC_CSM_LEAK_UNKNOWN" 16523008 "DTC_CSM_VER_MISMATCH" 16523009 "DTC_CSM_DTC_SET" 16523010 "DTC_CSM_CAL_FAULT" 16560128 "DTC_IBAT_MISMATCH" 16576512 "DTC_DIS_MAX_I2T" 16576513 "DTC_CHG_MAX_I2T" 16576768 "DTC_DIS_WARNING_I2T" 16576769 "DTC_CHG_WARNING_I2T" 11296784 "DTC_SAEJ1772_PROX_DECT_OOR_HI" 11296785 "DTC_SAEJ1772_PROX_DECT_OOR_LO" 11296800 "DTC_SAEJ1772_PILOT_PWM_OOR_HI" 11296801 "DTC_SAEJ1772_PILOT_PWM_OOR_LO" 11296802 "DTC_SAEJ1772_PILOT_PWM_DIG_COMM" 11296803 "DTC_SAEJ1772_PILOT_PWM_IR_ERR" 16175360 "DTC_FGD1_NO_SENSOR" 16175361 "DTC_FGD1_OOR_HI" 16175362 "DTC_FGD1_OOR_LO" 16175363 "DTC_FGD1_FAULT" 16175616 "DTC_FGD2_NO_SENSOR" 16175617 "DTC_FGD2_OOR_HI" 16175618 "DTC_FGD2_OOR_LO" 16175619 "DTC_FGD2_FAULT" 16171008 "DTC_CONT_OPEN" 16171009 "DTC_CONT_CLOSE" 16171010 "DTC_CONT_OPEN_CURRENT" 16171264 "DTC_CONT_CLOSE_ON_RESET" 16171265 "DTC_CONT_CLOSE_SIG_FAILED" 16171520 "DTC_PRECHARGE_TIMEOUT" 16171777 "DTC_CONT_MPOS_WELD_AT_SU" 16171778 "DTC_CONT_MNEG_WELD_AT_SU" 16171780 "DTC_CONT_CPOS_WELD_AT_SU" 16171781 "DTC_CONT_CNEG_WELD_AT_SU" 16171782 "DTC_CONT_ANEG_WELD_AT_SU" 16171783 "DTC_CONT_APOS_WELD_AT_SU" 16172033 "DTC_CONT_MPOS_WELD_AT_SD" 16172034 "DTC_CONT_MNEG_WELD_AT_SD" 16172036 "DTC_CONT_CPOS_WELD_AT_SD" 16172037 "DTC_CONT_CNEG_WELD_AT_SD" 16172038 "DTC_CONT_ANEG_WELD_AT_SD" 16172039 "DTC_CONT_APOS_WELD_AT_SD" 16172289 "DTC_CONT_MPOS_OPEN" 16172290 "DTC_CONT_MNEG_OPEN" 16172291 "DTC_CONT_MPRE_OPEN" 16172292 "DTC_CONT_CPOS_OPEN" 16172293 "DTC_CONT_CNEG_OPEN" 16172294 "DTC_CONT_APOS_OPEN" 16172295 "DTC_CONT_ANEG_OPEN" 16172545 "DTC_CONT_MPOS_VDIF" 16172546 "DTC_CONT_MNEG_VDIF" 16172548 "DTC_CONT_CPOS_VDIF" 16172549 "DTC_CONT_CNEG_VDIF" 16172550 "DTC_CONT_APOS_VDIF" 16172551 "DTC_CONT_ANEG_VDIF" 16174848 "DTC_HVIL" 16174849 "DTC_LVBAT_LO" 16174850 "DTC_LVBAT_HI" 16174851 "DTC_LVBAT_ERR" 16523520 "DTC_LEMLO_OOR_HI" 16523521 "DTC_LEMLO_OOR_LO" 16523522 "DTC_LEMLO_FAULT" 16523776 "DTC_LEMHI_OOR_HI" 16523777 "DTC_LEMHI_OOR_LO" 16523778 "DTC_LEMHI_FAULT" 16496320 "DTC_MBB_TOO_FEW" 16496321 "DTC_MBB_TOO_MANY" 16496352 "DTC_CELL_VMAX_ERR" 16496353 "DTC_CELL_VMIN_ERR" 16496354 "DTC_CELL_VMAX" 16496362 "DTC_CELL_VMAX_SEVERE" 16496355 "DTC_CELL_VMIN" 16496363 "DTC_CELL_VMIN_SEVERE" 16496356 "DTC_MOD_VOLTAGE_COMPARE" 16496336 "DTC_CELL_T_ERR" 16496337 "DTC_CELL_TMAX1" 16496338 "DTC_CELL_TMAX2" 16496339 "DTC_CELL_TMIN" 16497665 "DTC_MBB_01_MISSING" 16497666 "DTC_MBB_02_MISSING" 16497667 "DTC_MBB_03_MISSING" 16497668 "DTC_MBB_04_MISSING" 16497669 "DTC_MBB_05_MISSING" 16497670 "DTC_MBB_06_MISSING" 16497671 "DTC_MBB_07_MISSING" 16497672 "DTC_MBB_08_MISSING" 16497673 "DTC_MBB_09_MISSING" 16497680 "DTC_MBB_10_MISSING" 16497681 "DTC_MBB_11_MISSING" 16497682 "DTC_MBB_12_MISSING" 16497683 "DTC_MBB_13_MISSING" 16497684 "DTC_MBB_14_MISSING" 16497685 "DTC_MBB_15_MISSING" 16497686 "DTC_MBB_16_MISSING" 16497687 "DTC_MBB_17_MISSING" 16497688 "DTC_MBB_18_MISSING" 16497689 "DTC_MBB_19_MISSING" 16497696 "DTC_MBB_20_MISSING" 16497697 "DTC_MBB_21_MISSING" 16497698 "DTC_MBB_22_MISSING" 16497699 "DTC_MBB_23_MISSING" 16497700 "DTC_MBB_24_MISSING" 16498177 "DTC_MBB_01_VFAULT" 16498178 "DTC_MBB_02_VFAULT" 16498179 "DTC_MBB_03_VFAULT" 16498180 "DTC_MBB_04_VFAULT" 16498181 "DTC_MBB_05_VFAULT" 16498182 "DTC_MBB_06_VFAULT" 16498183 "DTC_MBB_07_VFAULT" 16498184 "DTC_MBB_08_VFAULT" 16498185 "DTC_MBB_09_VFAULT" 16498192 "DTC_MBB_10_VFAULT" 16498193 "DTC_MBB_11_VFAULT" 16498194 "DTC_MBB_12_VFAULT" 16498195 "DTC_MBB_13_VFAULT" 16498196 "DTC_MBB_14_VFAULT" 16498197 "DTC_MBB_15_VFAULT" 16498198 "DTC_MBB_16_VFAULT" 16498199 "DTC_MBB_17_VFAULT" 16498200 "DTC_MBB_18_VFAULT" 16498201 "DTC_MBB_19_VFAULT" 16498208 "DTC_MBB_20_VFAULT" 16498209 "DTC_MBB_21_VFAULT" 16498210 "DTC_MBB_22_VFAULT" 16498211 "DTC_MBB_23_VFAULT" 16498212 "DTC_MBB_24_VFAULT" 16497921 "DTC_MBB_01_TFAULT" 16497922 "DTC_MBB_02_TFAULT" 16497923 "DTC_MBB_03_TFAULT" 16497924 "DTC_MBB_04_TFAULT" 16497925 "DTC_MBB_05_TFAULT" 16497926 "DTC_MBB_06_TFAULT" 16497927 "DTC_MBB_07_TFAULT" 16497928 "DTC_MBB_08_TFAULT" 16497929 "DTC_MBB_09_TFAULT" 16497936 "DTC_MBB_10_TFAULT" 16497937 "DTC_MBB_11_TFAULT" 16497938 "DTC_MBB_12_TFAULT" 16497939 "DTC_MBB_13_TFAULT" 16497940 "DTC_MBB_14_TFAULT" 16497941 "DTC_MBB_15_TFAULT" 16497942 "DTC_MBB_16_TFAULT" 16497943 "DTC_MBB_17_TFAULT" 16497944 "DTC_MBB_18_TFAULT" 16497945 "DTC_MBB_19_TFAULT" 16497952 "DTC_MBB_20_TFAULT" 16497953 "DTC_MBB_21_TFAULT" 16497954 "DTC_MBB_22_TFAULT" 16497955 "DTC_MBB_23_TFAULT" 16497956 "DTC_MBB_24_TFAULT" 15785984 "DTC_PRECHARGE_ENERGY" 15785985 "DTC_PRT_FAILED" 15785986 "DTC_PRT_OVERTEMP" 15785987 "DTC_PRT_PROHIBIT" 16556032 "DTC_COOLANT_TEMP_OOR_HI" 16556033 "DTC_COOLANT_TEMP_OOR_LO" 16252928 "DTC_KEY_OFF_TIME_ERROR" 16506880 "DTC_VBAT_MISMATCH" 16506881 "DTC_VBAT_VMAX" 16506882 "DTC_VBAT_VMIN" 16506883 "DTC_PACK_FUSE" 15798544 "DTC_LLS1_OOR_HI" 15798545 "DTC_LLS1_OOR_LO" 15798546 "DTC_LLS1_FAULT" 15798816 "DTC_LLS2_OOR_HI" 15798817 "DTC_LLS2_OOR_LO" 15798818 "DTC_LLS2_FAULT" 14479360 "DTC_CFL_HEARTBEAT" 14479361 "DTC_CFL_FAULT" 14479362 "DTC_CFL_FAULT_LATCH" 13635584 "DTC_CONT_A_FAILED_HI" 13635585 "DTC_CONT_A_FAILED_LO" 13635586 "DTC_CONT_B_FAILED_HI" 13635587 "DTC_CONT_B_FAILED_LO" 13635588 "DTC_CONT_C_FAILED_HI" 13635589 "DTC_CONT_C_FAILED_LO" 13635590 "DTC_CONT_D_FAILED_HI" 13635591 "DTC_CONT_D_FAILED_LO" 13635592 "DTC_CONT_E_FAILED_HI" 13635593 "DTC_CONT_E_FAILED_LO" 13635594 "DTC_CONT_F_FAILED_HI" 13635595 "DTC_CONT_F_FAILED_LO" 13635596 "DTC_CONT_G_FAILED_HI" 13635597 "DTC_CONT_G_FAILED_LO" 13635598 "DTC_LSD_A_FAILED_HI" 13635599 "DTC_LSD_A_FAILED_LO" 13635600 "DTC_LSD_B_FAILED_HI" 13635601 "DTC_LSD_B_FAILED_LO" 13635602 "DTC_LSD_C_FAILED_HI" 13635603 "DTC_LSD_C_FAILED_LO" 13635606 "DTC_CONT_PWR_FAILED_HI" 13635607 "DTC_CONT_PWR_FAILED_LO" 13635608 "DTC_LSD_PUMP_FAILED_HI" 13635609 "DTC_LSD_PUMP_FAILED_LO" 13635610 "DTC_CHG_A_ENABLE_FAILED_HI" 13635611 "DTC_CHG_A_ENABLE_FAILED_LO" 13635612 "DTC_CHG_B_ENABLE_FAILED_HI" 13635613 "DTC_CHG_B_ENABLE_FAILED_LO" 13635614 "DTC_SW14V_PWR_FAILED_HI" 13635615 "DTC_SW14V_PWR_FAILED_LO" 13635620 "DTC_HSD_A_FAILED_HI" 13635621 "DTC_HSD_A_FAILED_LO" 13635622 "DTC_HSD_B_FAILED_HI" 13635623 "DTC_HSD_B_FAILED_LO" 13692968 "DTC_CONT_HPWR_FAILED_HI" 13692969 "DTC_CONT_HPWR_FAILED_LO" 13692970 "DTC_CONT_HPWR_OOR_HI" 13692971 "DTC_CONT_HPWR_OOR_LO" 13635616 "DTC_5V_PWR_OOR_HI" 13635617 "DTC_5V_PWR_OOR_LO" 14606336 "DTC_NVM_WRITE_TO" 14606337 "DTC_NVM_READ_TO" 14614528 "DTC_SPI_DIG_POT_FAULT" ;
VAL_ 1120 bcm_dtc_073 0 " - " 11276288 "DTC_VEPO" 11276289 "DTC_HSC_MISSING" 11460608 "DTC_NVM_SOC" 11460609 "DTC_NVM_KOT" 11460610 "DTC_NVM_DTC" 11460611 "DTC_NVM_SOC_CORRECTION" 11460612 "DTC_NVM_APP_SCRATCHPAD" 11517962 "DTC_LOOPTIME_TASK_A" 11517963 "DTC_LOOPTIME_TASK_B" 11517964 "DTC_LOOPTIME_TASK_C" 11517965 "DTC_LOOPTIME_TASK_D" 11517966 "DTC_LOOPTIME_TASK_E" 11517967 "DTC_LOOPTIME_TASK_F" 11323904 "DTC_INTERLOCK_A_FAILED_LOW" 11323905 "DTC_INTERLOCK_A_FAILED_HIGH" 11324160 "DTC_INTERLOCK_B_FAILED_LOW" 11324161 "DTC_INTERLOCK_B_FAILED_HIGH" 15728640 "DTC_EPO" 16498688 "DTC_BRUSA_MISSING" 16498689 "DTC_BRUSA_IDC" 16498690 "DTC_BRUSA_REQ_VS_CMD" 16433152 "DTC_AKERWADE_MISSING" 16433153 "DTC_AKERWADE_IDC" 16433154 "DTC_AKERWADE_REQ_VS_CMD" 16564224 "DTC_CHGLEAR_MISSING" 16564225 "DTC_CHGLEAR_IDC" 16564226 "DTC_CHGLEAR_REQ_VS_CMD" 16522240 "DTC_CSM_MISSING" 16522752 "DTC_CSM_VBAT" 16522753 "DTC_CSM_VPOS" 16522754 "DTC_CSM_VNEG" 16522755 "DTC_CSM_CPOS" 16522756 "DTC_CSM_CNEG" 16522757 "DTC_CSM_APOS" 16522758 "DTC_CSM_ANEG" 16522759 "DTC_CSM_FUSE_HI" 16522760 "DTC_CSM_FUSE_LO" 16521728 "DTC_CSM_ASIC" 16521729 "DTC_CSM_AILO" 16521730 "DTC_CSM_AIHI" 16520957 "DTC_LEAKAGE_DETECT_FAULT" 16522444 "DTC_REALTIMECLOCK_FAULT" 16520945 "DTC_CSM_LEAK_FAIL_CALC" 16520946 "DTC_CSM_LEAK_FAIL_HW" 16520947 "DTC_CSM_LEAK_EXT_SHORT" 16520948 "DTC_CSM_LEAK_MID_PACK_SHORT" 16520949 "DTC_CSM_LEAK_ERROR" 16520950 "DTC_CSM_LEAK_UNKNOWN" 16523008 "DTC_CSM_VER_MISMATCH" 16523009 "DTC_CSM_DTC_SET" 16523010 "DTC_CSM_CAL_FAULT" 16560128 "DTC_IBAT_MISMATCH" 16576512 "DTC_DIS_MAX_I2T" 16576513 "DTC_CHG_MAX_I2T" 16576768 "DTC_DIS_WARNING_I2T" 16576769 "DTC_CHG_WARNING_I2T" 11296784 "DTC_SAEJ1772_PROX_DECT_OOR_HI" 11296785 "DTC_SAEJ1772_PROX_DECT_OOR_LO" 11296800 "DTC_SAEJ1772_PILOT_PWM_OOR_HI" 11296801 "DTC_SAEJ1772_PILOT_PWM_OOR_LO" 11296802 "DTC_SAEJ1772_PILOT_PWM_DIG_COMM" 11296803 "DTC_SAEJ1772_PILOT_PWM_IR_ERR" 16175360 "DTC_FGD1_NO_SENSOR" 16175361 "DTC_FGD1_OOR_HI" 16175362 "DTC_FGD1_OOR_LO" 16175363 "DTC_FGD1_FAULT" 16175616 "DTC_FGD2_NO_SENSOR" 16175617 "DTC_FGD2_OOR_HI" 16175618 "DTC_FGD2_OOR_LO" 16175619 "DTC_FGD2_FAULT" 16171008 "DTC_CONT_OPEN" 16171009 "DTC_CONT_CLOSE" 16171010 "DTC_CONT_OPEN_CURRENT" 16171264 "DTC_CONT_CLOSE_ON_RESET" 16171265 "DTC_CONT_CLOSE_SIG_FAILED" 16171520 "DTC_PRECHARGE_TIMEOUT" 16171777 "DTC_CONT_MPOS_WELD_AT_SU" 16171778 "DTC_CONT_MNEG_WELD_AT_SU" 16171780 "DTC_CONT_CPOS_WELD_AT_SU" 16171781 "DTC_CONT_CNEG_WELD_AT_SU" 16171782 "DTC_CONT_ANEG_WELD_AT_SU" 16171783 "DTC_CONT_APOS_WELD_AT_SU" 16172033 "DTC_CONT_MPOS_WELD_AT_SD" 16172034 "DTC_CONT_MNEG_WELD_AT_SD" 16172036 "DTC_CONT_CPOS_WELD_AT_SD" 16172037 "DTC_CONT_CNEG_WELD_AT_SD" 16172038 "DTC_CONT_ANEG_WELD_AT_SD" 16172039 "DTC_CONT_APOS_WELD_AT_SD" 16172289 "DTC_CONT_MPOS_OPEN" 16172290 "DTC_CONT_MNEG_OPEN" 16172291 "DTC_CONT_MPRE_OPEN" 16172292 "DTC_CONT_CPOS_OPEN" 16172293 "DTC_CONT_CNEG_OPEN" 16172294 "DTC_CONT_APOS_OPEN" 16172295 "DTC_CONT_ANEG_OPEN" 16172545 "DTC_CONT_MPOS_VDIF" 16172546 "DTC_CONT_MNEG_VDIF" 16172548 "DTC_CONT_CPOS_VDIF" 16172549 "DTC_CONT_CNEG_VDIF" 16172550 "DTC_CONT_APOS_VDIF" 16172551 "DTC_CONT_ANEG_VDIF" 16174848 "DTC_HVIL" 16174849 "DTC_LVBAT_LO" 16174850 "DTC_LVBAT_HI" 16174851 "DTC_LVBAT_ERR" 16523520 "DTC_LEMLO_OOR_HI" 16523521 "DTC_LEMLO_OOR_LO" 16523522 "DTC_LEMLO_FAULT" 16523776 "DTC_LEMHI_OOR_HI" 16523777 "DTC_LEMHI_OOR_LO" 16523778 "DTC_LEMHI_FAULT" 16496320 "DTC_MBB_TOO_FEW" 16496321 "DTC_MBB_TOO_MANY" 16496352 "DTC_CELL_VMAX_ERR" 16496353 "DTC_CELL_VMIN_ERR" 16496354 "DTC_CELL_VMAX" 16496362 "DTC_CELL_VMAX_SEVERE" 16496355 "DTC_CELL_VMIN" 16496363 "DTC_CELL_VMIN_SEVERE" 16496356 "DTC_MOD_VOLTAGE_COMPARE" 16496336 "DTC_CELL_T_ERR" 16496337 "DTC_CELL_TMAX1" 16496338 "DTC_CELL_TMAX2" 16496339 "DTC_CELL_TMIN" 16497665 "DTC_MBB_01_MISSING" 16497666 "DTC_MBB_02_MISSING" 16497667 "DTC_MBB_03_MISSING" 16497668 "DTC_MBB_04_MISSING" 16497669 "DTC_MBB_05_MISSING" 16497670 "DTC_MBB_06_MISSING" 16497671 "DTC_MBB_07_MISSING" 16497672 "DTC_MBB_08_MISSING" 16497673 "DTC_MBB_09_MISSING" 16497680 "DTC_MBB_10_MISSING" 16497681 "DTC_MBB_11_MISSING" 16497682 "DTC_MBB_12_MISSING" 16497683 "DTC_MBB_13_MISSING" 16497684 "DTC_MBB_14_MISSING" 16497685 "DTC_MBB_15_MISSING" 16497686 "DTC_MBB_16_MISSING" 16497687 "DTC_MBB_17_MISSING" 16497688 "DTC_MBB_18_MISSING" 16497689 "DTC_MBB_19_MISSING" 16497696 "DTC_MBB_20_MISSING" 16497697 "DTC_MBB_21_MISSING" 16497698 "DTC_MBB_22_MISSING" 16497699 "DTC_MBB_23_MISSING" 16497700 "DTC_MBB_24_MISSING" 16498177 "DTC_MBB_01_VFAULT" 16498178 "DTC_MBB_02_VFAULT" 16498179 "DTC_MBB_03_VFAULT" 16498180 "DTC_MBB_04_VFAULT" 16498181 "DTC_MBB_05_VFAULT" 16498182 "DTC_MBB_06_VFAULT" 16498183 "DTC_MBB_07_VFAULT" 16498184 "DTC_MBB_08_VFAULT" 16498185 "DTC_MBB_09_VFAULT" 16498192 "DTC_MBB_10_VFAULT" 16498193 "DTC_MBB_11_VFAULT" 16498194 "DTC_MBB_12_VFAULT" 16498195 "DTC_MBB_13_VFAULT" 16498196 "DTC_MBB_14_VFAULT" 16498197 "DTC_MBB_15_VFAULT" 16498198 "DTC_MBB_16_VFAULT" 16498199 "DTC_MBB_17_VFAULT" 16498200 "DTC_MBB_18_VFAULT" 16498201 "DTC_MBB_19_VFAULT" 16498208 "DTC_MBB_20_VFAULT" 16498209 "DTC_MBB_21_VFAULT" 16498210 "DTC_MBB_22_VFAULT" 16498211 "DTC_MBB_23_VFAULT" 16498212 "DTC_MBB_24_VFAULT" 16497921 "DTC_MBB_01_TFAULT" 16497922 "DTC_MBB_02_TFAULT" 16497923 "DTC_MBB_03_TFAULT" 16497924 "DTC_MBB_04_TFAULT" 16497925 "DTC_MBB_05_TFAULT" 16497926 "DTC_MBB_06_TFAULT" 16497927 "DTC_MBB_07_TFAULT" 16497928 "DTC_MBB_08_TFAULT" 16497929 "DTC_MBB_09_TFAULT" 16497936 "DTC_MBB_10_TFAULT" 16497937 "DTC_MBB_11_TFAULT" 16497938 "DTC_MBB_12_TFAULT" 16497939 "DTC_MBB_13_TFAULT" 16497940 "DTC_MBB_14_TFAULT" 16497941 "DTC_MBB_15_TFAULT" 16497942 "DTC_MBB_16_TFAULT" 16497943 "DTC_MBB_17_TFAULT" 16497944 "DTC_MBB_18_TFAULT" 16497945 "DTC_MBB_19_TFAULT" 16497952 "DTC_MBB_20_TFAULT" 16497953 "DTC_MBB_21_TFAULT" 16497954 "DTC_MBB_22_TFAULT" 16497955 "DTC_MBB_23_TFAULT" 16497956 "DTC_MBB_24_TFAULT" 15785984 "DTC_PRECHARGE_ENERGY" 15785985 "DTC_PRT_FAILED" 15785986 "DTC_PRT_OVERTEMP" 15785987 "DTC_PRT_PROHIBIT" 16556032 "DTC_COOLANT_TEMP_OOR_HI" 16556033 "DTC_COOLANT_TEMP_OOR_LO" 16252928 "DTC_KEY_OFF_TIME_ERROR" 16506880 "DTC_VBAT_MISMATCH" 16506881 "DTC_VBAT_VMAX" 16506882 "DTC_VBAT_VMIN" 16506883 "DTC_PACK_FUSE" 15798544 "DTC_LLS1_OOR_HI" 15798545 "DTC_LLS1_OOR_LO" 15798546 "DTC_LLS1_FAULT" 15798816 "DTC_LLS2_OOR_HI" 15798817 "DTC_LLS2_OOR_LO" 15798818 "DTC_LLS2_FAULT" 14479360 "DTC_CFL_HEARTBEAT" 14479361 "DTC_CFL_FAULT" 14479362 "DTC_CFL_FAULT_LATCH" 13635584 "DTC_CONT_A_FAILED_HI" 13635585 "DTC_CONT_A_FAILED_LO" 13635586 "DTC_CONT_B_FAILED_HI" 13635587 "DTC_CONT_B_FAILED_LO" 13635588 "DTC_CONT_C_FAILED_HI" 13635589 "DTC_CONT_C_FAILED_LO" 13635590 "DTC_CONT_D_FAILED_HI" 13635591 "DTC_CONT_D_FAILED_LO" 13635592 "DTC_CONT_E_FAILED_HI" 13635593 "DTC_CONT_E_FAILED_LO" 13635594 "DTC_CONT_F_FAILED_HI" 13635595 "DTC_CONT_F_FAILED_LO" 13635596 "DTC_CONT_G_FAILED_HI" 13635597 "DTC_CONT_G_FAILED_LO" 13635598 "DTC_LSD_A_FAILED_HI" 13635599 "DTC_LSD_A_FAILED_LO" 13635600 "DTC_LSD_B_FAILED_HI" 13635601 "DTC_LSD_B_FAILED_LO" 13635602 "DTC_LSD_C_FAILED_HI" 13635603 "DTC_LSD_C_FAILED_LO" 13635606 "DTC_CONT_PWR_FAILED_HI" 13635607 "DTC_CONT_PWR_FAILED_LO" 13635608 "DTC_LSD_PUMP_FAILED_HI" 13635609 "DTC_LSD_PUMP_FAILED_LO" 13635610 "DTC_CHG_A_ENABLE_FAILED_HI" 13635611 "DTC_CHG_A_ENABLE_FAILED_LO" 13635612 "DTC_CHG_B_ENABLE_FAILED_HI" 13635613 "DTC_CHG_B_ENABLE_FAILED_LO" 13635614 "DTC_SW14V_PWR_FAILED_HI" 13635615 "DTC_SW14V_PWR_FAILED_LO" 13635620 "DTC_HSD_A_FAILED_HI" 13635621 "DTC_HSD_A_FAILED_LO" 13635622 "DTC_HSD_B_FAILED_HI" 13635623 "DTC_HSD_B_FAILED_LO" 13692968 "DTC_CONT_HPWR_FAILED_HI" 13692969 "DTC_CONT_HPWR_FAILED_LO" 13692970 "DTC_CONT_HPWR_OOR_HI" 13692971 "DTC_CONT_HPWR_OOR_LO" 13635616 "DTC_5V_PWR_OOR_HI" 13635617 "DTC_5V_PWR_OOR_LO" 14606336 "DTC_NVM_WRITE_TO" 14606337 "DTC_NVM_READ_TO" 14614528 "DTC_SPI_DIG_POT_FAULT" ;
VAL_ 1120 bcm_dtc_074 0 " - " 11276288 "DTC_VEPO" 11276289 "DTC_HSC_MISSING" 11460608 "DTC_NVM_SOC" 11460609 "DTC_NVM_KOT" 11460610 "DTC_NVM_DTC" 11460611 "DTC_NVM_SOC_CORRECTION" 11460612 "DTC_NVM_APP_SCRATCHPAD" 11517962 "DTC_LOOPTIME_TASK_A" 11517963 "DTC_LOOPTIME_TASK_B" 11517964 "DTC_LOOPTIME_TASK_C" 11517965 "DTC_LOOPTIME_TASK_D" 11517966 "DTC_LOOPTIME_TASK_E" 11517967 "DTC_LOOPTIME_TASK_F" 11323904 "DTC_INTERLOCK_A_FAILED_LOW" 11323905 "DTC_INTERLOCK_A_FAILED_HIGH" 11324160 "DTC_INTERLOCK_B_FAILED_LOW" 11324161 "DTC_INTERLOCK_B_FAILED_HIGH" 15728640 "DTC_EPO" 16498688 "DTC_BRUSA_MISSING" 16498689 "DTC_BRUSA_IDC" 16498690 "DTC_BRUSA_REQ_VS_CMD" 16433152 "DTC_AKERWADE_MISSING" 16433153 "DTC_AKERWADE_IDC" 16433154 "DTC_AKERWADE_REQ_VS_CMD" 16564224 "DTC_CHGLEAR_MISSING" 16564225 "DTC_CHGLEAR_IDC" 16564226 "DTC_CHGLEAR_REQ_VS_CMD" 16522240 "DTC_CSM_MISSING" 16522752 "DTC_CSM_VBAT" 16522753 "DTC_CSM_VPOS" 16522754 "DTC_CSM_VNEG" 16522755 "DTC_CSM_CPOS" 16522756 "DTC_CSM_CNEG" 16522757 "DTC_CSM_APOS" 16522758 "DTC_CSM_ANEG" 16522759 "DTC_CSM_FUSE_HI" 16522760 "DTC_CSM_FUSE_LO" 16521728 "DTC_CSM_ASIC" 16521729 "DTC_CSM_AILO" 16521730 "DTC_CSM_AIHI" 16520957 "DTC_LEAKAGE_DETECT_FAULT" 16522444 "DTC_REALTIMECLOCK_FAULT" 16520945 "DTC_CSM_LEAK_FAIL_CALC" 16520946 "DTC_CSM_LEAK_FAIL_HW" 16520947 "DTC_CSM_LEAK_EXT_SHORT" 16520948 "DTC_CSM_LEAK_MID_PACK_SHORT" 16520949 "DTC_CSM_LEAK_ERROR" 16520950 "DTC_CSM_LEAK_UNKNOWN" 16523008 "DTC_CSM_VER_MISMATCH" 16523009 "DTC_CSM_DTC_SET" 16523010 "DTC_CSM_CAL_FAULT" 16560128 "DTC_IBAT_MISMATCH" 16576512 "DTC_DIS_MAX_I2T" 16576513 "DTC_CHG_MAX_I2T" 16576768 "DTC_DIS_WARNING_I2T" 16576769 "DTC_CHG_WARNING_I2T" 11296784 "DTC_SAEJ1772_PROX_DECT_OOR_HI" 11296785 "DTC_SAEJ1772_PROX_DECT_OOR_LO" 11296800 "DTC_SAEJ1772_PILOT_PWM_OOR_HI" 11296801 "DTC_SAEJ1772_PILOT_PWM_OOR_LO" 11296802 "DTC_SAEJ1772_PILOT_PWM_DIG_COMM" 11296803 "DTC_SAEJ1772_PILOT_PWM_IR_ERR" 16175360 "DTC_FGD1_NO_SENSOR" 16175361 "DTC_FGD1_OOR_HI" 16175362 "DTC_FGD1_OOR_LO" 16175363 "DTC_FGD1_FAULT" 16175616 "DTC_FGD2_NO_SENSOR" 16175617 "DTC_FGD2_OOR_HI" 16175618 "DTC_FGD2_OOR_LO" 16175619 "DTC_FGD2_FAULT" 16171008 "DTC_CONT_OPEN" 16171009 "DTC_CONT_CLOSE" 16171010 "DTC_CONT_OPEN_CURRENT" 16171264 "DTC_CONT_CLOSE_ON_RESET" 16171265 "DTC_CONT_CLOSE_SIG_FAILED" 16171520 "DTC_PRECHARGE_TIMEOUT" 16171777 "DTC_CONT_MPOS_WELD_AT_SU" 16171778 "DTC_CONT_MNEG_WELD_AT_SU" 16171780 "DTC_CONT_CPOS_WELD_AT_SU" 16171781 "DTC_CONT_CNEG_WELD_AT_SU" 16171782 "DTC_CONT_ANEG_WELD_AT_SU" 16171783 "DTC_CONT_APOS_WELD_AT_SU" 16172033 "DTC_CONT_MPOS_WELD_AT_SD" 16172034 "DTC_CONT_MNEG_WELD_AT_SD" 16172036 "DTC_CONT_CPOS_WELD_AT_SD" 16172037 "DTC_CONT_CNEG_WELD_AT_SD" 16172038 "DTC_CONT_ANEG_WELD_AT_SD" 16172039 "DTC_CONT_APOS_WELD_AT_SD" 16172289 "DTC_CONT_MPOS_OPEN" 16172290 "DTC_CONT_MNEG_OPEN" 16172291 "DTC_CONT_MPRE_OPEN" 16172292 "DTC_CONT_CPOS_OPEN" 16172293 "DTC_CONT_CNEG_OPEN" 16172294 "DTC_CONT_APOS_OPEN" 16172295 "DTC_CONT_ANEG_OPEN" 16172545 "DTC_CONT_MPOS_VDIF" 16172546 "DTC_CONT_MNEG_VDIF" 16172548 "DTC_CONT_CPOS_VDIF" 16172549 "DTC_CONT_CNEG_VDIF" 16172550 "DTC_CONT_APOS_VDIF" 16172551 "DTC_CONT_ANEG_VDIF" 16174848 "DTC_HVIL" 16174849 "DTC_LVBAT_LO" 16174850 "DTC_LVBAT_HI" 16174851 "DTC_LVBAT_ERR" 16523520 "DTC_LEMLO_OOR_HI" 16523521 "DTC_LEMLO_OOR_LO" 16523522 "DTC_LEMLO_FAULT" 16523776 "DTC_LEMHI_OOR_HI" 16523777 "DTC_LEMHI_OOR_LO" 16523778 "DTC_LEMHI_FAULT" 16496320 "DTC_MBB_TOO_FEW" 16496321 "DTC_MBB_TOO_MANY" 16496352 "DTC_CELL_VMAX_ERR" 16496353 "DTC_CELL_VMIN_ERR" 16496354 "DTC_CELL_VMAX" 16496362 "DTC_CELL_VMAX_SEVERE" 16496355 "DTC_CELL_VMIN" 16496363 "DTC_CELL_VMIN_SEVERE" 16496356 "DTC_MOD_VOLTAGE_COMPARE" 16496336 "DTC_CELL_T_ERR" 16496337 "DTC_CELL_TMAX1" 16496338 "DTC_CELL_TMAX2" 16496339 "DTC_CELL_TMIN" 16497665 "DTC_MBB_01_MISSING" 16497666 "DTC_MBB_02_MISSING" 16497667 "DTC_MBB_03_MISSING" 16497668 "DTC_MBB_04_MISSING" 16497669 "DTC_MBB_05_MISSING" 16497670 "DTC_MBB_06_MISSING" 16497671 "DTC_MBB_07_MISSING" 16497672 "DTC_MBB_08_MISSING" 16497673 "DTC_MBB_09_MISSING" 16497680 "DTC_MBB_10_MISSING" 16497681 "DTC_MBB_11_MISSING" 16497682 "DTC_MBB_12_MISSING" 16497683 "DTC_MBB_13_MISSING" 16497684 "DTC_MBB_14_MISSING" 16497685 "DTC_MBB_15_MISSING" 16497686 "DTC_MBB_16_MISSING" 16497687 "DTC_MBB_17_MISSING" 16497688 "DTC_MBB_18_MISSING" 16497689 "DTC_MBB_19_MISSING" 16497696 "DTC_MBB_20_MISSING" 16497697 "DTC_MBB_21_MISSING" 16497698 "DTC_MBB_22_MISSING" 16497699 "DTC_MBB_23_MISSING" 16497700 "DTC_MBB_24_MISSING" 16498177 "DTC_MBB_01_VFAULT" 16498178 "DTC_MBB_02_VFAULT" 16498179 "DTC_MBB_03_VFAULT" 16498180 "DTC_MBB_04_VFAULT" 16498181 "DTC_MBB_05_VFAULT" 16498182 "DTC_MBB_06_VFAULT" 16498183 "DTC_MBB_07_VFAULT" 16498184 "DTC_MBB_08_VFAULT" 16498185 "DTC_MBB_09_VFAULT" 16498192 "DTC_MBB_10_VFAULT" 16498193 "DTC_MBB_11_VFAULT" 16498194 "DTC_MBB_12_VFAULT" 16498195 "DTC_MBB_13_VFAULT" 16498196 "DTC_MBB_14_VFAULT" 16498197 "DTC_MBB_15_VFAULT" 16498198 "DTC_MBB_16_VFAULT" 16498199 "DTC_MBB_17_VFAULT" 16498200 "DTC_MBB_18_VFAULT" 16498201 "DTC_MBB_19_VFAULT" 16498208 "DTC_MBB_20_VFAULT" 16498209 "DTC_MBB_21_VFAULT" 16498210 "DTC_MBB_22_VFAULT" 16498211 "DTC_MBB_23_VFAULT" 16498212 "DTC_MBB_24_VFAULT" 16497921 "DTC_MBB_01_TFAULT" 16497922 "DTC_MBB_02_TFAULT" 16497923 "DTC_MBB_03_TFAULT" 16497924 "DTC_MBB_04_TFAULT" 16497925 "DTC_MBB_05_TFAULT" 16497926 "DTC_MBB_06_TFAULT" 16497927 "DTC_MBB_07_TFAULT" 16497928 "DTC_MBB_08_TFAULT" 16497929 "DTC_MBB_09_TFAULT" 16497936 "DTC_MBB_10_TFAULT" 16497937 "DTC_MBB_11_TFAULT" 16497938 "DTC_MBB_12_TFAULT" 16497939 "DTC_MBB_13_TFAULT" 16497940 "DTC_MBB_14_TFAULT" 16497941 "DTC_MBB_15_TFAULT" 16497942 "DTC_MBB_16_TFAULT" 16497943 "DTC_MBB_17_TFAULT" 16497944 "DTC_MBB_18_TFAULT" 16497945 "DTC_MBB_19_TFAULT" 16497952 "DTC_MBB_20_TFAULT" 16497953 "DTC_MBB_21_TFAULT" 16497954 "DTC_MBB_22_TFAULT" 16497955 "DTC_MBB_23_TFAULT" 16497956 "DTC_MBB_24_TFAULT" 15785984 "DTC_PRECHARGE_ENERGY" 15785985 "DTC_PRT_FAILED" 15785986 "DTC_PRT_OVERTEMP" 15785987 "DTC_PRT_PROHIBIT" 16556032 "DTC_COOLANT_TEMP_OOR_HI" 16556033 "DTC_COOLANT_TEMP_OOR_LO" 16252928 "DTC_KEY_OFF_TIME_ERROR" 16506880 "DTC_VBAT_MISMATCH" 16506881 "DTC_VBAT_VMAX" 16506882 "DTC_VBAT_VMIN" 16506883 "DTC_PACK_FUSE" 15798544 "DTC_LLS1_OOR_HI" 15798545 "DTC_LLS1_OOR_LO" 15798546 "DTC_LLS1_FAULT" 15798816 "DTC_LLS2_OOR_HI" 15798817 "DTC_LLS2_OOR_LO" 15798818 "DTC_LLS2_FAULT" 14479360 "DTC_CFL_HEARTBEAT" 14479361 "DTC_CFL_FAULT" 14479362 "DTC_CFL_FAULT_LATCH" 13635584 "DTC_CONT_A_FAILED_HI" 13635585 "DTC_CONT_A_FAILED_LO" 13635586 "DTC_CONT_B_FAILED_HI" 13635587 "DTC_CONT_B_FAILED_LO" 13635588 "DTC_CONT_C_FAILED_HI" 13635589 "DTC_CONT_C_FAILED_LO" 13635590 "DTC_CONT_D_FAILED_HI" 13635591 "DTC_CONT_D_FAILED_LO" 13635592 "DTC_CONT_E_FAILED_HI" 13635593 "DTC_CONT_E_FAILED_LO" 13635594 "DTC_CONT_F_FAILED_HI" 13635595 "DTC_CONT_F_FAILED_LO" 13635596 "DTC_CONT_G_FAILED_HI" 13635597 "DTC_CONT_G_FAILED_LO" 13635598 "DTC_LSD_A_FAILED_HI" 13635599 "DTC_LSD_A_FAILED_LO" 13635600 "DTC_LSD_B_FAILED_HI" 13635601 "DTC_LSD_B_FAILED_LO" 13635602 "DTC_LSD_C_FAILED_HI" 13635603 "DTC_LSD_C_FAILED_LO" 13635606 "DTC_CONT_PWR_FAILED_HI" 13635607 "DTC_CONT_PWR_FAILED_LO" 13635608 "DTC_LSD_PUMP_FAILED_HI" 13635609 "DTC_LSD_PUMP_FAILED_LO" 13635610 "DTC_CHG_A_ENABLE_FAILED_HI" 13635611 "DTC_CHG_A_ENABLE_FAILED_LO" 13635612 "DTC_CHG_B_ENABLE_FAILED_HI" 13635613 "DTC_CHG_B_ENABLE_FAILED_LO" 13635614 "DTC_SW14V_PWR_FAILED_HI" 13635615 "DTC_SW14V_PWR_FAILED_LO" 13635620 "DTC_HSD_A_FAILED_HI" 13635621 "DTC_HSD_A_FAILED_LO" 13635622 "DTC_HSD_B_FAILED_HI" 13635623 "DTC_HSD_B_FAILED_LO" 13692968 "DTC_CONT_HPWR_FAILED_HI" 13692969 "DTC_CONT_HPWR_FAILED_LO" 13692970 "DTC_CONT_HPWR_OOR_HI" 13692971 "DTC_CONT_HPWR_OOR_LO" 13635616 "DTC_5V_PWR_OOR_HI" 13635617 "DTC_5V_PWR_OOR_LO" 14606336 "DTC_NVM_WRITE_TO" 14606337 "DTC_NVM_READ_TO" 14614528 "DTC_SPI_DIG_POT_FAULT" ;
VAL_ 1120 bcm_dtc_075 0 " - " 11276288 "DTC_VEPO" 11276289 "DTC_HSC_MISSING" 11460608 "DTC_NVM_SOC" 11460609 "DTC_NVM_KOT" 11460610 "DTC_NVM_DTC" 11460611 "DTC_NVM_SOC_CORRECTION" 11460612 "DTC_NVM_APP_SCRATCHPAD" 11517962 "DTC_LOOPTIME_TASK_A" 11517963 "DTC_LOOPTIME_TASK_B" 11517964 "DTC_LOOPTIME_TASK_C" 11517965 "DTC_LOOPTIME_TASK_D" 11517966 "DTC_LOOPTIME_TASK_E" 11517967 "DTC_LOOPTIME_TASK_F" 11323904 "DTC_INTERLOCK_A_FAILED_LOW" 11323905 "DTC_INTERLOCK_A_FAILED_HIGH" 11324160 "DTC_INTERLOCK_B_FAILED_LOW" 11324161 "DTC_INTERLOCK_B_FAILED_HIGH" 15728640 "DTC_EPO" 16498688 "DTC_BRUSA_MISSING" 16498689 "DTC_BRUSA_IDC" 16498690 "DTC_BRUSA_REQ_VS_CMD" 16433152 "DTC_AKERWADE_MISSING" 16433153 "DTC_AKERWADE_IDC" 16433154 "DTC_AKERWADE_REQ_VS_CMD" 16564224 "DTC_CHGLEAR_MISSING" 16564225 "DTC_CHGLEAR_IDC" 16564226 "DTC_CHGLEAR_REQ_VS_CMD" 16522240 "DTC_CSM_MISSING" 16522752 "DTC_CSM_VBAT" 16522753 "DTC_CSM_VPOS" 16522754 "DTC_CSM_VNEG" 16522755 "DTC_CSM_CPOS" 16522756 "DTC_CSM_CNEG" 16522757 "DTC_CSM_APOS" 16522758 "DTC_CSM_ANEG" 16522759 "DTC_CSM_FUSE_HI" 16522760 "DTC_CSM_FUSE_LO" 16521728 "DTC_CSM_ASIC" 16521729 "DTC_CSM_AILO" 16521730 "DTC_CSM_AIHI" 16520957 "DTC_LEAKAGE_DETECT_FAULT" 16522444 "DTC_REALTIMECLOCK_FAULT" 16520945 "DTC_CSM_LEAK_FAIL_CALC" 16520946 "DTC_CSM_LEAK_FAIL_HW" 16520947 "DTC_CSM_LEAK_EXT_SHORT" 16520948 "DTC_CSM_LEAK_MID_PACK_SHORT" 16520949 "DTC_CSM_LEAK_ERROR" 16520950 "DTC_CSM_LEAK_UNKNOWN" 16523008 "DTC_CSM_VER_MISMATCH" 16523009 "DTC_CSM_DTC_SET" 16523010 "DTC_CSM_CAL_FAULT" 16560128 "DTC_IBAT_MISMATCH" 16576512 "DTC_DIS_MAX_I2T" 16576513 "DTC_CHG_MAX_I2T" 16576768 "DTC_DIS_WARNING_I2T" 16576769 "DTC_CHG_WARNING_I2T" 11296784 "DTC_SAEJ1772_PROX_DECT_OOR_HI" 11296785 "DTC_SAEJ1772_PROX_DECT_OOR_LO" 11296800 "DTC_SAEJ1772_PILOT_PWM_OOR_HI" 11296801 "DTC_SAEJ1772_PILOT_PWM_OOR_LO" 11296802 "DTC_SAEJ1772_PILOT_PWM_DIG_COMM" 11296803 "DTC_SAEJ1772_PILOT_PWM_IR_ERR" 16175360 "DTC_FGD1_NO_SENSOR" 16175361 "DTC_FGD1_OOR_HI" 16175362 "DTC_FGD1_OOR_LO" 16175363 "DTC_FGD1_FAULT" 16175616 "DTC_FGD2_NO_SENSOR" 16175617 "DTC_FGD2_OOR_HI" 16175618 "DTC_FGD2_OOR_LO" 16175619 "DTC_FGD2_FAULT" 16171008 "DTC_CONT_OPEN" 16171009 "DTC_CONT_CLOSE" 16171010 "DTC_CONT_OPEN_CURRENT" 16171264 "DTC_CONT_CLOSE_ON_RESET" 16171265 "DTC_CONT_CLOSE_SIG_FAILED" 16171520 "DTC_PRECHARGE_TIMEOUT" 16171777 "DTC_CONT_MPOS_WELD_AT_SU" 16171778 "DTC_CONT_MNEG_WELD_AT_SU" 16171780 "DTC_CONT_CPOS_WELD_AT_SU" 16171781 "DTC_CONT_CNEG_WELD_AT_SU" 16171782 "DTC_CONT_ANEG_WELD_AT_SU" 16171783 "DTC_CONT_APOS_WELD_AT_SU" 16172033 "DTC_CONT_MPOS_WELD_AT_SD" 16172034 "DTC_CONT_MNEG_WELD_AT_SD" 16172036 "DTC_CONT_CPOS_WELD_AT_SD" 16172037 "DTC_CONT_CNEG_WELD_AT_SD" 16172038 "DTC_CONT_ANEG_WELD_AT_SD" 16172039 "DTC_CONT_APOS_WELD_AT_SD" 16172289 "DTC_CONT_MPOS_OPEN" 16172290 "DTC_CONT_MNEG_OPEN" 16172291 "DTC_CONT_MPRE_OPEN" 16172292 "DTC_CONT_CPOS_OPEN" 16172293 "DTC_CONT_CNEG_OPEN" 16172294 "DTC_CONT_APOS_OPEN" 16172295 "DTC_CONT_ANEG_OPEN" 16172545 "DTC_CONT_MPOS_VDIF" 16172546 "DTC_CONT_MNEG_VDIF" 16172548 "DTC_CONT_CPOS_VDIF" 16172549 "DTC_CONT_CNEG_VDIF" 16172550 "DTC_CONT_APOS_VDIF" 16172551 "DTC_CONT_ANEG_VDIF" 16174848 "DTC_HVIL" 16174849 "DTC_LVBAT_LO" 16174850 "DTC_LVBAT_HI" 16174851 "DTC_LVBAT_ERR" 16523520 "DTC_LEMLO_OOR_HI" 16523521 "DTC_LEMLO_OOR_LO" 16523522 "DTC_LEMLO_FAULT" 16523776 "DTC_LEMHI_OOR_HI" 16523777 "DTC_LEMHI_OOR_LO" 16523778 "DTC_LEMHI_FAULT" 16496320 "DTC_MBB_TOO_FEW" 16496321 "DTC_MBB_TOO_MANY" 16496352 "DTC_CELL_VMAX_ERR" 16496353 "DTC_CELL_VMIN_ERR" 16496354 "DTC_CELL_VMAX" 16496362 "DTC_CELL_VMAX_SEVERE" 16496355 "DTC_CELL_VMIN" 16496363 "DTC_CELL_VMIN_SEVERE" 16496356 "DTC_MOD_VOLTAGE_COMPARE" 16496336 "DTC_CELL_T_ERR" 16496337 "DTC_CELL_TMAX1" 16496338 "DTC_CELL_TMAX2" 16496339 "DTC_CELL_TMIN" 16497665 "DTC_MBB_01_MISSING" 16497666 "DTC_MBB_02_MISSING" 16497667 "DTC_MBB_03_MISSING" 16497668 "DTC_MBB_04_MISSING" 16497669 "DTC_MBB_05_MISSING" 16497670 "DTC_MBB_06_MISSING" 16497671 "DTC_MBB_07_MISSING" 16497672 "DTC_MBB_08_MISSING" 16497673 "DTC_MBB_09_MISSING" 16497680 "DTC_MBB_10_MISSING" 16497681 "DTC_MBB_11_MISSING" 16497682 "DTC_MBB_12_MISSING" 16497683 "DTC_MBB_13_MISSING" 16497684 "DTC_MBB_14_MISSING" 16497685 "DTC_MBB_15_MISSING" 16497686 "DTC_MBB_16_MISSING" 16497687 "DTC_MBB_17_MISSING" 16497688 "DTC_MBB_18_MISSING" 16497689 "DTC_MBB_19_MISSING" 16497696 "DTC_MBB_20_MISSING" 16497697 "DTC_MBB_21_MISSING" 16497698 "DTC_MBB_22_MISSING" 16497699 "DTC_MBB_23_MISSING" 16497700 "DTC_MBB_24_MISSING" 16498177 "DTC_MBB_01_VFAULT" 16498178 "DTC_MBB_02_VFAULT" 16498179 "DTC_MBB_03_VFAULT" 16498180 "DTC_MBB_04_VFAULT" 16498181 "DTC_MBB_05_VFAULT" 16498182 "DTC_MBB_06_VFAULT" 16498183 "DTC_MBB_07_VFAULT" 16498184 "DTC_MBB_08_VFAULT" 16498185 "DTC_MBB_09_VFAULT" 16498192 "DTC_MBB_10_VFAULT" 16498193 "DTC_MBB_11_VFAULT" 16498194 "DTC_MBB_12_VFAULT" 16498195 "DTC_MBB_13_VFAULT" 16498196 "DTC_MBB_14_VFAULT" 16498197 "DTC_MBB_15_VFAULT" 16498198 "DTC_MBB_16_VFAULT" 16498199 "DTC_MBB_17_VFAULT" 16498200 "DTC_MBB_18_VFAULT" 16498201 "DTC_MBB_19_VFAULT" 16498208 "DTC_MBB_20_VFAULT" 16498209 "DTC_MBB_21_VFAULT" 16498210 "DTC_MBB_22_VFAULT" 16498211 "DTC_MBB_23_VFAULT" 16498212 "DTC_MBB_24_VFAULT" 16497921 "DTC_MBB_01_TFAULT" 16497922 "DTC_MBB_02_TFAULT" 16497923 "DTC_MBB_03_TFAULT" 16497924 "DTC_MBB_04_TFAULT" 16497925 "DTC_MBB_05_TFAULT" 16497926 "DTC_MBB_06_TFAULT" 16497927 "DTC_MBB_07_TFAULT" 16497928 "DTC_MBB_08_TFAULT" 16497929 "DTC_MBB_09_TFAULT" 16497936 "DTC_MBB_10_TFAULT" 16497937 "DTC_MBB_11_TFAULT" 16497938 "DTC_MBB_12_TFAULT" 16497939 "DTC_MBB_13_TFAULT" 16497940 "DTC_MBB_14_TFAULT" 16497941 "DTC_MBB_15_TFAULT" 16497942 "DTC_MBB_16_TFAULT" 16497943 "DTC_MBB_17_TFAULT" 16497944 "DTC_MBB_18_TFAULT" 16497945 "DTC_MBB_19_TFAULT" 16497952 "DTC_MBB_20_TFAULT" 16497953 "DTC_MBB_21_TFAULT" 16497954 "DTC_MBB_22_TFAULT" 16497955 "DTC_MBB_23_TFAULT" 16497956 "DTC_MBB_24_TFAULT" 15785984 "DTC_PRECHARGE_ENERGY" 15785985 "DTC_PRT_FAILED" 15785986 "DTC_PRT_OVERTEMP" 15785987 "DTC_PRT_PROHIBIT" 16556032 "DTC_COOLANT_TEMP_OOR_HI" 16556033 "DTC_COOLANT_TEMP_OOR_LO" 16252928 "DTC_KEY_OFF_TIME_ERROR" 16506880 "DTC_VBAT_MISMATCH" 16506881 "DTC_VBAT_VMAX" 16506882 "DTC_VBAT_VMIN" 16506883 "DTC_PACK_FUSE" 15798544 "DTC_LLS1_OOR_HI" 15798545 "DTC_LLS1_OOR_LO" 15798546 "DTC_LLS1_FAULT" 15798816 "DTC_LLS2_OOR_HI" 15798817 "DTC_LLS2_OOR_LO" 15798818 "DTC_LLS2_FAULT" 14479360 "DTC_CFL_HEARTBEAT" 14479361 "DTC_CFL_FAULT" 14479362 "DTC_CFL_FAULT_LATCH" 13635584 "DTC_CONT_A_FAILED_HI" 13635585 "DTC_CONT_A_FAILED_LO" 13635586 "DTC_CONT_B_FAILED_HI" 13635587 "DTC_CONT_B_FAILED_LO" 13635588 "DTC_CONT_C_FAILED_HI" 13635589 "DTC_CONT_C_FAILED_LO" 13635590 "DTC_CONT_D_FAILED_HI" 13635591 "DTC_CONT_D_FAILED_LO" 13635592 "DTC_CONT_E_FAILED_HI" 13635593 "DTC_CONT_E_FAILED_LO" 13635594 "DTC_CONT_F_FAILED_HI" 13635595 "DTC_CONT_F_FAILED_LO" 13635596 "DTC_CONT_G_FAILED_HI" 13635597 "DTC_CONT_G_FAILED_LO" 13635598 "DTC_LSD_A_FAILED_HI" 13635599 "DTC_LSD_A_FAILED_LO" 13635600 "DTC_LSD_B_FAILED_HI" 13635601 "DTC_LSD_B_FAILED_LO" 13635602 "DTC_LSD_C_FAILED_HI" 13635603 "DTC_LSD_C_FAILED_LO" 13635606 "DTC_CONT_PWR_FAILED_HI" 13635607 "DTC_CONT_PWR_FAILED_LO" 13635608 "DTC_LSD_PUMP_FAILED_HI" 13635609 "DTC_LSD_PUMP_FAILED_LO" 13635610 "DTC_CHG_A_ENABLE_FAILED_HI" 13635611 "DTC_CHG_A_ENABLE_FAILED_LO" 13635612 "DTC_CHG_B_ENABLE_FAILED_HI" 13635613 "DTC_CHG_B_ENABLE_FAILED_LO" 13635614 "DTC_SW14V_PWR_FAILED_HI" 13635615 "DTC_SW14V_PWR_FAILED_LO" 13635620 "DTC_HSD_A_FAILED_HI" 13635621 "DTC_HSD_A_FAILED_LO" 13635622 "DTC_HSD_B_FAILED_HI" 13635623 "DTC_HSD_B_FAILED_LO" 13692968 "DTC_CONT_HPWR_FAILED_HI" 13692969 "DTC_CONT_HPWR_FAILED_LO" 13692970 "DTC_CONT_HPWR_OOR_HI" 13692971 "DTC_CONT_HPWR_OOR_LO" 13635616 "DTC_5V_PWR_OOR_HI" 13635617 "DTC_5V_PWR_OOR_LO" 14606336 "DTC_NVM_WRITE_TO" 14606337 "DTC_NVM_READ_TO" 14614528 "DTC_SPI_DIG_POT_FAULT" ;
VAL_ 1120 bcm_dtc_076 0 " - " 11276288 "DTC_VEPO" 11276289 "DTC_HSC_MISSING" 11460608 "DTC_NVM_SOC" 11460609 "DTC_NVM_KOT" 11460610 "DTC_NVM_DTC" 11460611 "DTC_NVM_SOC_CORRECTION" 11460612 "DTC_NVM_APP_SCRATCHPAD" 11517962 "DTC_LOOPTIME_TASK_A" 11517963 "DTC_LOOPTIME_TASK_B" 11517964 "DTC_LOOPTIME_TASK_C" 11517965 "DTC_LOOPTIME_TASK_D" 11517966 "DTC_LOOPTIME_TASK_E" 11517967 "DTC_LOOPTIME_TASK_F" 11323904 "DTC_INTERLOCK_A_FAILED_LOW" 11323905 "DTC_INTERLOCK_A_FAILED_HIGH" 11324160 "DTC_INTERLOCK_B_FAILED_LOW" 11324161 "DTC_INTERLOCK_B_FAILED_HIGH" 15728640 "DTC_EPO" 16498688 "DTC_BRUSA_MISSING" 16498689 "DTC_BRUSA_IDC" 16498690 "DTC_BRUSA_REQ_VS_CMD" 16433152 "DTC_AKERWADE_MISSING" 16433153 "DTC_AKERWADE_IDC" 16433154 "DTC_AKERWADE_REQ_VS_CMD" 16564224 "DTC_CHGLEAR_MISSING" 16564225 "DTC_CHGLEAR_IDC" 16564226 "DTC_CHGLEAR_REQ_VS_CMD" 16522240 "DTC_CSM_MISSING" 16522752 "DTC_CSM_VBAT" 16522753 "DTC_CSM_VPOS" 16522754 "DTC_CSM_VNEG" 16522755 "DTC_CSM_CPOS" 16522756 "DTC_CSM_CNEG" 16522757 "DTC_CSM_APOS" 16522758 "DTC_CSM_ANEG" 16522759 "DTC_CSM_FUSE_HI" 16522760 "DTC_CSM_FUSE_LO" 16521728 "DTC_CSM_ASIC" 16521729 "DTC_CSM_AILO" 16521730 "DTC_CSM_AIHI" 16520957 "DTC_LEAKAGE_DETECT_FAULT" 16522444 "DTC_REALTIMECLOCK_FAULT" 16520945 "DTC_CSM_LEAK_FAIL_CALC" 16520946 "DTC_CSM_LEAK_FAIL_HW" 16520947 "DTC_CSM_LEAK_EXT_SHORT" 16520948 "DTC_CSM_LEAK_MID_PACK_SHORT" 16520949 "DTC_CSM_LEAK_ERROR" 16520950 "DTC_CSM_LEAK_UNKNOWN" 16523008 "DTC_CSM_VER_MISMATCH" 16523009 "DTC_CSM_DTC_SET" 16523010 "DTC_CSM_CAL_FAULT" 16560128 "DTC_IBAT_MISMATCH" 16576512 "DTC_DIS_MAX_I2T" 16576513 "DTC_CHG_MAX_I2T" 16576768 "DTC_DIS_WARNING_I2T" 16576769 "DTC_CHG_WARNING_I2T" 11296784 "DTC_SAEJ1772_PROX_DECT_OOR_HI" 11296785 "DTC_SAEJ1772_PROX_DECT_OOR_LO" 11296800 "DTC_SAEJ1772_PILOT_PWM_OOR_HI" 11296801 "DTC_SAEJ1772_PILOT_PWM_OOR_LO" 11296802 "DTC_SAEJ1772_PILOT_PWM_DIG_COMM" 11296803 "DTC_SAEJ1772_PILOT_PWM_IR_ERR" 16175360 "DTC_FGD1_NO_SENSOR" 16175361 "DTC_FGD1_OOR_HI" 16175362 "DTC_FGD1_OOR_LO" 16175363 "DTC_FGD1_FAULT" 16175616 "DTC_FGD2_NO_SENSOR" 16175617 "DTC_FGD2_OOR_HI" 16175618 "DTC_FGD2_OOR_LO" 16175619 "DTC_FGD2_FAULT" 16171008 "DTC_CONT_OPEN" 16171009 "DTC_CONT_CLOSE" 16171010 "DTC_CONT_OPEN_CURRENT" 16171264 "DTC_CONT_CLOSE_ON_RESET" 16171265 "DTC_CONT_CLOSE_SIG_FAILED" 16171520 "DTC_PRECHARGE_TIMEOUT" 16171777 "DTC_CONT_MPOS_WELD_AT_SU" 16171778 "DTC_CONT_MNEG_WELD_AT_SU" 16171780 "DTC_CONT_CPOS_WELD_AT_SU" 16171781 "DTC_CONT_CNEG_WELD_AT_SU" 16171782 "DTC_CONT_ANEG_WELD_AT_SU" 16171783 "DTC_CONT_APOS_WELD_AT_SU" 16172033 "DTC_CONT_MPOS_WELD_AT_SD" 16172034 "DTC_CONT_MNEG_WELD_AT_SD" 16172036 "DTC_CONT_CPOS_WELD_AT_SD" 16172037 "DTC_CONT_CNEG_WELD_AT_SD" 16172038 "DTC_CONT_ANEG_WELD_AT_SD" 16172039 "DTC_CONT_APOS_WELD_AT_SD" 16172289 "DTC_CONT_MPOS_OPEN" 16172290 "DTC_CONT_MNEG_OPEN" 16172291 "DTC_CONT_MPRE_OPEN" 16172292 "DTC_CONT_CPOS_OPEN" 16172293 "DTC_CONT_CNEG_OPEN" 16172294 "DTC_CONT_APOS_OPEN" 16172295 "DTC_CONT_ANEG_OPEN" 16172545 "DTC_CONT_MPOS_VDIF" 16172546 "DTC_CONT_MNEG_VDIF" 16172548 "DTC_CONT_CPOS_VDIF" 16172549 "DTC_CONT_CNEG_VDIF" 16172550 "DTC_CONT_APOS_VDIF" 16172551 "DTC_CONT_ANEG_VDIF" 16174848 "DTC_HVIL" 16174849 "DTC_LVBAT_LO" 16174850 "DTC_LVBAT_HI" 16174851 "DTC_LVBAT_ERR" 16523520 "DTC_LEMLO_OOR_HI" 16523521 "DTC_LEMLO_OOR_LO" 16523522 "DTC_LEMLO_FAULT" 16523776 "DTC_LEMHI_OOR_HI" 16523777 "DTC_LEMHI_OOR_LO" 16523778 "DTC_LEMHI_FAULT" 16496320 "DTC_MBB_TOO_FEW" 16496321 "DTC_MBB_TOO_MANY" 16496352 "DTC_CELL_VMAX_ERR" 16496353 "DTC_CELL_VMIN_ERR" 16496354 "DTC_CELL_VMAX" 16496362 "DTC_CELL_VMAX_SEVERE" 16496355 "DTC_CELL_VMIN" 16496363 "DTC_CELL_VMIN_SEVERE" 16496356 "DTC_MOD_VOLTAGE_COMPARE" 16496336 "DTC_CELL_T_ERR" 16496337 "DTC_CELL_TMAX1" 16496338 "DTC_CELL_TMAX2" 16496339 "DTC_CELL_TMIN" 16497665 "DTC_MBB_01_MISSING" 16497666 "DTC_MBB_02_MISSING" 16497667 "DTC_MBB_03_MISSING" 16497668 "DTC_MBB_04_MISSING" 16497669 "DTC_MBB_05_MISSING" 16497670 "DTC_MBB_06_MISSING" 16497671 "DTC_MBB_07_MISSING" 16497672 "DTC_MBB_08_MISSING" 16497673 "DTC_MBB_09_MISSING" 16497680 "DTC_MBB_10_MISSING" 16497681 "DTC_MBB_11_MISSING" 16497682 "DTC_MBB_12_MISSING" 16497683 "DTC_MBB_13_MISSING" 16497684 "DTC_MBB_14_MISSING" 16497685 "DTC_MBB_15_MISSING" 16497686 "DTC_MBB_16_MISSING" 16497687 "DTC_MBB_17_MISSING" 16497688 "DTC_MBB_18_MISSING" 16497689 "DTC_MBB_19_MISSING" 16497696 "DTC_MBB_20_MISSING" 16497697 "DTC_MBB_21_MISSING" 16497698 "DTC_MBB_22_MISSING" 16497699 "DTC_MBB_23_MISSING" 16497700 "DTC_MBB_24_MISSING" 16498177 "DTC_MBB_01_VFAULT" 16498178 "DTC_MBB_02_VFAULT" 16498179 "DTC_MBB_03_VFAULT" 16498180 "DTC_MBB_04_VFAULT" 16498181 "DTC_MBB_05_VFAULT" 16498182 "DTC_MBB_06_VFAULT" 16498183 "DTC_MBB_07_VFAULT" 16498184 "DTC_MBB_08_VFAULT" 16498185 "DTC_MBB_09_VFAULT" 16498192 "DTC_MBB_10_VFAULT" 16498193 "DTC_MBB_11_VFAULT" 16498194 "DTC_MBB_12_VFAULT" 16498195 "DTC_MBB_13_VFAULT" 16498196 "DTC_MBB_14_VFAULT" 16498197 "DTC_MBB_15_VFAULT" 16498198 "DTC_MBB_16_VFAULT" 16498199 "DTC_MBB_17_VFAULT" 16498200 "DTC_MBB_18_VFAULT" 16498201 "DTC_MBB_19_VFAULT" 16498208 "DTC_MBB_20_VFAULT" 16498209 "DTC_MBB_21_VFAULT" 16498210 "DTC_MBB_22_VFAULT" 16498211 "DTC_MBB_23_VFAULT" 16498212 "DTC_MBB_24_VFAULT" 16497921 "DTC_MBB_01_TFAULT" 16497922 "DTC_MBB_02_TFAULT" 16497923 "DTC_MBB_03_TFAULT" 16497924 "DTC_MBB_04_TFAULT" 16497925 "DTC_MBB_05_TFAULT" 16497926 "DTC_MBB_06_TFAULT" 16497927 "DTC_MBB_07_TFAULT" 16497928 "DTC_MBB_08_TFAULT" 16497929 "DTC_MBB_09_TFAULT" 16497936 "DTC_MBB_10_TFAULT" 16497937 "DTC_MBB_11_TFAULT" 16497938 "DTC_MBB_12_TFAULT" 16497939 "DTC_MBB_13_TFAULT" 16497940 "DTC_MBB_14_TFAULT" 16497941 "DTC_MBB_15_TFAULT" 16497942 "DTC_MBB_16_TFAULT" 16497943 "DTC_MBB_17_TFAULT" 16497944 "DTC_MBB_18_TFAULT" 16497945 "DTC_MBB_19_TFAULT" 16497952 "DTC_MBB_20_TFAULT" 16497953 "DTC_MBB_21_TFAULT" 16497954 "DTC_MBB_22_TFAULT" 16497955 "DTC_MBB_23_TFAULT" 16497956 "DTC_MBB_24_TFAULT" 15785984 "DTC_PRECHARGE_ENERGY" 15785985 "DTC_PRT_FAILED" 15785986 "DTC_PRT_OVERTEMP" 15785987 "DTC_PRT_PROHIBIT" 16556032 "DTC_COOLANT_TEMP_OOR_HI" 16556033 "DTC_COOLANT_TEMP_OOR_LO" 16252928 "DTC_KEY_OFF_TIME_ERROR" 16506880 "DTC_VBAT_MISMATCH" 16506881 "DTC_VBAT_VMAX" 16506882 "DTC_VBAT_VMIN" 16506883 "DTC_PACK_FUSE" 15798544 "DTC_LLS1_OOR_HI" 15798545 "DTC_LLS1_OOR_LO" 15798546 "DTC_LLS1_FAULT" 15798816 "DTC_LLS2_OOR_HI" 15798817 "DTC_LLS2_OOR_LO" 15798818 "DTC_LLS2_FAULT" 14479360 "DTC_CFL_HEARTBEAT" 14479361 "DTC_CFL_FAULT" 14479362 "DTC_CFL_FAULT_LATCH" 13635584 "DTC_CONT_A_FAILED_HI" 13635585 "DTC_CONT_A_FAILED_LO" 13635586 "DTC_CONT_B_FAILED_HI" 13635587 "DTC_CONT_B_FAILED_LO" 13635588 "DTC_CONT_C_FAILED_HI" 13635589 "DTC_CONT_C_FAILED_LO" 13635590 "DTC_CONT_D_FAILED_HI" 13635591 "DTC_CONT_D_FAILED_LO" 13635592 "DTC_CONT_E_FAILED_HI" 13635593 "DTC_CONT_E_FAILED_LO" 13635594 "DTC_CONT_F_FAILED_HI" 13635595 "DTC_CONT_F_FAILED_LO" 13635596 "DTC_CONT_G_FAILED_HI" 13635597 "DTC_CONT_G_FAILED_LO" 13635598 "DTC_LSD_A_FAILED_HI" 13635599 "DTC_LSD_A_FAILED_LO" 13635600 "DTC_LSD_B_FAILED_HI" 13635601 "DTC_LSD_B_FAILED_LO" 13635602 "DTC_LSD_C_FAILED_HI" 13635603 "DTC_LSD_C_FAILED_LO" 13635606 "DTC_CONT_PWR_FAILED_HI" 13635607 "DTC_CONT_PWR_FAILED_LO" 13635608 "DTC_LSD_PUMP_FAILED_HI" 13635609 "DTC_LSD_PUMP_FAILED_LO" 13635610 "DTC_CHG_A_ENABLE_FAILED_HI" 13635611 "DTC_CHG_A_ENABLE_FAILED_LO" 13635612 "DTC_CHG_B_ENABLE_FAILED_HI" 13635613 "DTC_CHG_B_ENABLE_FAILED_LO" 13635614 "DTC_SW14V_PWR_FAILED_HI" 13635615 "DTC_SW14V_PWR_FAILED_LO" 13635620 "DTC_HSD_A_FAILED_HI" 13635621 "DTC_HSD_A_FAILED_LO" 13635622 "DTC_HSD_B_FAILED_HI" 13635623 "DTC_HSD_B_FAILED_LO" 13692968 "DTC_CONT_HPWR_FAILED_HI" 13692969 "DTC_CONT_HPWR_FAILED_LO" 13692970 "DTC_CONT_HPWR_OOR_HI" 13692971 "DTC_CONT_HPWR_OOR_LO" 13635616 "DTC_5V_PWR_OOR_HI" 13635617 "DTC_5V_PWR_OOR_LO" 14606336 "DTC_NVM_WRITE_TO" 14606337 "DTC_NVM_READ_TO" 14614528 "DTC_SPI_DIG_POT_FAULT" ;
VAL_ 1120 bcm_dtc_077 0 " - " 11276288 "DTC_VEPO" 11276289 "DTC_HSC_MISSING" 11460608 "DTC_NVM_SOC" 11460609 "DTC_NVM_KOT" 11460610 "DTC_NVM_DTC" 11460611 "DTC_NVM_SOC_CORRECTION" 11460612 "DTC_NVM_APP_SCRATCHPAD" 11517962 "DTC_LOOPTIME_TASK_A" 11517963 "DTC_LOOPTIME_TASK_B" 11517964 "DTC_LOOPTIME_TASK_C" 11517965 "DTC_LOOPTIME_TASK_D" 11517966 "DTC_LOOPTIME_TASK_E" 11517967 "DTC_LOOPTIME_TASK_F" 11323904 "DTC_INTERLOCK_A_FAILED_LOW" 11323905 "DTC_INTERLOCK_A_FAILED_HIGH" 11324160 "DTC_INTERLOCK_B_FAILED_LOW" 11324161 "DTC_INTERLOCK_B_FAILED_HIGH" 15728640 "DTC_EPO" 16498688 "DTC_BRUSA_MISSING" 16498689 "DTC_BRUSA_IDC" 16498690 "DTC_BRUSA_REQ_VS_CMD" 16433152 "DTC_AKERWADE_MISSING" 16433153 "DTC_AKERWADE_IDC" 16433154 "DTC_AKERWADE_REQ_VS_CMD" 16564224 "DTC_CHGLEAR_MISSING" 16564225 "DTC_CHGLEAR_IDC" 16564226 "DTC_CHGLEAR_REQ_VS_CMD" 16522240 "DTC_CSM_MISSING" 16522752 "DTC_CSM_VBAT" 16522753 "DTC_CSM_VPOS" 16522754 "DTC_CSM_VNEG" 16522755 "DTC_CSM_CPOS" 16522756 "DTC_CSM_CNEG" 16522757 "DTC_CSM_APOS" 16522758 "DTC_CSM_ANEG" 16522759 "DTC_CSM_FUSE_HI" 16522760 "DTC_CSM_FUSE_LO" 16521728 "DTC_CSM_ASIC" 16521729 "DTC_CSM_AILO" 16521730 "DTC_CSM_AIHI" 16520957 "DTC_LEAKAGE_DETECT_FAULT" 16522444 "DTC_REALTIMECLOCK_FAULT" 16520945 "DTC_CSM_LEAK_FAIL_CALC" 16520946 "DTC_CSM_LEAK_FAIL_HW" 16520947 "DTC_CSM_LEAK_EXT_SHORT" 16520948 "DTC_CSM_LEAK_MID_PACK_SHORT" 16520949 "DTC_CSM_LEAK_ERROR" 16520950 "DTC_CSM_LEAK_UNKNOWN" 16523008 "DTC_CSM_VER_MISMATCH" 16523009 "DTC_CSM_DTC_SET" 16523010 "DTC_CSM_CAL_FAULT" 16560128 "DTC_IBAT_MISMATCH" 16576512 "DTC_DIS_MAX_I2T" 16576513 "DTC_CHG_MAX_I2T" 16576768 "DTC_DIS_WARNING_I2T" 16576769 "DTC_CHG_WARNING_I2T" 11296784 "DTC_SAEJ1772_PROX_DECT_OOR_HI" 11296785 "DTC_SAEJ1772_PROX_DECT_OOR_LO" 11296800 "DTC_SAEJ1772_PILOT_PWM_OOR_HI" 11296801 "DTC_SAEJ1772_PILOT_PWM_OOR_LO" 11296802 "DTC_SAEJ1772_PILOT_PWM_DIG_COMM" 11296803 "DTC_SAEJ1772_PILOT_PWM_IR_ERR" 16175360 "DTC_FGD1_NO_SENSOR" 16175361 "DTC_FGD1_OOR_HI" 16175362 "DTC_FGD1_OOR_LO" 16175363 "DTC_FGD1_FAULT" 16175616 "DTC_FGD2_NO_SENSOR" 16175617 "DTC_FGD2_OOR_HI" 16175618 "DTC_FGD2_OOR_LO" 16175619 "DTC_FGD2_FAULT" 16171008 "DTC_CONT_OPEN" 16171009 "DTC_CONT_CLOSE" 16171010 "DTC_CONT_OPEN_CURRENT" 16171264 "DTC_CONT_CLOSE_ON_RESET" 16171265 "DTC_CONT_CLOSE_SIG_FAILED" 16171520 "DTC_PRECHARGE_TIMEOUT" 16171777 "DTC_CONT_MPOS_WELD_AT_SU" 16171778 "DTC_CONT_MNEG_WELD_AT_SU" 16171780 "DTC_CONT_CPOS_WELD_AT_SU" 16171781 "DTC_CONT_CNEG_WELD_AT_SU" 16171782 "DTC_CONT_ANEG_WELD_AT_SU" 16171783 "DTC_CONT_APOS_WELD_AT_SU" 16172033 "DTC_CONT_MPOS_WELD_AT_SD" 16172034 "DTC_CONT_MNEG_WELD_AT_SD" 16172036 "DTC_CONT_CPOS_WELD_AT_SD" 16172037 "DTC_CONT_CNEG_WELD_AT_SD" 16172038 "DTC_CONT_ANEG_WELD_AT_SD" 16172039 "DTC_CONT_APOS_WELD_AT_SD" 16172289 "DTC_CONT_MPOS_OPEN" 16172290 "DTC_CONT_MNEG_OPEN" 16172291 "DTC_CONT_MPRE_OPEN" 16172292 "DTC_CONT_CPOS_OPEN" 16172293 "DTC_CONT_CNEG_OPEN" 16172294 "DTC_CONT_APOS_OPEN" 16172295 "DTC_CONT_ANEG_OPEN" 16172545 "DTC_CONT_MPOS_VDIF" 16172546 "DTC_CONT_MNEG_VDIF" 16172548 "DTC_CONT_CPOS_VDIF" 16172549 "DTC_CONT_CNEG_VDIF" 16172550 "DTC_CONT_APOS_VDIF" 16172551 "DTC_CONT_ANEG_VDIF" 16174848 "DTC_HVIL" 16174849 "DTC_LVBAT_LO" 16174850 "DTC_LVBAT_HI" 16174851 "DTC_LVBAT_ERR" 16523520 "DTC_LEMLO_OOR_HI" 16523521 "DTC_LEMLO_OOR_LO" 16523522 "DTC_LEMLO_FAULT" 16523776 "DTC_LEMHI_OOR_HI" 16523777 "DTC_LEMHI_OOR_LO" 16523778 "DTC_LEMHI_FAULT" 16496320 "DTC_MBB_TOO_FEW" 16496321 "DTC_MBB_TOO_MANY" 16496352 "DTC_CELL_VMAX_ERR" 16496353 "DTC_CELL_VMIN_ERR" 16496354 "DTC_CELL_VMAX" 16496362 "DTC_CELL_VMAX_SEVERE" 16496355 "DTC_CELL_VMIN" 16496363 "DTC_CELL_VMIN_SEVERE" 16496356 "DTC_MOD_VOLTAGE_COMPARE" 16496336 "DTC_CELL_T_ERR" 16496337 "DTC_CELL_TMAX1" 16496338 "DTC_CELL_TMAX2" 16496339 "DTC_CELL_TMIN" 16497665 "DTC_MBB_01_MISSING" 16497666 "DTC_MBB_02_MISSING" 16497667 "DTC_MBB_03_MISSING" 16497668 "DTC_MBB_04_MISSING" 16497669 "DTC_MBB_05_MISSING" 16497670 "DTC_MBB_06_MISSING" 16497671 "DTC_MBB_07_MISSING" 16497672 "DTC_MBB_08_MISSING" 16497673 "DTC_MBB_09_MISSING" 16497680 "DTC_MBB_10_MISSING" 16497681 "DTC_MBB_11_MISSING" 16497682 "DTC_MBB_12_MISSING" 16497683 "DTC_MBB_13_MISSING" 16497684 "DTC_MBB_14_MISSING" 16497685 "DTC_MBB_15_MISSING" 16497686 "DTC_MBB_16_MISSING" 16497687 "DTC_MBB_17_MISSING" 16497688 "DTC_MBB_18_MISSING" 16497689 "DTC_MBB_19_MISSING" 16497696 "DTC_MBB_20_MISSING" 16497697 "DTC_MBB_21_MISSING" 16497698 "DTC_MBB_22_MISSING" 16497699 "DTC_MBB_23_MISSING" 16497700 "DTC_MBB_24_MISSING" 16498177 "DTC_MBB_01_VFAULT" 16498178 "DTC_MBB_02_VFAULT" 16498179 "DTC_MBB_03_VFAULT" 16498180 "DTC_MBB_04_VFAULT" 16498181 "DTC_MBB_05_VFAULT" 16498182 "DTC_MBB_06_VFAULT" 16498183 "DTC_MBB_07_VFAULT" 16498184 "DTC_MBB_08_VFAULT" 16498185 "DTC_MBB_09_VFAULT" 16498192 "DTC_MBB_10_VFAULT" 16498193 "DTC_MBB_11_VFAULT" 16498194 "DTC_MBB_12_VFAULT" 16498195 "DTC_MBB_13_VFAULT" 16498196 "DTC_MBB_14_VFAULT" 16498197 "DTC_MBB_15_VFAULT" 16498198 "DTC_MBB_16_VFAULT" 16498199 "DTC_MBB_17_VFAULT" 16498200 "DTC_MBB_18_VFAULT" 16498201 "DTC_MBB_19_VFAULT" 16498208 "DTC_MBB_20_VFAULT" 16498209 "DTC_MBB_21_VFAULT" 16498210 "DTC_MBB_22_VFAULT" 16498211 "DTC_MBB_23_VFAULT" 16498212 "DTC_MBB_24_VFAULT" 16497921 "DTC_MBB_01_TFAULT" 16497922 "DTC_MBB_02_TFAULT" 16497923 "DTC_MBB_03_TFAULT" 16497924 "DTC_MBB_04_TFAULT" 16497925 "DTC_MBB_05_TFAULT" 16497926 "DTC_MBB_06_TFAULT" 16497927 "DTC_MBB_07_TFAULT" 16497928 "DTC_MBB_08_TFAULT" 16497929 "DTC_MBB_09_TFAULT" 16497936 "DTC_MBB_10_TFAULT" 16497937 "DTC_MBB_11_TFAULT" 16497938 "DTC_MBB_12_TFAULT" 16497939 "DTC_MBB_13_TFAULT" 16497940 "DTC_MBB_14_TFAULT" 16497941 "DTC_MBB_15_TFAULT" 16497942 "DTC_MBB_16_TFAULT" 16497943 "DTC_MBB_17_TFAULT" 16497944 "DTC_MBB_18_TFAULT" 16497945 "DTC_MBB_19_TFAULT" 16497952 "DTC_MBB_20_TFAULT" 16497953 "DTC_MBB_21_TFAULT" 16497954 "DTC_MBB_22_TFAULT" 16497955 "DTC_MBB_23_TFAULT" 16497956 "DTC_MBB_24_TFAULT" 15785984 "DTC_PRECHARGE_ENERGY" 15785985 "DTC_PRT_FAILED" 15785986 "DTC_PRT_OVERTEMP" 15785987 "DTC_PRT_PROHIBIT" 16556032 "DTC_COOLANT_TEMP_OOR_HI" 16556033 "DTC_COOLANT_TEMP_OOR_LO" 16252928 "DTC_KEY_OFF_TIME_ERROR" 16506880 "DTC_VBAT_MISMATCH" 16506881 "DTC_VBAT_VMAX" 16506882 "DTC_VBAT_VMIN" 16506883 "DTC_PACK_FUSE" 15798544 "DTC_LLS1_OOR_HI" 15798545 "DTC_LLS1_OOR_LO" 15798546 "DTC_LLS1_FAULT" 15798816 "DTC_LLS2_OOR_HI" 15798817 "DTC_LLS2_OOR_LO" 15798818 "DTC_LLS2_FAULT" 14479360 "DTC_CFL_HEARTBEAT" 14479361 "DTC_CFL_FAULT" 14479362 "DTC_CFL_FAULT_LATCH" 13635584 "DTC_CONT_A_FAILED_HI" 13635585 "DTC_CONT_A_FAILED_LO" 13635586 "DTC_CONT_B_FAILED_HI" 13635587 "DTC_CONT_B_FAILED_LO" 13635588 "DTC_CONT_C_FAILED_HI" 13635589 "DTC_CONT_C_FAILED_LO" 13635590 "DTC_CONT_D_FAILED_HI" 13635591 "DTC_CONT_D_FAILED_LO" 13635592 "DTC_CONT_E_FAILED_HI" 13635593 "DTC_CONT_E_FAILED_LO" 13635594 "DTC_CONT_F_FAILED_HI" 13635595 "DTC_CONT_F_FAILED_LO" 13635596 "DTC_CONT_G_FAILED_HI" 13635597 "DTC_CONT_G_FAILED_LO" 13635598 "DTC_LSD_A_FAILED_HI" 13635599 "DTC_LSD_A_FAILED_LO" 13635600 "DTC_LSD_B_FAILED_HI" 13635601 "DTC_LSD_B_FAILED_LO" 13635602 "DTC_LSD_C_FAILED_HI" 13635603 "DTC_LSD_C_FAILED_LO" 13635606 "DTC_CONT_PWR_FAILED_HI" 13635607 "DTC_CONT_PWR_FAILED_LO" 13635608 "DTC_LSD_PUMP_FAILED_HI" 13635609 "DTC_LSD_PUMP_FAILED_LO" 13635610 "DTC_CHG_A_ENABLE_FAILED_HI" 13635611 "DTC_CHG_A_ENABLE_FAILED_LO" 13635612 "DTC_CHG_B_ENABLE_FAILED_HI" 13635613 "DTC_CHG_B_ENABLE_FAILED_LO" 13635614 "DTC_SW14V_PWR_FAILED_HI" 13635615 "DTC_SW14V_PWR_FAILED_LO" 13635620 "DTC_HSD_A_FAILED_HI" 13635621 "DTC_HSD_A_FAILED_LO" 13635622 "DTC_HSD_B_FAILED_HI" 13635623 "DTC_HSD_B_FAILED_LO" 13692968 "DTC_CONT_HPWR_FAILED_HI" 13692969 "DTC_CONT_HPWR_FAILED_LO" 13692970 "DTC_CONT_HPWR_OOR_HI" 13692971 "DTC_CONT_HPWR_OOR_LO" 13635616 "DTC_5V_PWR_OOR_HI" 13635617 "DTC_5V_PWR_OOR_LO" 14606336 "DTC_NVM_WRITE_TO" 14606337 "DTC_NVM_READ_TO" 14614528 "DTC_SPI_DIG_POT_FAULT" ;
VAL_ 1120 bcm_dtc_078 0 " - " 11276288 "DTC_VEPO" 11276289 "DTC_HSC_MISSING" 11460608 "DTC_NVM_SOC" 11460609 "DTC_NVM_KOT" 11460610 "DTC_NVM_DTC" 11460611 "DTC_NVM_SOC_CORRECTION" 11460612 "DTC_NVM_APP_SCRATCHPAD" 11517962 "DTC_LOOPTIME_TASK_A" 11517963 "DTC_LOOPTIME_TASK_B" 11517964 "DTC_LOOPTIME_TASK_C" 11517965 "DTC_LOOPTIME_TASK_D" 11517966 "DTC_LOOPTIME_TASK_E" 11517967 "DTC_LOOPTIME_TASK_F" 11323904 "DTC_INTERLOCK_A_FAILED_LOW" 11323905 "DTC_INTERLOCK_A_FAILED_HIGH" 11324160 "DTC_INTERLOCK_B_FAILED_LOW" 11324161 "DTC_INTERLOCK_B_FAILED_HIGH" 15728640 "DTC_EPO" 16498688 "DTC_BRUSA_MISSING" 16498689 "DTC_BRUSA_IDC" 16498690 "DTC_BRUSA_REQ_VS_CMD" 16433152 "DTC_AKERWADE_MISSING" 16433153 "DTC_AKERWADE_IDC" 16433154 "DTC_AKERWADE_REQ_VS_CMD" 16564224 "DTC_CHGLEAR_MISSING" 16564225 "DTC_CHGLEAR_IDC" 16564226 "DTC_CHGLEAR_REQ_VS_CMD" 16522240 "DTC_CSM_MISSING" 16522752 "DTC_CSM_VBAT" 16522753 "DTC_CSM_VPOS" 16522754 "DTC_CSM_VNEG" 16522755 "DTC_CSM_CPOS" 16522756 "DTC_CSM_CNEG" 16522757 "DTC_CSM_APOS" 16522758 "DTC_CSM_ANEG" 16522759 "DTC_CSM_FUSE_HI" 16522760 "DTC_CSM_FUSE_LO" 16521728 "DTC_CSM_ASIC" 16521729 "DTC_CSM_AILO" 16521730 "DTC_CSM_AIHI" 16520957 "DTC_LEAKAGE_DETECT_FAULT" 16522444 "DTC_REALTIMECLOCK_FAULT" 16520945 "DTC_CSM_LEAK_FAIL_CALC" 16520946 "DTC_CSM_LEAK_FAIL_HW" 16520947 "DTC_CSM_LEAK_EXT_SHORT" 16520948 "DTC_CSM_LEAK_MID_PACK_SHORT" 16520949 "DTC_CSM_LEAK_ERROR" 16520950 "DTC_CSM_LEAK_UNKNOWN" 16523008 "DTC_CSM_VER_MISMATCH" 16523009 "DTC_CSM_DTC_SET" 16523010 "DTC_CSM_CAL_FAULT" 16560128 "DTC_IBAT_MISMATCH" 16576512 "DTC_DIS_MAX_I2T" 16576513 "DTC_CHG_MAX_I2T" 16576768 "DTC_DIS_WARNING_I2T" 16576769 "DTC_CHG_WARNING_I2T" 11296784 "DTC_SAEJ1772_PROX_DECT_OOR_HI" 11296785 "DTC_SAEJ1772_PROX_DECT_OOR_LO" 11296800 "DTC_SAEJ1772_PILOT_PWM_OOR_HI" 11296801 "DTC_SAEJ1772_PILOT_PWM_OOR_LO" 11296802 "DTC_SAEJ1772_PILOT_PWM_DIG_COMM" 11296803 "DTC_SAEJ1772_PILOT_PWM_IR_ERR" 16175360 "DTC_FGD1_NO_SENSOR" 16175361 "DTC_FGD1_OOR_HI" 16175362 "DTC_FGD1_OOR_LO" 16175363 "DTC_FGD1_FAULT" 16175616 "DTC_FGD2_NO_SENSOR" 16175617 "DTC_FGD2_OOR_HI" 16175618 "DTC_FGD2_OOR_LO" 16175619 "DTC_FGD2_FAULT" 16171008 "DTC_CONT_OPEN" 16171009 "DTC_CONT_CLOSE" 16171010 "DTC_CONT_OPEN_CURRENT" 16171264 "DTC_CONT_CLOSE_ON_RESET" 16171265 "DTC_CONT_CLOSE_SIG_FAILED" 16171520 "DTC_PRECHARGE_TIMEOUT" 16171777 "DTC_CONT_MPOS_WELD_AT_SU" 16171778 "DTC_CONT_MNEG_WELD_AT_SU" 16171780 "DTC_CONT_CPOS_WELD_AT_SU" 16171781 "DTC_CONT_CNEG_WELD_AT_SU" 16171782 "DTC_CONT_ANEG_WELD_AT_SU" 16171783 "DTC_CONT_APOS_WELD_AT_SU" 16172033 "DTC_CONT_MPOS_WELD_AT_SD" 16172034 "DTC_CONT_MNEG_WELD_AT_SD" 16172036 "DTC_CONT_CPOS_WELD_AT_SD" 16172037 "DTC_CONT_CNEG_WELD_AT_SD" 16172038 "DTC_CONT_ANEG_WELD_AT_SD" 16172039 "DTC_CONT_APOS_WELD_AT_SD" 16172289 "DTC_CONT_MPOS_OPEN" 16172290 "DTC_CONT_MNEG_OPEN" 16172291 "DTC_CONT_MPRE_OPEN" 16172292 "DTC_CONT_CPOS_OPEN" 16172293 "DTC_CONT_CNEG_OPEN" 16172294 "DTC_CONT_APOS_OPEN" 16172295 "DTC_CONT_ANEG_OPEN" 16172545 "DTC_CONT_MPOS_VDIF" 16172546 "DTC_CONT_MNEG_VDIF" 16172548 "DTC_CONT_CPOS_VDIF" 16172549 "DTC_CONT_CNEG_VDIF" 16172550 "DTC_CONT_APOS_VDIF" 16172551 "DTC_CONT_ANEG_VDIF" 16174848 "DTC_HVIL" 16174849 "DTC_LVBAT_LO" 16174850 "DTC_LVBAT_HI" 16174851 "DTC_LVBAT_ERR" 16523520 "DTC_LEMLO_OOR_HI" 16523521 "DTC_LEMLO_OOR_LO" 16523522 "DTC_LEMLO_FAULT" 16523776 "DTC_LEMHI_OOR_HI" 16523777 "DTC_LEMHI_OOR_LO" 16523778 "DTC_LEMHI_FAULT" 16496320 "DTC_MBB_TOO_FEW" 16496321 "DTC_MBB_TOO_MANY" 16496352 "DTC_CELL_VMAX_ERR" 16496353 "DTC_CELL_VMIN_ERR" 16496354 "DTC_CELL_VMAX" 16496362 "DTC_CELL_VMAX_SEVERE" 16496355 "DTC_CELL_VMIN" 16496363 "DTC_CELL_VMIN_SEVERE" 16496356 "DTC_MOD_VOLTAGE_COMPARE" 16496336 "DTC_CELL_T_ERR" 16496337 "DTC_CELL_TMAX1" 16496338 "DTC_CELL_TMAX2" 16496339 "DTC_CELL_TMIN" 16497665 "DTC_MBB_01_MISSING" 16497666 "DTC_MBB_02_MISSING" 16497667 "DTC_MBB_03_MISSING" 16497668 "DTC_MBB_04_MISSING" 16497669 "DTC_MBB_05_MISSING" 16497670 "DTC_MBB_06_MISSING" 16497671 "DTC_MBB_07_MISSING" 16497672 "DTC_MBB_08_MISSING" 16497673 "DTC_MBB_09_MISSING" 16497680 "DTC_MBB_10_MISSING" 16497681 "DTC_MBB_11_MISSING" 16497682 "DTC_MBB_12_MISSING" 16497683 "DTC_MBB_13_MISSING" 16497684 "DTC_MBB_14_MISSING" 16497685 "DTC_MBB_15_MISSING" 16497686 "DTC_MBB_16_MISSING" 16497687 "DTC_MBB_17_MISSING" 16497688 "DTC_MBB_18_MISSING" 16497689 "DTC_MBB_19_MISSING" 16497696 "DTC_MBB_20_MISSING" 16497697 "DTC_MBB_21_MISSING" 16497698 "DTC_MBB_22_MISSING" 16497699 "DTC_MBB_23_MISSING" 16497700 "DTC_MBB_24_MISSING" 16498177 "DTC_MBB_01_VFAULT" 16498178 "DTC_MBB_02_VFAULT" 16498179 "DTC_MBB_03_VFAULT" 16498180 "DTC_MBB_04_VFAULT" 16498181 "DTC_MBB_05_VFAULT" 16498182 "DTC_MBB_06_VFAULT" 16498183 "DTC_MBB_07_VFAULT" 16498184 "DTC_MBB_08_VFAULT" 16498185 "DTC_MBB_09_VFAULT" 16498192 "DTC_MBB_10_VFAULT" 16498193 "DTC_MBB_11_VFAULT" 16498194 "DTC_MBB_12_VFAULT" 16498195 "DTC_MBB_13_VFAULT" 16498196 "DTC_MBB_14_VFAULT" 16498197 "DTC_MBB_15_VFAULT" 16498198 "DTC_MBB_16_VFAULT" 16498199 "DTC_MBB_17_VFAULT" 16498200 "DTC_MBB_18_VFAULT" 16498201 "DTC_MBB_19_VFAULT" 16498208 "DTC_MBB_20_VFAULT" 16498209 "DTC_MBB_21_VFAULT" 16498210 "DTC_MBB_22_VFAULT" 16498211 "DTC_MBB_23_VFAULT" 16498212 "DTC_MBB_24_VFAULT" 16497921 "DTC_MBB_01_TFAULT" 16497922 "DTC_MBB_02_TFAULT" 16497923 "DTC_MBB_03_TFAULT" 16497924 "DTC_MBB_04_TFAULT" 16497925 "DTC_MBB_05_TFAULT" 16497926 "DTC_MBB_06_TFAULT" 16497927 "DTC_MBB_07_TFAULT" 16497928 "DTC_MBB_08_TFAULT" 16497929 "DTC_MBB_09_TFAULT" 16497936 "DTC_MBB_10_TFAULT" 16497937 "DTC_MBB_11_TFAULT" 16497938 "DTC_MBB_12_TFAULT" 16497939 "DTC_MBB_13_TFAULT" 16497940 "DTC_MBB_14_TFAULT" 16497941 "DTC_MBB_15_TFAULT" 16497942 "DTC_MBB_16_TFAULT" 16497943 "DTC_MBB_17_TFAULT" 16497944 "DTC_MBB_18_TFAULT" 16497945 "DTC_MBB_19_TFAULT" 16497952 "DTC_MBB_20_TFAULT" 16497953 "DTC_MBB_21_TFAULT" 16497954 "DTC_MBB_22_TFAULT" 16497955 "DTC_MBB_23_TFAULT" 16497956 "DTC_MBB_24_TFAULT" 15785984 "DTC_PRECHARGE_ENERGY" 15785985 "DTC_PRT_FAILED" 15785986 "DTC_PRT_OVERTEMP" 15785987 "DTC_PRT_PROHIBIT" 16556032 "DTC_COOLANT_TEMP_OOR_HI" 16556033 "DTC_COOLANT_TEMP_OOR_LO" 16252928 "DTC_KEY_OFF_TIME_ERROR" 16506880 "DTC_VBAT_MISMATCH" 16506881 "DTC_VBAT_VMAX" 16506882 "DTC_VBAT_VMIN" 16506883 "DTC_PACK_FUSE" 15798544 "DTC_LLS1_OOR_HI" 15798545 "DTC_LLS1_OOR_LO" 15798546 "DTC_LLS1_FAULT" 15798816 "DTC_LLS2_OOR_HI" 15798817 "DTC_LLS2_OOR_LO" 15798818 "DTC_LLS2_FAULT" 14479360 "DTC_CFL_HEARTBEAT" 14479361 "DTC_CFL_FAULT" 14479362 "DTC_CFL_FAULT_LATCH" 13635584 "DTC_CONT_A_FAILED_HI" 13635585 "DTC_CONT_A_FAILED_LO" 13635586 "DTC_CONT_B_FAILED_HI" 13635587 "DTC_CONT_B_FAILED_LO" 13635588 "DTC_CONT_C_FAILED_HI" 13635589 "DTC_CONT_C_FAILED_LO" 13635590 "DTC_CONT_D_FAILED_HI" 13635591 "DTC_CONT_D_FAILED_LO" 13635592 "DTC_CONT_E_FAILED_HI" 13635593 "DTC_CONT_E_FAILED_LO" 13635594 "DTC_CONT_F_FAILED_HI" 13635595 "DTC_CONT_F_FAILED_LO" 13635596 "DTC_CONT_G_FAILED_HI" 13635597 "DTC_CONT_G_FAILED_LO" 13635598 "DTC_LSD_A_FAILED_HI" 13635599 "DTC_LSD_A_FAILED_LO" 13635600 "DTC_LSD_B_FAILED_HI" 13635601 "DTC_LSD_B_FAILED_LO" 13635602 "DTC_LSD_C_FAILED_HI" 13635603 "DTC_LSD_C_FAILED_LO" 13635606 "DTC_CONT_PWR_FAILED_HI" 13635607 "DTC_CONT_PWR_FAILED_LO" 13635608 "DTC_LSD_PUMP_FAILED_HI" 13635609 "DTC_LSD_PUMP_FAILED_LO" 13635610 "DTC_CHG_A_ENABLE_FAILED_HI" 13635611 "DTC_CHG_A_ENABLE_FAILED_LO" 13635612 "DTC_CHG_B_ENABLE_FAILED_HI" 13635613 "DTC_CHG_B_ENABLE_FAILED_LO" 13635614 "DTC_SW14V_PWR_FAILED_HI" 13635615 "DTC_SW14V_PWR_FAILED_LO" 13635620 "DTC_HSD_A_FAILED_HI" 13635621 "DTC_HSD_A_FAILED_LO" 13635622 "DTC_HSD_B_FAILED_HI" 13635623 "DTC_HSD_B_FAILED_LO" 13692968 "DTC_CONT_HPWR_FAILED_HI" 13692969 "DTC_CONT_HPWR_FAILED_LO" 13692970 "DTC_CONT_HPWR_OOR_HI" 13692971 "DTC_CONT_HPWR_OOR_LO" 13635616 "DTC_5V_PWR_OOR_HI" 13635617 "DTC_5V_PWR_OOR_LO" 14606336 "DTC_NVM_WRITE_TO" 14606337 "DTC_NVM_READ_TO" 14614528 "DTC_SPI_DIG_POT_FAULT" ;
VAL_ 1120 bcm_dtc_079 0 " - " 11276288 "DTC_VEPO" 11276289 "DTC_HSC_MISSING" 11460608 "DTC_NVM_SOC" 11460609 "DTC_NVM_KOT" 11460610 "DTC_NVM_DTC" 11460611 "DTC_NVM_SOC_CORRECTION" 11460612 "DTC_NVM_APP_SCRATCHPAD" 11517962 "DTC_LOOPTIME_TASK_A" 11517963 "DTC_LOOPTIME_TASK_B" 11517964 "DTC_LOOPTIME_TASK_C" 11517965 "DTC_LOOPTIME_TASK_D" 11517966 "DTC_LOOPTIME_TASK_E" 11517967 "DTC_LOOPTIME_TASK_F" 11323904 "DTC_INTERLOCK_A_FAILED_LOW" 11323905 "DTC_INTERLOCK_A_FAILED_HIGH" 11324160 "DTC_INTERLOCK_B_FAILED_LOW" 11324161 "DTC_INTERLOCK_B_FAILED_HIGH" 15728640 "DTC_EPO" 16498688 "DTC_BRUSA_MISSING" 16498689 "DTC_BRUSA_IDC" 16498690 "DTC_BRUSA_REQ_VS_CMD" 16433152 "DTC_AKERWADE_MISSING" 16433153 "DTC_AKERWADE_IDC" 16433154 "DTC_AKERWADE_REQ_VS_CMD" 16564224 "DTC_CHGLEAR_MISSING" 16564225 "DTC_CHGLEAR_IDC" 16564226 "DTC_CHGLEAR_REQ_VS_CMD" 16522240 "DTC_CSM_MISSING" 16522752 "DTC_CSM_VBAT" 16522753 "DTC_CSM_VPOS" 16522754 "DTC_CSM_VNEG" 16522755 "DTC_CSM_CPOS" 16522756 "DTC_CSM_CNEG" 16522757 "DTC_CSM_APOS" 16522758 "DTC_CSM_ANEG" 16522759 "DTC_CSM_FUSE_HI" 16522760 "DTC_CSM_FUSE_LO" 16521728 "DTC_CSM_ASIC" 16521729 "DTC_CSM_AILO" 16521730 "DTC_CSM_AIHI" 16520957 "DTC_LEAKAGE_DETECT_FAULT" 16522444 "DTC_REALTIMECLOCK_FAULT" 16520945 "DTC_CSM_LEAK_FAIL_CALC" 16520946 "DTC_CSM_LEAK_FAIL_HW" 16520947 "DTC_CSM_LEAK_EXT_SHORT" 16520948 "DTC_CSM_LEAK_MID_PACK_SHORT" 16520949 "DTC_CSM_LEAK_ERROR" 16520950 "DTC_CSM_LEAK_UNKNOWN" 16523008 "DTC_CSM_VER_MISMATCH" 16523009 "DTC_CSM_DTC_SET" 16523010 "DTC_CSM_CAL_FAULT" 16560128 "DTC_IBAT_MISMATCH" 16576512 "DTC_DIS_MAX_I2T" 16576513 "DTC_CHG_MAX_I2T" 16576768 "DTC_DIS_WARNING_I2T" 16576769 "DTC_CHG_WARNING_I2T" 11296784 "DTC_SAEJ1772_PROX_DECT_OOR_HI" 11296785 "DTC_SAEJ1772_PROX_DECT_OOR_LO" 11296800 "DTC_SAEJ1772_PILOT_PWM_OOR_HI" 11296801 "DTC_SAEJ1772_PILOT_PWM_OOR_LO" 11296802 "DTC_SAEJ1772_PILOT_PWM_DIG_COMM" 11296803 "DTC_SAEJ1772_PILOT_PWM_IR_ERR" 16175360 "DTC_FGD1_NO_SENSOR" 16175361 "DTC_FGD1_OOR_HI" 16175362 "DTC_FGD1_OOR_LO" 16175363 "DTC_FGD1_FAULT" 16175616 "DTC_FGD2_NO_SENSOR" 16175617 "DTC_FGD2_OOR_HI" 16175618 "DTC_FGD2_OOR_LO" 16175619 "DTC_FGD2_FAULT" 16171008 "DTC_CONT_OPEN" 16171009 "DTC_CONT_CLOSE" 16171010 "DTC_CONT_OPEN_CURRENT" 16171264 "DTC_CONT_CLOSE_ON_RESET" 16171265 "DTC_CONT_CLOSE_SIG_FAILED" 16171520 "DTC_PRECHARGE_TIMEOUT" 16171777 "DTC_CONT_MPOS_WELD_AT_SU" 16171778 "DTC_CONT_MNEG_WELD_AT_SU" 16171780 "DTC_CONT_CPOS_WELD_AT_SU" 16171781 "DTC_CONT_CNEG_WELD_AT_SU" 16171782 "DTC_CONT_ANEG_WELD_AT_SU" 16171783 "DTC_CONT_APOS_WELD_AT_SU" 16172033 "DTC_CONT_MPOS_WELD_AT_SD" 16172034 "DTC_CONT_MNEG_WELD_AT_SD" 16172036 "DTC_CONT_CPOS_WELD_AT_SD" 16172037 "DTC_CONT_CNEG_WELD_AT_SD" 16172038 "DTC_CONT_ANEG_WELD_AT_SD" 16172039 "DTC_CONT_APOS_WELD_AT_SD" 16172289 "DTC_CONT_MPOS_OPEN" 16172290 "DTC_CONT_MNEG_OPEN" 16172291 "DTC_CONT_MPRE_OPEN" 16172292 "DTC_CONT_CPOS_OPEN" 16172293 "DTC_CONT_CNEG_OPEN" 16172294 "DTC_CONT_APOS_OPEN" 16172295 "DTC_CONT_ANEG_OPEN" 16172545 "DTC_CONT_MPOS_VDIF" 16172546 "DTC_CONT_MNEG_VDIF" 16172548 "DTC_CONT_CPOS_VDIF" 16172549 "DTC_CONT_CNEG_VDIF" 16172550 "DTC_CONT_APOS_VDIF" 16172551 "DTC_CONT_ANEG_VDIF" 16174848 "DTC_HVIL" 16174849 "DTC_LVBAT_LO" 16174850 "DTC_LVBAT_HI" 16174851 "DTC_LVBAT_ERR" 16523520 "DTC_LEMLO_OOR_HI" 16523521 "DTC_LEMLO_OOR_LO" 16523522 "DTC_LEMLO_FAULT" 16523776 "DTC_LEMHI_OOR_HI" 16523777 "DTC_LEMHI_OOR_LO" 16523778 "DTC_LEMHI_FAULT" 16496320 "DTC_MBB_TOO_FEW" 16496321 "DTC_MBB_TOO_MANY" 16496352 "DTC_CELL_VMAX_ERR" 16496353 "DTC_CELL_VMIN_ERR" 16496354 "DTC_CELL_VMAX" 16496362 "DTC_CELL_VMAX_SEVERE" 16496355 "DTC_CELL_VMIN" 16496363 "DTC_CELL_VMIN_SEVERE" 16496356 "DTC_MOD_VOLTAGE_COMPARE" 16496336 "DTC_CELL_T_ERR" 16496337 "DTC_CELL_TMAX1" 16496338 "DTC_CELL_TMAX2" 16496339 "DTC_CELL_TMIN" 16497665 "DTC_MBB_01_MISSING" 16497666 "DTC_MBB_02_MISSING" 16497667 "DTC_MBB_03_MISSING" 16497668 "DTC_MBB_04_MISSING" 16497669 "DTC_MBB_05_MISSING" 16497670 "DTC_MBB_06_MISSING" 16497671 "DTC_MBB_07_MISSING" 16497672 "DTC_MBB_08_MISSING" 16497673 "DTC_MBB_09_MISSING" 16497680 "DTC_MBB_10_MISSING" 16497681 "DTC_MBB_11_MISSING" 16497682 "DTC_MBB_12_MISSING" 16497683 "DTC_MBB_13_MISSING" 16497684 "DTC_MBB_14_MISSING" 16497685 "DTC_MBB_15_MISSING" 16497686 "DTC_MBB_16_MISSING" 16497687 "DTC_MBB_17_MISSING" 16497688 "DTC_MBB_18_MISSING" 16497689 "DTC_MBB_19_MISSING" 16497696 "DTC_MBB_20_MISSING" 16497697 "DTC_MBB_21_MISSING" 16497698 "DTC_MBB_22_MISSING" 16497699 "DTC_MBB_23_MISSING" 16497700 "DTC_MBB_24_MISSING" 16498177 "DTC_MBB_01_VFAULT" 16498178 "DTC_MBB_02_VFAULT" 16498179 "DTC_MBB_03_VFAULT" 16498180 "DTC_MBB_04_VFAULT" 16498181 "DTC_MBB_05_VFAULT" 16498182 "DTC_MBB_06_VFAULT" 16498183 "DTC_MBB_07_VFAULT" 16498184 "DTC_MBB_08_VFAULT" 16498185 "DTC_MBB_09_VFAULT" 16498192 "DTC_MBB_10_VFAULT" 16498193 "DTC_MBB_11_VFAULT" 16498194 "DTC_MBB_12_VFAULT" 16498195 "DTC_MBB_13_VFAULT" 16498196 "DTC_MBB_14_VFAULT" 16498197 "DTC_MBB_15_VFAULT" 16498198 "DTC_MBB_16_VFAULT" 16498199 "DTC_MBB_17_VFAULT" 16498200 "DTC_MBB_18_VFAULT" 16498201 "DTC_MBB_19_VFAULT" 16498208 "DTC_MBB_20_VFAULT" 16498209 "DTC_MBB_21_VFAULT" 16498210 "DTC_MBB_22_VFAULT" 16498211 "DTC_MBB_23_VFAULT" 16498212 "DTC_MBB_24_VFAULT" 16497921 "DTC_MBB_01_TFAULT" 16497922 "DTC_MBB_02_TFAULT" 16497923 "DTC_MBB_03_TFAULT" 16497924 "DTC_MBB_04_TFAULT" 16497925 "DTC_MBB_05_TFAULT" 16497926 "DTC_MBB_06_TFAULT" 16497927 "DTC_MBB_07_TFAULT" 16497928 "DTC_MBB_08_TFAULT" 16497929 "DTC_MBB_09_TFAULT" 16497936 "DTC_MBB_10_TFAULT" 16497937 "DTC_MBB_11_TFAULT" 16497938 "DTC_MBB_12_TFAULT" 16497939 "DTC_MBB_13_TFAULT" 16497940 "DTC_MBB_14_TFAULT" 16497941 "DTC_MBB_15_TFAULT" 16497942 "DTC_MBB_16_TFAULT" 16497943 "DTC_MBB_17_TFAULT" 16497944 "DTC_MBB_18_TFAULT" 16497945 "DTC_MBB_19_TFAULT" 16497952 "DTC_MBB_20_TFAULT" 16497953 "DTC_MBB_21_TFAULT" 16497954 "DTC_MBB_22_TFAULT" 16497955 "DTC_MBB_23_TFAULT" 16497956 "DTC_MBB_24_TFAULT" 15785984 "DTC_PRECHARGE_ENERGY" 15785985 "DTC_PRT_FAILED" 15785986 "DTC_PRT_OVERTEMP" 15785987 "DTC_PRT_PROHIBIT" 16556032 "DTC_COOLANT_TEMP_OOR_HI" 16556033 "DTC_COOLANT_TEMP_OOR_LO" 16252928 "DTC_KEY_OFF_TIME_ERROR" 16506880 "DTC_VBAT_MISMATCH" 16506881 "DTC_VBAT_VMAX" 16506882 "DTC_VBAT_VMIN" 16506883 "DTC_PACK_FUSE" 15798544 "DTC_LLS1_OOR_HI" 15798545 "DTC_LLS1_OOR_LO" 15798546 "DTC_LLS1_FAULT" 15798816 "DTC_LLS2_OOR_HI" 15798817 "DTC_LLS2_OOR_LO" 15798818 "DTC_LLS2_FAULT" 14479360 "DTC_CFL_HEARTBEAT" 14479361 "DTC_CFL_FAULT" 14479362 "DTC_CFL_FAULT_LATCH" 13635584 "DTC_CONT_A_FAILED_HI" 13635585 "DTC_CONT_A_FAILED_LO" 13635586 "DTC_CONT_B_FAILED_HI" 13635587 "DTC_CONT_B_FAILED_LO" 13635588 "DTC_CONT_C_FAILED_HI" 13635589 "DTC_CONT_C_FAILED_LO" 13635590 "DTC_CONT_D_FAILED_HI" 13635591 "DTC_CONT_D_FAILED_LO" 13635592 "DTC_CONT_E_FAILED_HI" 13635593 "DTC_CONT_E_FAILED_LO" 13635594 "DTC_CONT_F_FAILED_HI" 13635595 "DTC_CONT_F_FAILED_LO" 13635596 "DTC_CONT_G_FAILED_HI" 13635597 "DTC_CONT_G_FAILED_LO" 13635598 "DTC_LSD_A_FAILED_HI" 13635599 "DTC_LSD_A_FAILED_LO" 13635600 "DTC_LSD_B_FAILED_HI" 13635601 "DTC_LSD_B_FAILED_LO" 13635602 "DTC_LSD_C_FAILED_HI" 13635603 "DTC_LSD_C_FAILED_LO" 13635606 "DTC_CONT_PWR_FAILED_HI" 13635607 "DTC_CONT_PWR_FAILED_LO" 13635608 "DTC_LSD_PUMP_FAILED_HI" 13635609 "DTC_LSD_PUMP_FAILED_LO" 13635610 "DTC_CHG_A_ENABLE_FAILED_HI" 13635611 "DTC_CHG_A_ENABLE_FAILED_LO" 13635612 "DTC_CHG_B_ENABLE_FAILED_HI" 13635613 "DTC_CHG_B_ENABLE_FAILED_LO" 13635614 "DTC_SW14V_PWR_FAILED_HI" 13635615 "DTC_SW14V_PWR_FAILED_LO" 13635620 "DTC_HSD_A_FAILED_HI" 13635621 "DTC_HSD_A_FAILED_LO" 13635622 "DTC_HSD_B_FAILED_HI" 13635623 "DTC_HSD_B_FAILED_LO" 13692968 "DTC_CONT_HPWR_FAILED_HI" 13692969 "DTC_CONT_HPWR_FAILED_LO" 13692970 "DTC_CONT_HPWR_OOR_HI" 13692971 "DTC_CONT_HPWR_OOR_LO" 13635616 "DTC_5V_PWR_OOR_HI" 13635617 "DTC_5V_PWR_OOR_LO" 14606336 "DTC_NVM_WRITE_TO" 14606337 "DTC_NVM_READ_TO" 14614528 "DTC_SPI_DIG_POT_FAULT" ;
VAL_ 1120 bcm_dtc_080 0 " - " 11276288 "DTC_VEPO" 11276289 "DTC_HSC_MISSING" 11460608 "DTC_NVM_SOC" 11460609 "DTC_NVM_KOT" 11460610 "DTC_NVM_DTC" 11460611 "DTC_NVM_SOC_CORRECTION" 11460612 "DTC_NVM_APP_SCRATCHPAD" 11517962 "DTC_LOOPTIME_TASK_A" 11517963 "DTC_LOOPTIME_TASK_B" 11517964 "DTC_LOOPTIME_TASK_C" 11517965 "DTC_LOOPTIME_TASK_D" 11517966 "DTC_LOOPTIME_TASK_E" 11517967 "DTC_LOOPTIME_TASK_F" 11323904 "DTC_INTERLOCK_A_FAILED_LOW" 11323905 "DTC_INTERLOCK_A_FAILED_HIGH" 11324160 "DTC_INTERLOCK_B_FAILED_LOW" 11324161 "DTC_INTERLOCK_B_FAILED_HIGH" 15728640 "DTC_EPO" 16498688 "DTC_BRUSA_MISSING" 16498689 "DTC_BRUSA_IDC" 16498690 "DTC_BRUSA_REQ_VS_CMD" 16433152 "DTC_AKERWADE_MISSING" 16433153 "DTC_AKERWADE_IDC" 16433154 "DTC_AKERWADE_REQ_VS_CMD" 16564224 "DTC_CHGLEAR_MISSING" 16564225 "DTC_CHGLEAR_IDC" 16564226 "DTC_CHGLEAR_REQ_VS_CMD" 16522240 "DTC_CSM_MISSING" 16522752 "DTC_CSM_VBAT" 16522753 "DTC_CSM_VPOS" 16522754 "DTC_CSM_VNEG" 16522755 "DTC_CSM_CPOS" 16522756 "DTC_CSM_CNEG" 16522757 "DTC_CSM_APOS" 16522758 "DTC_CSM_ANEG" 16522759 "DTC_CSM_FUSE_HI" 16522760 "DTC_CSM_FUSE_LO" 16521728 "DTC_CSM_ASIC" 16521729 "DTC_CSM_AILO" 16521730 "DTC_CSM_AIHI" 16520957 "DTC_LEAKAGE_DETECT_FAULT" 16522444 "DTC_REALTIMECLOCK_FAULT" 16520945 "DTC_CSM_LEAK_FAIL_CALC" 16520946 "DTC_CSM_LEAK_FAIL_HW" 16520947 "DTC_CSM_LEAK_EXT_SHORT" 16520948 "DTC_CSM_LEAK_MID_PACK_SHORT" 16520949 "DTC_CSM_LEAK_ERROR" 16520950 "DTC_CSM_LEAK_UNKNOWN" 16523008 "DTC_CSM_VER_MISMATCH" 16523009 "DTC_CSM_DTC_SET" 16523010 "DTC_CSM_CAL_FAULT" 16560128 "DTC_IBAT_MISMATCH" 16576512 "DTC_DIS_MAX_I2T" 16576513 "DTC_CHG_MAX_I2T" 16576768 "DTC_DIS_WARNING_I2T" 16576769 "DTC_CHG_WARNING_I2T" 11296784 "DTC_SAEJ1772_PROX_DECT_OOR_HI" 11296785 "DTC_SAEJ1772_PROX_DECT_OOR_LO" 11296800 "DTC_SAEJ1772_PILOT_PWM_OOR_HI" 11296801 "DTC_SAEJ1772_PILOT_PWM_OOR_LO" 11296802 "DTC_SAEJ1772_PILOT_PWM_DIG_COMM" 11296803 "DTC_SAEJ1772_PILOT_PWM_IR_ERR" 16175360 "DTC_FGD1_NO_SENSOR" 16175361 "DTC_FGD1_OOR_HI" 16175362 "DTC_FGD1_OOR_LO" 16175363 "DTC_FGD1_FAULT" 16175616 "DTC_FGD2_NO_SENSOR" 16175617 "DTC_FGD2_OOR_HI" 16175618 "DTC_FGD2_OOR_LO" 16175619 "DTC_FGD2_FAULT" 16171008 "DTC_CONT_OPEN" 16171009 "DTC_CONT_CLOSE" 16171010 "DTC_CONT_OPEN_CURRENT" 16171264 "DTC_CONT_CLOSE_ON_RESET" 16171265 "DTC_CONT_CLOSE_SIG_FAILED" 16171520 "DTC_PRECHARGE_TIMEOUT" 16171777 "DTC_CONT_MPOS_WELD_AT_SU" 16171778 "DTC_CONT_MNEG_WELD_AT_SU" 16171780 "DTC_CONT_CPOS_WELD_AT_SU" 16171781 "DTC_CONT_CNEG_WELD_AT_SU" 16171782 "DTC_CONT_ANEG_WELD_AT_SU" 16171783 "DTC_CONT_APOS_WELD_AT_SU" 16172033 "DTC_CONT_MPOS_WELD_AT_SD" 16172034 "DTC_CONT_MNEG_WELD_AT_SD" 16172036 "DTC_CONT_CPOS_WELD_AT_SD" 16172037 "DTC_CONT_CNEG_WELD_AT_SD" 16172038 "DTC_CONT_ANEG_WELD_AT_SD" 16172039 "DTC_CONT_APOS_WELD_AT_SD" 16172289 "DTC_CONT_MPOS_OPEN" 16172290 "DTC_CONT_MNEG_OPEN" 16172291 "DTC_CONT_MPRE_OPEN" 16172292 "DTC_CONT_CPOS_OPEN" 16172293 "DTC_CONT_CNEG_OPEN" 16172294 "DTC_CONT_APOS_OPEN" 16172295 "DTC_CONT_ANEG_OPEN" 16172545 "DTC_CONT_MPOS_VDIF" 16172546 "DTC_CONT_MNEG_VDIF" 16172548 "DTC_CONT_CPOS_VDIF" 16172549 "DTC_CONT_CNEG_VDIF" 16172550 "DTC_CONT_APOS_VDIF" 16172551 "DTC_CONT_ANEG_VDIF" 16174848 "DTC_HVIL" 16174849 "DTC_LVBAT_LO" 16174850 "DTC_LVBAT_HI" 16174851 "DTC_LVBAT_ERR" 16523520 "DTC_LEMLO_OOR_HI" 16523521 "DTC_LEMLO_OOR_LO" 16523522 "DTC_LEMLO_FAULT" 16523776 "DTC_LEMHI_OOR_HI" 16523777 "DTC_LEMHI_OOR_LO" 16523778 "DTC_LEMHI_FAULT" 16496320 "DTC_MBB_TOO_FEW" 16496321 "DTC_MBB_TOO_MANY" 16496352 "DTC_CELL_VMAX_ERR" 16496353 "DTC_CELL_VMIN_ERR" 16496354 "DTC_CELL_VMAX" 16496362 "DTC_CELL_VMAX_SEVERE" 16496355 "DTC_CELL_VMIN" 16496363 "DTC_CELL_VMIN_SEVERE" 16496356 "DTC_MOD_VOLTAGE_COMPARE" 16496336 "DTC_CELL_T_ERR" 16496337 "DTC_CELL_TMAX1" 16496338 "DTC_CELL_TMAX2" 16496339 "DTC_CELL_TMIN" 16497665 "DTC_MBB_01_MISSING" 16497666 "DTC_MBB_02_MISSING" 16497667 "DTC_MBB_03_MISSING" 16497668 "DTC_MBB_04_MISSING" 16497669 "DTC_MBB_05_MISSING" 16497670 "DTC_MBB_06_MISSING" 16497671 "DTC_MBB_07_MISSING" 16497672 "DTC_MBB_08_MISSING" 16497673 "DTC_MBB_09_MISSING" 16497680 "DTC_MBB_10_MISSING" 16497681 "DTC_MBB_11_MISSING" 16497682 "DTC_MBB_12_MISSING" 16497683 "DTC_MBB_13_MISSING" 16497684 "DTC_MBB_14_MISSING" 16497685 "DTC_MBB_15_MISSING" 16497686 "DTC_MBB_16_MISSING" 16497687 "DTC_MBB_17_MISSING" 16497688 "DTC_MBB_18_MISSING" 16497689 "DTC_MBB_19_MISSING" 16497696 "DTC_MBB_20_MISSING" 16497697 "DTC_MBB_21_MISSING" 16497698 "DTC_MBB_22_MISSING" 16497699 "DTC_MBB_23_MISSING" 16497700 "DTC_MBB_24_MISSING" 16498177 "DTC_MBB_01_VFAULT" 16498178 "DTC_MBB_02_VFAULT" 16498179 "DTC_MBB_03_VFAULT" 16498180 "DTC_MBB_04_VFAULT" 16498181 "DTC_MBB_05_VFAULT" 16498182 "DTC_MBB_06_VFAULT" 16498183 "DTC_MBB_07_VFAULT" 16498184 "DTC_MBB_08_VFAULT" 16498185 "DTC_MBB_09_VFAULT" 16498192 "DTC_MBB_10_VFAULT" 16498193 "DTC_MBB_11_VFAULT" 16498194 "DTC_MBB_12_VFAULT" 16498195 "DTC_MBB_13_VFAULT" 16498196 "DTC_MBB_14_VFAULT" 16498197 "DTC_MBB_15_VFAULT" 16498198 "DTC_MBB_16_VFAULT" 16498199 "DTC_MBB_17_VFAULT" 16498200 "DTC_MBB_18_VFAULT" 16498201 "DTC_MBB_19_VFAULT" 16498208 "DTC_MBB_20_VFAULT" 16498209 "DTC_MBB_21_VFAULT" 16498210 "DTC_MBB_22_VFAULT" 16498211 "DTC_MBB_23_VFAULT" 16498212 "DTC_MBB_24_VFAULT" 16497921 "DTC_MBB_01_TFAULT" 16497922 "DTC_MBB_02_TFAULT" 16497923 "DTC_MBB_03_TFAULT" 16497924 "DTC_MBB_04_TFAULT" 16497925 "DTC_MBB_05_TFAULT" 16497926 "DTC_MBB_06_TFAULT" 16497927 "DTC_MBB_07_TFAULT" 16497928 "DTC_MBB_08_TFAULT" 16497929 "DTC_MBB_09_TFAULT" 16497936 "DTC_MBB_10_TFAULT" 16497937 "DTC_MBB_11_TFAULT" 16497938 "DTC_MBB_12_TFAULT" 16497939 "DTC_MBB_13_TFAULT" 16497940 "DTC_MBB_14_TFAULT" 16497941 "DTC_MBB_15_TFAULT" 16497942 "DTC_MBB_16_TFAULT" 16497943 "DTC_MBB_17_TFAULT" 16497944 "DTC_MBB_18_TFAULT" 16497945 "DTC_MBB_19_TFAULT" 16497952 "DTC_MBB_20_TFAULT" 16497953 "DTC_MBB_21_TFAULT" 16497954 "DTC_MBB_22_TFAULT" 16497955 "DTC_MBB_23_TFAULT" 16497956 "DTC_MBB_24_TFAULT" 15785984 "DTC_PRECHARGE_ENERGY" 15785985 "DTC_PRT_FAILED" 15785986 "DTC_PRT_OVERTEMP" 15785987 "DTC_PRT_PROHIBIT" 16556032 "DTC_COOLANT_TEMP_OOR_HI" 16556033 "DTC_COOLANT_TEMP_OOR_LO" 16252928 "DTC_KEY_OFF_TIME_ERROR" 16506880 "DTC_VBAT_MISMATCH" 16506881 "DTC_VBAT_VMAX" 16506882 "DTC_VBAT_VMIN" 16506883 "DTC_PACK_FUSE" 15798544 "DTC_LLS1_OOR_HI" 15798545 "DTC_LLS1_OOR_LO" 15798546 "DTC_LLS1_FAULT" 15798816 "DTC_LLS2_OOR_HI" 15798817 "DTC_LLS2_OOR_LO" 15798818 "DTC_LLS2_FAULT" 14479360 "DTC_CFL_HEARTBEAT" 14479361 "DTC_CFL_FAULT" 14479362 "DTC_CFL_FAULT_LATCH" 13635584 "DTC_CONT_A_FAILED_HI" 13635585 "DTC_CONT_A_FAILED_LO" 13635586 "DTC_CONT_B_FAILED_HI" 13635587 "DTC_CONT_B_FAILED_LO" 13635588 "DTC_CONT_C_FAILED_HI" 13635589 "DTC_CONT_C_FAILED_LO" 13635590 "DTC_CONT_D_FAILED_HI" 13635591 "DTC_CONT_D_FAILED_LO" 13635592 "DTC_CONT_E_FAILED_HI" 13635593 "DTC_CONT_E_FAILED_LO" 13635594 "DTC_CONT_F_FAILED_HI" 13635595 "DTC_CONT_F_FAILED_LO" 13635596 "DTC_CONT_G_FAILED_HI" 13635597 "DTC_CONT_G_FAILED_LO" 13635598 "DTC_LSD_A_FAILED_HI" 13635599 "DTC_LSD_A_FAILED_LO" 13635600 "DTC_LSD_B_FAILED_HI" 13635601 "DTC_LSD_B_FAILED_LO" 13635602 "DTC_LSD_C_FAILED_HI" 13635603 "DTC_LSD_C_FAILED_LO" 13635606 "DTC_CONT_PWR_FAILED_HI" 13635607 "DTC_CONT_PWR_FAILED_LO" 13635608 "DTC_LSD_PUMP_FAILED_HI" 13635609 "DTC_LSD_PUMP_FAILED_LO" 13635610 "DTC_CHG_A_ENABLE_FAILED_HI" 13635611 "DTC_CHG_A_ENABLE_FAILED_LO" 13635612 "DTC_CHG_B_ENABLE_FAILED_HI" 13635613 "DTC_CHG_B_ENABLE_FAILED_LO" 13635614 "DTC_SW14V_PWR_FAILED_HI" 13635615 "DTC_SW14V_PWR_FAILED_LO" 13635620 "DTC_HSD_A_FAILED_HI" 13635621 "DTC_HSD_A_FAILED_LO" 13635622 "DTC_HSD_B_FAILED_HI" 13635623 "DTC_HSD_B_FAILED_LO" 13692968 "DTC_CONT_HPWR_FAILED_HI" 13692969 "DTC_CONT_HPWR_FAILED_LO" 13692970 "DTC_CONT_HPWR_OOR_HI" 13692971 "DTC_CONT_HPWR_OOR_LO" 13635616 "DTC_5V_PWR_OOR_HI" 13635617 "DTC_5V_PWR_OOR_LO" 14606336 "DTC_NVM_WRITE_TO" 14606337 "DTC_NVM_READ_TO" 14614528 "DTC_SPI_DIG_POT_FAULT" ;
